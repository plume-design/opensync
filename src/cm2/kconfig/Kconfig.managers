## src/fsm/kconfig/Kconfig.managers
```kconfig
menuconfig MANAGER_FSM
    bool "Flow Service Manager (FSM)"
    default y
    help
        Enable Flow Service Manager (FSM)

    config MANAGER_FSM_CFG
        depends on MANAGER_FSM
        string "FSM Startup configuration"
        default "fsm;true;always_restart=true;restart_delay=-1"
        help
            Flow Service Manager startup configuration

    config FSM_PCAP_SNAPLEN
        depends on MANAGER_FSM
        int "Set snapshot len"
        default 0
        help
            Set a custom snapshot length.

            If unsure, use 0 (use libpcap default - 65535).

    config FSM_ZMQ_IMC
        depends on MANAGER_FSM
        bool "Use ZMQ as IMC"
        default n
        help
            Default FSM to FCM communication through ZMQ, Disabling switches
            to Unix domain socket

    config FSM_DPI_DNS
        depends on MANAGER_FSM
        bool "Use DPI_DNS as dns module"
        default y
        help
            DPI_DNS plugin to process A, AAAA and Type 65 DNS exchanges

    config FSM_DPI_NDP
        depends on MANAGER_FSM
        bool "Use DPI_NDP as neighbor discovery module"
        default y
        help
            DPI_NDP plugin to process arp and icmpv6 NS and NA message exchanges

    config FSM_DPI_MDNS_RESPONDER
        depends on MANAGER_FSM
        bool "Use DPI_MDNS_RESPONDER to respond to mdns queries"
        default y
        help
            DPI_MDNS_RESPONDER plugin to respond to mdns queries

    config FSM_MEM_MAX
        depends on MANAGER_FSM
        int "High memory usage threshold in MB for FSM"
        default 160
        help
            FSM will be restarted once this threshold is reached.
            This value can be overridden through the ovsdb Node_Config table.

    config FSM_DPI_SOCKET
        depends on MANAGER_FSM
        bool "FSM getting packets to parse through a network socket"
        default y if PLATFORM_IS_NATIVE
        default n
        help
            Start a UDP listening server to receive packets to parse through
            a remote network entity.

    config FSM_NF_CONNTRACK
        depends on MANAGER_FSM
        bool "Access netfilter conntrack API"
        default n if PLATFORM_IS_NATIVE
        default y
        help
            Enable access netfilter conntrack API

    config FSM_TAP_INTF
        depends on MANAGER_FSM
        bool "Enable tap interfaces"
        default n if PLATFORM_IS_NATIVE
        default y
        help
            Enable tap interfaces

    config FSM_NO_DSO
        depends on MANAGER_FSM
        depends on PLATFORM_IS_NATIVE
        bool "Compile all FSM plugins as part of libopensync as opposed to DSOs"
        default y if $(shell, echo $(CC) | grep -qw ^clang && echo "yes" || echo "no") = "yes"
        help
            Compile FSM plugins as part of libopensync in native mode if the compiler is clang

    config FSM_MAP_LEGACY_PLUGINS
        depends on MANAGER_FSM
        bool "Hard code a mapping between legacy plugins and reserved internet ports"
        default n
        help
            Hard code a mapping between legacy plugins and reserved internet ports

    config FSM_ALWAYS_ADD_NEIGHBOR_INFO
        depends on MANAGER_FSM
        depends on PLATFORM_IS_NATIVE
        bool "Unconditionally cache IP <-> mac mapping from a packet"
        default y
        help
            Hard code a mapping between legacy plugins and reserved internet ports

    config FSM_ENABLE_DBG
        depends on MANAGER_FSM
        bool "Debug configuration only"
        default y
        help
            Allow the management of debugging knobs
```

## src/hello_world/kconfig/Kconfig.managers
```kconfig
menuconfig MANAGER_HELLOWORLD
    bool "Hello World"
    default n
    help
        Enable Hello World -- example manager

        The Hello World is an example manager so it is disabled by default. You
        can start it by using the following command:

        ovsh u Node_Services --where service==hello_world enable:=true

    config MANAGER_HELLOWORLD_CFG
        string "Hello World Startup configuration"
        depends on MANAGER_HELLOWORLD
        default "hello_world;false"
        help
            Hello World startup configuration
```

## src/iotm/kconfig/Kconfig.managers
```kconfig
menuconfig MANAGER_IOTM
    bool "IoT Manager (IOTM)"
    default n
    help
        IoT Manager (IOTM) manages everything related to IoT connectivity,
        including Thread 802.15.4 mesh networking protocol.

if MANAGER_IOTM
    config MANAGER_IOTM_CFG
        string "IOTM Startup configuration"
        default "iotm;true;needs_plan_b=false"
        help
            IoT Manager startup configuration

    menuconfig IOTM_ENABLE_THREAD
        bool "Enable support for Thread Border Router functionality"
        default n

    if IOTM_ENABLE_THREAD
        config IOTM_THREAD_INTERFACE_NAME
            string "Default Thread network interface name"
            default "wpan0"

        config IOTM_THREAD_SCAN_INTERVAL
            int "Default interval (seconds) to scan the Thread network(s)"
            default 0
            help
                If greater than 0, periodic Thread network diagnostic scan will be
                performed, to retrieve topology and other information about the
                devices in the Thread network.
    endif

endif
```

## src/lib/accel_evict_msg/kconfig/Kconfig.libs
```kconfig
menuconfig ACCEL_FLOW_EVICT_MESSAGE
    bool "Enables accel flow eviction messages"
    default y
	depends on MANAGER_FSM
    depends on !PLATFORM_IS_NATIVE
    help
        Enable custom packet called flush which is used to sent acceleration eviction notices to opensync nodes.
```

## src/lib/arp_parse/kconfig/Kconfig.libs
```kconfig
menuconfig LIB_LEGACY_FSM_ARP_PARSER
    bool "Enables Opensync legacy FSM ARP parser"
    default n
    help
       N/A
```

## src/lib/common/kconfig/Kconfig.libs
```kconfig
menu "OS Common configuration"

    config OS_EV_TRACE
    bool "enable libev event tracing"
    default n
    help
        Enable libev tracing. libev must have support for it.

    config MEM_MONITOR
    bool "dynamic memory allocation monitoring"
    default n
    help
            Enable dynamic memory allocation monitoring

endmenu
```

## src/lib/ct_stats/kconfig/Kconfig.libs
```kconfig
menuconfig FCM_CT_STATS
    bool "Connection tracking statistics collection module"
    default y
    depends on MANAGER_FCM
    help
        Enables collection of connection track statistics

    config FCM_PROXIMITY_SUPPORT
        bool "Enable collecting all current apps and updating live flows for proximity use case"
        default n
        help
            Enable collecting all current apps and updating live flows for proximity use case
```

## src/lib/data_report_tags/kconfig/Kconfig.libs
```kconfig
menuconfig LIB_DATA_REPORT_TAGS
    bool "Enables data report tags"
        default y
        help
            N/A
```

## src/lib/dhcp_parse/kconfig/Kconfig.libs
```kconfig
menuconfig LIB_LEGACY_FSM_DHCP_PARSER
    bool "Enables Opensync legacy FSM DHCP parser"
    default n
    help
       N/A
```

## src/lib/dns_parse/kconfig/Kconfig.libs
```kconfig
menuconfig LIB_LEGACY_FSM_DNS_PARSER
    bool "Enables Opensync legacy FSM DNS parser"
    default n
    help
       N/A
```

## src/lib/est/kconfig/Kconfig.libs
```kconfig
menuconfig EST_CLIENT_LIB
    bool "EST Client library"
    default y
    depends on MANAGER_PKIM
    help
        EST Client library will be build EST
```

## src/lib/evx/kconfig/Kconfig.libs
```kconfig
menu "libevx Configuration"
    config LIBEVX_USE_CARES
        bool "Asynchronous DNS resolution support"
        default n
        help
            Enable support for asynchronous DNS resolution.

            This requires libcares to be present on the platform.
endmenu
```

## src/lib/ff/kconfig/Kconfig.libs
```kconfig
menu "libff: Feature Flag (FF) configuration"
    config FF_ACCESS_PATH
        string "Path for feature flags access provider"
        default "$(INSTALL_PREFIX)/etc/ff"
        help
            Files from this path will be checked by access provider to consider flags as enabled.
            To set flag as ENABLED by this provider create a corresponding "flag_name" file in that path.
endmenu
```

## src/lib/fsm_dpi_dhcp_relay/kconfig/Kconfig.libs
```kconfig
menu "DHCP Relay Configuration"
    config DHCP_RELAY_SPOOF_SOURCE_MAC
        bool "Spoof source MAC"
        default y
        help
            When relaying a DHCP message, the Ethernet source MAC address
            will be the MAC address of the relay instead of the DHCP client.
            Some DHCP servers will reject DHCP messages if the client's MAC
            address doesn't match the Ethernet source address.

            This option enables 'source MAC address spoofing', meaning that
            the Ethernet source MAC address is replaced with the MAC address
            of the DHCP client.
endmenu
```

## src/lib/fsm_dpi_sec_portmap/kconfig/Kconfig.libs
```kconfig
menuconfig FSM_DPI_SEC_PORTMAP
        bool "Enables port forwarding monitoring"
        depends on MANAGER_FSM
        default y if PLATFORM_IS_NATIVE
        default n
        help
            "Enables port forwarding monitoring through FSM"
```

## src/lib/fsm_dpi_upnp/kconfig/Kconfig.libs
```kconfig
menuconfig FSM_DPI_UPNP
        bool "Enables UPnP port forwarding monitoring"
        depends on MANAGER_FSM
        default y if PLATFORM_IS_NATIVE
        default n
        help
            "Enables UPnP port forwarding monitoring through FSM"
```

## src/lib/fsm_utils/kconfig/Kconfig.libs
```kconfig
menuconfig LIB_FSM_UTILS
    bool "Enables the FSM utilities library"
        default y
        help
            Enable the FSM utilities library

config FSM_IPC_USE_OSBUS
    bool "Use OSBUS for FSM_IPC"
    depends on LIB_FSM_UTILS && USE_OSBUS
    default n
    help
        Use OSBUS for fsm_ipc instead of unix sockets (imc)
```

## src/lib/gatekeeper_cache/kconfig/Kconfig.libs
```kconfig
menu "lib_gatekeeper_cache Configuration"
    config LIBGATEKEEPER_CACHE
        bool "Library for caching Gatekeeper Service (IP flows and flow attributes)"
        default y
        help
            Library for caching Gatekeeper Service (IP flows and flow attributes)

    config GATEKEEPER_CACHE_LRU_SIZE
        depends on LIBGATEKEEPER_CACHE
        int "Set gatekeeper cache LRU size"
        default 8 if PLATFORM_IS_NATIVE
        default 32000
endmenu
```

## src/lib/gatekeeper_plugin/kconfig/Kconfig.libs
```kconfig
menu "libgatekeeper_plugin Configuration"
    config GATEKEEPER_ENDPOINT
        bool "endpoints support based on attribute type"
        default n
        help
            Enable support to enable URL endpoints based on attribute type
endmenu
```

## src/lib/hostap/kconfig/Kconfig
```kconfig
config HOSTAP_LIB
    bool "OpenSync hostapd library"
    default y

config HOSTAP_TIMEOUT_T_SWITCH
    bool "use -t switch with timeout command"
    default y
    help
        Depending on busybox or coreutils package version
        on target platform the "timeout" command either
        will take "timeout -t 5 ..." or "timeout 5 ...".

        Enable this if "timeout -t 5 ..." works on your platform.

        Disable this if "timeout 5 ..." works on your platform.

config HOSTAP_PSK_FILE_WPS
    bool "use PSKs from wpa_psk_file for WPS sessions"
    default y
    help
        We introduced new tag "wps" to PSK file. That tag is used
        for marking PSKs usable in WPS sessions.

        This feature is dependent on the below upstream hostap commit
        which recognizes this tag.

            commit fde8e7946304569292c5d520d76371291cc4f88c
            Author: Tomasz Jankowski tomasz.jankowski@plume.com
            Date: Mon Feb 10 12:49:33 2020 +0100

            WPS: Make it possible to use PSKs loaded from the PSK file.

        Enable this only on platforms using hostap patched with above commit.

config HOSTAP_WPA_SUPPLICANT_GLOBAL_PATH
    string "WPA supplicant global path"
    default "/var/run/wpa_supplicantglobal"
    help
        Specify WPA supplicant global path, which depends on wpad.init in hostapd package.

        In openwrt hostapd opensource community, it is set as /var/run/wpa_supplicant/global by default.
        https://github.com/openwrt/openwrt/blob/master/package/network/services/hostapd/files/wpad.init#L30

        As WPA supplicant global path might be customized in wpad.init by SDK, it is suggeested to make it
        configurable by opensync kconfig to match the customized path.
```
