## src/cm2/kconfig/Kconfig.managers
```kconfig
menuconfig MANAGER_CM
    bool "Connectivity Manager (CM)"
    default y
    help
        CM2 (Cloud Manager) is responsible for cloud connectivity and WiFi
        backhaul onboarding

if MANAGER_CM
    config MANAGER_CM_CFG
        string "Startup options"
        default "cm;true;needs_plan_b=true"
        help
            Manager startup options

    config CM2_USE_WAN_LINK_MANAGEMENT
        bool "Use CM to manage WAN links"
        default y
        help
            Use Wifi_Master_State table to manage WAN links

    config CM2_USE_DRYRUN_ON_GRE
        bool "Use udhcpc dryrun on gre interfaces"
        default y
        help
            Run udhcpc dryrun on gre interfaces during link examination

    config CM2_USE_CUSTOM_UDHCPC
        bool "Use patched udhcpc for link selection"
        default y
        help
            Leverage non-standard udhcpc patches in order to improve link selection

    config CM2_USE_UDHCPC_VENDOR_CLASSID
       bool "Use udhcpc with vendor classid"
       default y
       help
          Enable vendor classId option in udhcpc during link examination"

    config CM2_MTU_ON_GRE
        int "MTU on GRE interface"
        default 1500
        help
            Define mtu on gre interface for WiFi sta interfaces

    config CM2_ETHERNET_SHORT_DELAY
        int "short ethernet delay"
        default 5
        help
            short delay before adding ethernet into br-home bridge to protect loop creation

    config CM2_ETHERNET_LONG_DELAY
        int "long ethernet delay"
        default 128
        help
            long delay before adding ethernet into br-home bridge used during boot the platform to protect loop creation

    config CM2_OVS_MIN_BACKOFF
        int "Minimum OVS backoff"
        default 30
        help
            Minimum value to randomly backoff for the next OVS connection to be established

    config CM2_OVS_MAX_BACKOFF
        int "Maximum OVS backoff"
        default 60
        help
            Maximum value to randomly backoff for the next OVS connection to be established

    config CM2_OVS_SHORT_BACKOFF
        int "Short OVS backoff"
        default 8
        help
           Deafult short backoff time for the next OVS connection to be established

    menuconfig CM2_USE_WDT
        bool "Use WDT module"
        select CM2_USE_STABILITY_CHECK
        default y

        if CM2_USE_WDT
            comment "WDT configuration"

        config CM2_WDT_INTERVAL
            int "Interval of WDT ping"
            default 10
            help
                Watchdog ping interval
        endif

    menuconfig CM2_USE_TCPDUMP
        bool "Use tcpdump"
        select CM2_USE_STABILITY_CHECK
        default y
        help
            Run tcpdump on main link when connection problem is detected

        if CM2_USE_TCPDUMP
            comment "Tcpdump configuration"

            config CM2_TCPDUMP_START_STOP_DAEMON_PATH
                string "start-stop-daemon path"
                depends on CM2_USE_TCPDUMP
                default "/sbin/start-stop-daemon"
                help
                    Path to start-stop-daemon

            config CM2_TCPDUMP_PATH
                string "tcpdump path"
                default "/usr/sbin/tcpdump"
                help
                    Path to tcpdump application

            config CM2_TCPDUMP_PREFIX_FILE
                string "tcpdump prefix file"
                default "tcpdump"
                help
                    Prefix to tcpdump pcap file

            config CM2_TCPDUMP_TIMEOUT_PARAM
                string "tcpdump timeout param"
                default "300"
                help
                    Close tcpdump after timeout in sec

            config CM2_TCPDUMP_COUNT_PARAM
                string "tcpdump count param"
                default "5000"
                help
                    Close tcpdump after receiving count packets

            config CM2_TCPDUMP_SNAPLEN_PARAM
                string "tcpdump count param"
                default "128"
                help
                    tcpdump snarf snaplen bytes of data from each packet

        endif

    config CM2_CLOUD_FATAL_THRESHOLD
            int "Threshold of resolving tries and amount of new controller address used"
            default 0
            help
                Threshold of resolving tries and new tries of connection to the controller without success.
                The reason of usage is protection against resolving library hanged or ovsdb-server.
                Value 0 means threshold disabled

    menuconfig CM2_USE_STABILITY_CHECK
        bool "Use stability checking"
        default y
        help
            Run stability checking to verify quality of established connection

        if CM2_USE_STABILITY_CHECK
            comment "Stability configuration"

        config CM2_STABILITY_INTERVAL
            int "Interval of stability check trigger"
            default 10
            help
                Define interval in sec to trigger stability check process

        config CM2_STABILITY_THRESH_LINK
            int "Threshold of link restart"
            default 2
            help
                Threshold of subsequent link failures to try fix the link

        config CM2_STABILITY_THRESH_FATAL
            int "Threshold of OpenSync restart"
            default 8
            help
                Threshold of subsequent check failures to restart OpenSync

        config CM2_STABILITY_THRESH_ROUTER
            int "Threshold of restore connection"
            default 4
            help
                Threshold of subsequent router check failures to trigger restore connection

        config CM2_STABILITY_THRESH_INTERNET
            int "Threshold of restore Internet"
            default 6
            help
                Threshold of subsequent Internet check failures to trigger restore Internet

        config CM2_STABILITY_THRESH_VTAG
            int "Threshold of remove VTAG usage"
            default 10
            help
                Threshold of subsequent router check failures to rollback to previous VTAG settings

        config CM2_STABILITY_THRESH_CPU
            string "Threshold of CPU to trigger stability checking"
            default "0.70"
            help
                Threshold of loadavg (number of currently executing kernel scheduling entities) to allow trigger stability checking

        config CM2_STABILITY_THRESH_TCPDUMP
            int "Threshold of tcpdump running"
            default 4
            help
               Threshold of subsequent router check failures to trigger collect data on main interface

        config CM2_STABILITY_USE_RESTORE_SWITCH_CFG
            bool "Use restoring switch configuration"
            default n
            help
               Some devices require restoring switch configuration when problems with connectivity is detected

        endif

    config CM2_USE_EXTRA_DEBUGS
        bool "Use additional debug logs"
        default y
        help
           Enable additional debug logs"
endif
```

## src/cpm/kconfig/Kconfig.managers
```kconfig
menuconfig MANAGER_CAPTIVEPORTAL
    bool "Captive Portal"
    default y
    help
        Enable Captive Portal

        The Captive Portal manager is to run services related to bringing up captive portal
        at a location. You can start it by using the following command:

        ovsh u Node_Services --where service==cpm enable:=true

    config MANAGER_CAPTIVEPORTAL_CFG
        string "Captive Portal Startup configuration"
        depends on MANAGER_CAPTIVEPORTAL
        default "cpm;false"
        help
            Captive Portal startup configuration

    config CPM_TINYPROXY_PATH
        string "Path to the tinyproxy binary"
        depends on MANAGER_CAPTIVEPORTAL
        default "/usr/sbin/tinyproxy"
        help
            Full path to the tinyproxy binary

    config CPM_TINYPROXY_ETC
        string "tinyproxy configuration folder"
        depends on MANAGER_CAPTIVEPORTAL
        default "/tmp/tinyproxy"
        help
            This is the location where the tinyproxy.conf
            file will be created.
```

## src/dm/kconfig/Kconfig.managers
```kconfig
menuconfig MANAGER_DM
    bool "Device Manager (DM)"
    default y

if MANAGER_DM
    config DM_MANAGER_PATH
        string "Managers search path"
        default "$(INSTALL_PREFIX)/bin"
        help
            Search path that will be used to locate managers. Multiple paths
            can be specified by using ; as separator.

    config DM_PID_PATH
        string "Path to the PID folder"
        default "/tmp/dmpid"
        help
            This is the folder where PID files of the started processes will
            be stored. The files will be named [MANAGER_NAME].pid

    config DM_OSYNC_CRASH_REPORTS
        bool "OpenSync crash reports sent to cloud"
        default y
        help
            If an OpenSync process crashes, a concise crash report
            will be generated and sent to the cloud.

    config DM_CRASH_REPORTS_TMP_DIR
        string "Temporary directory for storing OpenSync crash reports"
        default "/tmp/osync_crash_reports"
        help
            The directory in which to store crash report files before
            they are sent to the cloud and deleted.

    config DM_DEFAULT_MAX_MEMORY
        int "Default high memory usage limit in kB"
        default 10000
        help
            DM will abort the manager when its memory limit (in kB) is exceeded
            DM_DEFAULT_MAX_MEMORY_CNT times. If the process does not have custom
            memory limit defined, this default value will be used instead.

    config DM_DEFAULT_MAX_MEMORY_CNT
        int "Default high memory exceeded counter"
        default 10
        help
            The number of times the DM_DEFAULT_MAX_MEMORY limit must be exceeded
            before DM takes any action.
endif
```

## src/fcm/kconfig/Kconfig.managers
```kconfig
menuconfig MANAGER_FCM
    bool "Flow Collection Manager (FCM)"
    default y
    help
        Enable Flow Collection Manager (FCM)

    config MANAGER_FCM_CFG
        depends on MANAGER_FCM
        string "FCM Startup configuration"
        default "fcm;true;always_restart=true;restart_delay=-1"
        help
            Flow Collection Manager startup configuration

    config FCM_ZMQ_IMC
        depends on MANAGER_FCM
        bool "Use ZMQ as IMC"
        default n
        help
            Default FSM to FCM communication through ZMQ, Disabling switches
            to Unix domain socket

    config FCM_MEM_MAX
        depends on MANAGER_FCM
        int "High memory usage threshold in MB for FCM"
        default 100
        help
            FCM will be restarted once this threshold is reached.
            This value can be overridden through the ovsdb Node_Config table.

    config FCM_NO_DSO
        depends on MANAGER_FCM
        depends on PLATFORM_IS_NATIVE
        bool "Compile all FCM plugins as part of libopensync as opposed to DSOs"
        default y if $(shell, echo $(CC) | grep -qw ^clang && echo "yes" || echo "no") = "yes"
        help
            Compile FCM plugins as part of libopensync in native mode if the compiler is clang

    config FCM_MEM_CHECK_PERIOD
        depends on MANAGER_FCM
        int "Set FCM memory check periodicity"
        default 120
        help
            Set FCM memory check periodicity.
```

## src/fm/kconfig/Kconfig.managers
```kconfig
menuconfig MANAGER_FM
    bool "Flash Manager (FM)"
    default n
    help
        Flash Manager

if MANAGER_FM
    config MANAGER_FM_CFG
        string "FM Startup configuration"
        default "fm;true;needs_plan_b=true"
        help
            Flash Manager startup configuration

    comment "Default logging type"

    config FM_LOG_FILE
    string "Name of the log file to rotate"
    default "messages"
    help
        Name of the base log file to rotate

    config FM_LOGFILE_MONITOR
        string "Monitored log file name"
        default "messages.0"
        help
            "Monitored log file name"

    config FM_LOG_PATH
        string "Path where FM_LOG_PATH and FM_LOGFILE_MONITOR are stored"
        default "/var/log"
        help
            Path to log files

    config FM_LOG_FLASH_ARCHIVE_PATH
        string "Path where to keep archived logs on flash"
        default "$(INSTALL_PREFIX)/log_archive"
        help
            Path where to keep archived logs on flash when logging to flash is enabled

    config FM_LOG_RAM_ARCHIVE_PATH
        string "Path where to keep archived logs on RAM"
        default "/var/log/opensync/log_archive"
        help
            Path where to keep archived logs on RAM when logging to RAM is enabled

    config FM_LOG_ARCHIVE_SUBDIRECTORY
        string "Subdirectory in the archive directory to store logs"
        default "syslog"
        help
            Subdirectory in the archive directory to store logs

    comment "Default logging type"

    config FM_LOG_TO_RAMOOPS
        bool "Logging to ramoops"
        default y
        help
            Logging to RAMOOPS

    config FM_LOG_TO_FLASH
        bool "Logging to flash"
        default n
        help
            Logging to flash only

    config FM_RAMOOPS_BUFFER
        string "Default path to ramoops buffer"
        default "/dev/pmsg0"
        help
            Path to a secured userspace-accessible pstore object

    config FM_CRASH_LOG_DIR
        string "Default crash logs directory"
        default "crash"
        help
            Crash log directory name

    config FM_LOG_CRASH_ARCHIVE_PATH
        string "Path where to keep archived logs on RAM"
        default "/var/log/opensync/log_archive/crash"
        help
            Path where to keep archived logs on RAM when logging to RAM is enabled

    config FM_MAX_ROTATION_SYSLOG_FLASH_CNT
        int "Maximum number of syslog files in flash"
        default 8
        help
            Maximum number of rotated syslog files to keep in flash

    config FM_MAX_ROTATION_SYSLOG_RAM_CNT
        int "Maximum number of syslog files in RAM"
        default 8
        help
            Maximum number of rotated syslog files to keep in RAM

    config FM_RAM_SYSLOG_SIZE
        int "RAM: syslog size"
        default 1024
        help
            Size of syslog file storing in RAM

    config FM_FLASH_SYSLOG_SIZE
        int "FLASH syslog size"
        default 1024
        help
            Size of syslog file storing in FLASH

    comment "Default persistent configuration"

    config FM_USE_PERSIST
        bool "Use persist state by default"
        default n
        help
            Use persist state to keep data with logging type

    config FM_LOG_PERSISTENT_STATE
        string "Path to file with log state"
        default "$(INSTALL_PREFIX)/log_archive/fm_state"
        help
            "Path to the file with log state info"

    config FM_CRASH_COUNT_PATH
        string "Default filepath for crash file count"
        default "/tmp/crash_count.txt"
        help
            Path to a file destination for crash file count

    config FM_CRASH_FILE_COUNT
        int "Maximum number of syslog crash files"
        default 100
        help
            Maximum number of rotated crash syslog files to keep
endif
```
