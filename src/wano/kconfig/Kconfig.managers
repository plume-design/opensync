## src/wano/kconfig/Kconfig.managers
```kconfig
menuconfig MANAGER_WANO
    bool "WAN Orchestrator (WANO)"
    default y
    help
        Enable WAN Orchestrator (WANO)

if MANAGER_WANO
    config MANAGER_WANO_CFG
        string "WANO Startup configuration"
        default "wano;true;needs_plan_b=true;max_memory=20000"
        help
            WAN Orchestrator startup configuration

    config MANAGER_WANO_IFACE_LIST
        string "WANO Interface List"
        default "eth0"
        help
            Space separated interface list that will be used for WAN probing.

            Optionally an interface type can be specified by appending the
            ":type" string to the interface name. If the type is not specified,
            `eth` is assumed. Currently the only supported types are `eth` and
            `unmanaged`.

    config MANAGER_WANO_PLUGIN_TIMEOUT
        int "WAN plug-in link probing timeout"
        default 15
        help
            If the WAN plug-in probing doesn't reach a conclusion in the amount
            of time defined by this option, it is terminated and WANO moves to
            the next plug-in in the list.

    config MANAGER_WANO_PLUGIN_IMMEDIATE_TIMEOUT
        int "WAN plug-in immediate timeout"
        default 300
        help
            This is the amount of time that the pipeline is allowed to do an
            immediate restart without using a backoff timer. After the amount of
            seconds defined in this variable, the pipeline will sleep for an
            increasing amount of time before restarting plug-ins.

    config MANAGER_WANO_PLUGIN_DHCPV4
        bool "WANO IPv4 DHCP plugin"
        default y
        help
            WANO DHCPv4 plug-in for interface configuration via the DHCPv4
            protocol.

    config MANAGER_WANO_PLUGIN_DHCPV6
        bool "WANO IPv6 DHCP plugin"
        default y
        help
            WANO DHCPv6 plug-in for interface configuration via the DHCPv6/RA
            protocol.

    config MANAGER_WANO_PLUGIN_STATIC_IPV4
        bool "WANO static IPv4 plugin"
        default y
        help
            Plugin configuring static IP address on WAN interfaces.
            Configuration parameters are read from "wanp" key-value OPS, here
            is the list of parameters:
            "static-ipv4-ip-addr" : The IP address (string)
            "static-ipv4-netmask" : The netmask (string)
            "static-ipv4-gateway" : The gateway (string)
            "static-ipv4-ping-addrs" : Addresses for ping (semicolon separated
                                       list)
    config MANAGER_WANO_PLUGIN_PPPOE
        bool "WANO pppoe plugin"
        default y
        help
            WANO pppoe plug-in for interface configuration via the pppoe
            protocol. Configuration is read from persistent storage.

    config MANAGER_WANO_PLUGIN_VLAN
        bool "WANO VLAN plugin"
        default y
        help
            WANO pppoe plug-in for VLAN interface configuration. The VLAN
            configuration is read from persistent storage.

    config MANAGER_WANO_PLUGIN_ETHCLIENT
        bool "WANO ethernet client detection plugin"
        default y
        help
            WANO plug-in for quick ethernet client-only port detection. This
            plug-in tries to detect clients that are directly connected to the
            ethernet port. If such case is found, all WAN plug-ins on the
            current interface are aborted.

    config MANAGER_WANO_PLUGIN_ETHCLIENT_DHCP_WAIT
        int "Ethernet client wait time in seconds"
        default 5
        depends on MANAGER_WANO_PLUGIN_ETHCLIENT
        help
            This is the timeout in seconds that the plug-in will wait after
            receiving the first DHCP discover packet from a client, after which
            it will consider that an ethernet client was successfully detected.
            If another DHCP message type is received or another client sends a
            DHCP discover message, the timer is aborted.

    config MANAGER_WANO_PLUGIN_ETHCLIENT_DHCP_NUM
        int "Ethernet client DISCOVER packet number"
        default 3
        depends on MANAGER_WANO_PLUGIN_ETHCLIENT
        help
            Number of DISCOVER type packets to be received from a single host
            after which the ethernet client is considered to be successfully
            detected.

            If another DHCP packet type is received, or another host sends any
            type of DHCP packet, this number is ignored.

    config MANAGER_WANO_PLUGIN_CMTS
        bool "WANO CMTS plugin"
        default n
        help
            WANO cmts plug-in for reporting configured link by the CMTS.

    config WANO_DNS_PROBE_RESOLV_CONF_PATH
        string "Location of the resolv.conf file"
        default "/tmp/resolv.conf"
        help
            Location of the resolv.conf file used by DNS probe.

endif
```

## src/wbm/kconfig/Kconfig.managers
```kconfig
menuconfig MANAGER_WBM
    bool "Wifi Blaster Manager (WBM)"
    default n
    help
        Enable Wifi Blaster Manager (WBM)

    config MANAGER_WBM_CFG
        string "WBM Startup configuration"
        depends on MANAGER_WBM
        default "wbm;true;needs_plan_b=false"
        help
            Wifi Blaster Manager startup configuration

   config PKTGEN_LIB_ENABLED
        depends on MANAGER_WBM
        bool "Pktgen configuration library"
        default y
        help
            Enable pktgen configuration library
```

## src/wm2/kconfig/Kconfig.managers
```kconfig
menuconfig MANAGER_WM
    bool "Wireless Manager (WM)"
    default y
    help
        Enable Wireless Manager (WM)

    config MANAGER_WM_CFG
        depends on MANAGER_WM
        string "WM Startup configuration"
        default "wm;true;needs_plan_b=true"
        help
            Wireless Manager startup configuration

    config MANAGER_WM_L2UF_KICK
        depends on MANAGER_WM
        bool "Enable processing L2UF for stale client kicks"
        default y
        help
            When clients roam between APs, they are not
            guaranteed to properly deauthenticate themselves
            from the old AP they are roaming away from. This
            is both due to bugs, or actually legit cases,
            like going out of range while in powersave.

            Most (if not all) wireless drivers have some
            countermeasures to purge stale links to
            stations - typically inactivity timers, or
            powersave out-of-sync detection.

            Some also implement an immediate purge when an
            L2UF packet is attempted to be transmitted on an
            interface with an SA matching an existing
            station on that BSS.

            Set to 'y' for platforms where drivers do not
            support this L2UF kickout behavior.

            It is safe to say 'y' even on platforms where
            drivers support it, at the expense of wasting
            a bit of CPU and memory to handle pcap captures.

            To test whether a platform supports it already,
            one can take two clients, set the same MAC address
            on both, and instruct them to connect to two
            different radios on the same OpenSync AP.
            They should eventually re-connect in a ping-pong
            fashion: one will cause the other to disconnect,
            and vice-versa.
```

## src/wpd/kconfig/Kconfig
```kconfig
menuconfig WPD_ENABLED
    bool "Enable WPD (Watchdog Proxy Daemon)"
    default y
    help
        Select to include WPD daemon in the image.

    if WPD_ENABLED

        config WPD_WATCHDOG_DEVICE
            string "Watchdog device"
            default "/dev/watchdog"

        config WPD_PING_TIMEOUT
            int "Ping timeout"
            default 60
            help
                Timeout after which WPD will setup watchdog device to trigger
                an immediate hardware reset, if in this time period WPD doesn't
                receive a ping from managers.

        config WPD_PING_INITIAL_TIMEOUT
            int "Initial ping timeout"
            default 80
            help
                First ping from managers must be received within this time period,
                otherwise WPD will setup watchdog device to trigger an immediate
                hardware reset.

        config WPD_WATCHDOG_TIMEOUT
            int "Watchdog timeout"
            default 30
            help
                WPD will setup watchdog device to trigger a hardware reset after
                this number of seconds, if WPD crashes and stops pinging the
                device.

        config WPD_PID_PATH
            string "Location of the WPD PID file"
            default "/var/run/wpd.pid"


    endif
```
