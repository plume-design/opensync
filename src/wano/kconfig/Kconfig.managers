## src/wano/kconfig/Kconfig.managers
```kconfig
menuconfig MANAGER_WANO
    bool "WAN Orchestrator (WANO)"
    default y
    help
        Enable WAN Orchestrator (WANO)

if MANAGER_WANO
    config MANAGER_WANO_CFG
        string "WANO Startup configuration"
        default "wano;true;needs_plan_b=true;max_memory=20000"
        help
            WAN Orchestrator startup configuration
            Optional crash backoff keys (;-separated key=value):
            crash_count_max, crash_count_period, crash_recovery.
            crash_count_max=0 disables. Ignored when needs_plan_b=true.

    config MANAGER_WANO_IFACE_LIST
        string "WANO Interface List"
        default "eth0"
        help
            Space separated interface list that will be used for WAN probing.

            Optionally an interface type can be specified by appending the
            ":type" string to the interface name. If the type is not specified,
            `eth` is assumed. Currently the only supported types are `eth` and
            `unmanaged`.

    config MANAGER_WANO_SUPPORT_EXP_BACKOFF_DHCP
        bool "Extend WANO plug-in timeouts for DHCP exponential backoff"
        default y if OSN_UDHCPC_RFC_2131_BACKOFF
        default n
        help
            Extend the WANO plug-in timeouts so that an RFC 2131 §4.1
            exponential DHCP DISCOVER backoff (4 -> 8 -> 16 -> 32 -> 64s) can
            run to completion before the DHCPv4 plug-in is torn down. Without
            this, the plug-in would be restarted long before the backoff curve
            finishes, defeating the purpose of the backoff.

            When enabled this raises:
              - MANAGER_WANO_PLUGIN_DHCP_TIMEOUT      25s  -> 127s
              - MANAGER_WANO_PLUGIN_IMMEDIATE_TIMEOUT 300s -> 86400s (24h)

            The immediate-timeout is raised to 24h (effectively disabling
            WANO's own pipeline backoff for the DHCP path). This is to keep the
            whole exponential period consistent.

            Only the DHCPv4 plug-in uses the longer timeout (also when it runs
            on a VLAN interface). All other plug-ins (PPPoE, static IPv4,
            DHCPv6) keep MANAGER_WANO_PLUGIN_TIMEOUT. A DHCPv4 probe that fails
            (e.g. on a VLAN without a DHCP server) still takes ~127s (instead
            of ~25s) before WANO moves on.

            Leave this off (default) unless the platform has a udhcpc patched
            for RFC 2131 backoff (see OSN_UDHCPC_RFC_2131_BACKOFF). It defaults
            on only when OSN_UDHCPC_RFC_2131_BACKOFF is enabled.

    config MANAGER_WANO_PLUGIN_TIMEOUT
        int "WAN plug-in link probing timeout"
        default 25
        help
            If the WAN plug-in probing doesn't reach a conclusion in the amount
            of time defined by this option, it is terminated and WANO moves to
            the next plug-in in the list.

            DHCP plug-ins use MANAGER_WANO_PLUGIN_DHCP_TIMEOUT instead.

    config MANAGER_WANO_PLUGIN_DHCP_TIMEOUT
        int "WAN DHCP plug-in link probing timeout"
        default 127 if MANAGER_WANO_SUPPORT_EXP_BACKOFF_DHCP
        default 25
        help
            Same as MANAGER_WANO_PLUGIN_TIMEOUT, but for the DHCPv4 plug-in
            only.

            The 127s value (used only when MANAGER_WANO_SUPPORT_EXP_BACKOFF_DHCP
            is set) covers the full RFC 2131 §4.1 DISCOVER backoff curve
            (4 + 8 + 16 + 32 + 64 = 124s), plus a few extra seconds of margin
            for jitter.

    config MANAGER_WANO_PLUGIN_IMMEDIATE_TIMEOUT
        int "WAN plug-in immediate timeout"
        default 86400 if MANAGER_WANO_SUPPORT_EXP_BACKOFF_DHCP
        default 300
        help
            This is the amount of time that the pipeline is allowed to do an
            immediate restart without using a backoff timer. After the amount of
            seconds defined in this variable, the pipeline will sleep for an
            increasing amout of time before restarting plug-ins.

    config MANAGER_WANO_PLUGIN_DHCPV4
        bool "WANO IPv4 DHCP plugin"
        default y
        help
            WANO DHCPv4 plug-in for interface configuration via the DHCPv4
            protocol.

    config MANAGER_WANO_PLUGIN_DHCPV6
        bool "WANO IPv6 DHCP plugin"
        default y
        help
            WANO DHCPv6 plug-in for interface configuration via the DHCPv6/RA
            protocol.

    config MANAGER_WANO_PLUGIN_STATIC_IPV4
        bool "WANO static IPv4 plugin"
        default y
        help
            Plugin configuring static IP address on WAN interfaces.
            Configuration parameters are read from "wanp" key-value OPS, here
            is the list of parameters:
            "static-ipv4-ip-addr" : The IP address (string)
            "static-ipv4-netmask" : The netmask (string)
            "static-ipv4-gateway" : The gateway (string)
            "static-ipv4-ping-addrs" : Addresses for ping (semicolon separated
                                       list)
    config MANAGER_WANO_PLUGIN_PPPOE
        bool "WANO pppoe plugin"
        default y
        help
            WANO pppoe plug-in for interface configuration via the pppoe
            protocol. Configuration is read from persistant storage.

    config MANAGER_WANO_PLUGIN_VLAN
        bool "WANO VLAN plugin"
        default y
        help
            WANO pppoe plug-in for VLAN interface configuration. The VLAN
            configuration is read from persistent storage.

    config MANAGER_WANO_PLUGIN_ETHCLIENT
        bool "WANO ethernet client detection plugin"
        default y
        help
            WANO plug-in for quick ethernet client-only port detection. This
            plug-in tries to detect clients that are directly connected to the
            ethernet port. If such case is found, all WAN plug-ins on the
            current interface are aborted.

    config MANAGER_WANO_PLUGIN_ETHCLIENT_DHCP_WAIT
        int "Ethernet client wait time in seconds"
        default 5
        depends on MANAGER_WANO_PLUGIN_ETHCLIENT
        help
            This is the timeout in seconds that the plug-in will wait after
            receiving the first DHCP discover packet from a client, after which
            it will consider that an ethernet client was successfully detected.
            If another DHCP message type is received or another client sends a
            DHCP discover message, the timer is aborted.

    config MANAGER_WANO_PLUGIN_ETHCLIENT_DHCP_NUM
        int "Ethernet client DISCOVER packet number"
        default 3
        depends on MANAGER_WANO_PLUGIN_ETHCLIENT
        help
            Number of DISCOVER type packets to be received from a single host
            after which the ethernet client is considered to be successfully
            detected.

            If another DHCP packet type is received, or another host sends any
            type of DHCP packet, this number is ignored.

    config MANAGER_WANO_PLUGIN_CMTS
        bool "WANO CMTS plugin"
        default n
        help
            WANO cmts plug-in for reporting configured link by the CMTS.

    config WANO_DNS_PROBE_RESOLV_CONF_PATH
        string "Location of the resolv.conf file"
        default "/tmp/resolv.conf"
        help
            Location of the resolv.conf file used by DNS probe.

endif
```
