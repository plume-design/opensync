## src/lib/osp/kconfig/Kconfig.osp_dl
```kconfig
if OSP_DL_CURL
    menu "cURL Options"
        config OSP_DL_CURL_RETRY
            int "Maximum number of download retries"
            default 3

            help
                The maximum number of times osp_dl_curl will retry to download
                an URL before giving up.

        config OSP_DL_CURL_PROGRESS_INTERVAL
            int "Progress interval"
            default 10

            help
                This is the number of seconds between progress reports.

                Use 0 to disable periodic progress reports.

        config OSP_DL_CURL_CERT_AUTHORITY_FILE
            string "Certificate authority file"
            default "$(INSTALL_PREFIX)/certs/auth.pem"
            help
                Path to the certificate authority file.

                This corresponds to the -ca curl option. Use an empty string to
                use system's default.

        config OSP_DL_CURL_ALLOW_UNTRUSTED_CONNECTIONS
            bool "Allow untrusted HTTPS connections"
            default n

            help
                This options enables insecure https connections to untrusted https
                servers (their identity could not be verified).

                This corresponds to the -k curl option.

        config OSP_DL_CURL_DETECT_STALLED
            bool "Detect stalled connections"
            default y

            help
                Detect if the connection has stalled and retry the download.

                This is roughly equivalent to the following curl options:
                    --connec-timeout 30 --speed-limit 128 --speed-time 30
    endmenu
endif
```

## src/lib/osp/kconfig/Kconfig.osp_dl.backend
```kconfig
config OSP_DL_NULL
    bool "Null"
    help
        This backend implements a dummy implementation of the osp_dl API. All
        functions in this implementation return an error.

config OSP_DL_CURL
    bool "cURL"
    help
        This backend provides a cURL based osp_DL API implementation.

        Note: cURL to be fully asynchronous must be compiled with c-ares
        support. Otherwise it will use the system resolver which may block on
        DNS queries.
```

## src/lib/osp/kconfig/Kconfig.osp_l2switch
```kconfig
if OSP_L2SWITCH_SWCONFIG
    comment "Swconfig Options"
    config OSP_L2SWITCH_SWCONFIG_DEVICE
        string "Swconfig Device"
        default "switch0"
        help
            The swconfig device, typically "switch0".

    config OSP_L2SWITCH_SWCONFIG_PORT_CPU
        int "Swconfig CPU Port Number"
        default 0
        help
            This option spceifies the switch CPU port number.

    config OSP_L2SWITCH_SWCONFIG_PORT_MAP
        string "Swconfig Interface Mapping"
        default "eth0=5 eth1=4"
        help
            This option defines mappings between interface names and switch
            port numbers.

            The format is a list of IF_NAME=PORT_NUMBER keywords separated by
            spaces.

    config OSP_L2SWITCH_SWCONFIG_VLAN0_WAR
        bool "Use custom ports string for VLAN0"
        default n
        help
            Some internal switches have issues handling VLAN 0. In such cases
            it is necessary to use an alternative (fixed) "ports" parameter for
            swconfig.

            Enable this option to specify a custom string.

    config OSP_L2SWITCH_SWCONFIG_VLAN0_PORTS
        string "VLAN0 ports string"
        default ""
        depends on OSP_L2SWITCH_SWCONFIG_VLAN0_WAR
        help
            Specify the "ports" string to be used with VLAN0.

endif
```

## src/lib/osp/kconfig/Kconfig.osp_l2switch.backend
```kconfig
config OSP_L2SWITCH_NULL
    bool "Null"

    help
        Use a dummy L2 switch implementation

config OSP_L2SWITCH_SWCONFIG
    bool "swconfig"

    help
        Use the swconfig tool for configuring the internal L2 switch
```

## src/lib/osp/kconfig/Kconfig.osp_l2uf
```kconfig
if OSP_L2UF_LIBPCAP
    comment "L2UF Options"
    config OSP_L2UF_LIBPACP_DEVICE
        string "L2UF Device"
        default "br-home.l2uf"
        help
            The interface name where we can sniff l2uf frames with pcap.

endif
```

## src/lib/osp/kconfig/Kconfig.osp_l2uf.backend
```kconfig
config OSP_L2UF_NULL
    bool "Null"

    help
        Use a dummy L2UF implementation

config OSP_L2UF_LIBPCAP
    bool "libpcap"

    help
        Use the libpcap l2uf implementation
```

## src/lib/osp/kconfig/Kconfig.osp_led
```kconfig
config OSP_LED
    bool "Enable support for OSP LED API"
    default n
    help
        Use the new OSP LED API
```

## src/lib/osp/kconfig/Kconfig.osp_objm.backend
```kconfig
config OSP_OBJM_OBJMFS
    bool "Object management on filesystem (OBJMFS)"
    select OBJMFS_ENABLED
    help
        Use the file system backend provided by the objmfs library
```

## src/lib/osp/kconfig/Kconfig.osp_otbr.backend
```kconfig
config OSP_OTBR_NULL
    bool "Null"
    help
        This backend implements a dummy implementation of the osp_otbr API.
        All functions in this implementation do nothing and return success.

config OSP_OTBR_CLI_LIB
    bool "OTBR Agent CLI library"
    select OTBR_CLI
    help
        This backend uses OpenThread Border Router Agent CLI library to
        run and control OTBR Agent using OpenThread CLI commands.
```

## src/lib/osp/kconfig/Kconfig.osp_pki
```kconfig
if OSP_PKI_PS
    menu "PKI Persistent Storage Options"
        choice
            prompt "Public Key Algorithm"
            help
                Default algorithm used for public/private key generation

            config OSP_PKI_PS_ALGO_P384
                bool "NIST P-384"
                help
                    P-384 NIST curve

            config OSP_PKI_PS_ALGO_P256
                bool "NIST P-256"
                help
                    P-256 NIST curve

            config OSP_PKI_PS_ALGO_ED25519
                bool "ED25519"
                help
                    Edwards 25519 elliptic curve

            config OSP_PKI_PS_ALGO_RSA4096
                bool "RSA 4096"
                help
                    RSA 4096 bits

            config OSP_PKI_PS_ALGO_RSA3072
                bool "RSA 3072"
                help
                    RSA 3072 bits
         endchoice
    endmenu
endif
```

## src/lib/osp/kconfig/Kconfig.osp_pki.backend
```kconfig
config OSP_PKI_PS
    bool "OpenSync Encrypted Persistent Storage"
    help
        Use OpenSync Encrypted persistent storage for certificate safekeeping.
```

## src/lib/osp/kconfig/Kconfig.osp_power.backend
```kconfig
menuconfig OSP_POWER
    bool "OSP Power"
    default n
    help
        Select to enable OSP Power APIs.

        OSP Power APIs give useful information
        about power suplly types and its parameters.
```

## src/lib/osp/kconfig/Kconfig.osp_ps.backend
```kconfig
config OSP_PS_PSFS
    bool "Filesystem (PSFS)"
    select PSFS_ENABLED
    help
        Use the file system backend provided by the psfs library
```

## src/lib/osp/kconfig/Kconfig.osp_reboot
```kconfig
#
# OSP_PS_REBOOT_PSTORE options
#
config OSP_REBOOT_PSTORE_DEV
    string "PSTORE logging device"
    default "/dev/pmsg0"
    help
        The PSTORE logging device, typically /dev/pmsg0. This character device
        is used for recording the reboot reason into PSTORE memory.

config OSP_REBOOT_PSTORE_FS
    string "Mount point of the PSTORE filesystem"
    default "/sys/fs/pstore"
    help
        Mount point of the PSTORE filesystem. The filesystem must be mounted
        by some sort of start-up script before the PSTORE backend code can
        properly detect the reboot reason
```

## src/lib/osp/kconfig/Kconfig.osp_reboot.backend
```kconfig
config OSP_REBOOT_PSTORE
    bool "PSTORE backend"
    help
        Use PSTORE for recording reboot count/reasons
        Also, use the PSTORE system to figure out exceptional reboot events
        such as kernel crashes and watchdog timeouts.
```

## src/lib/osp/kconfig/Kconfig.osp_sec
```kconfig
# Add sec_openssl options
#

if OSP_SEC_OPENSSL
    menu "OpenSSL Backend Options"
        choice
            prompt "Key Generation"
            default OSP_SEC_KEY_DEFAULT
            source "src/lib/osp/kconfig/Kconfig.osp_sec.backend.key"
	    
            osource "vendor/*/kconfig/Kconfig.osp_sec.backend.key"
            osource "platform/*/kconfig/Kconfig.osp_sec.backend.key"
        endchoice
    endmenu

endif
```

## src/lib/osp/kconfig/Kconfig.osp_sec.backend
```kconfig
config OSP_SEC_OPENSSL
    bool "OpenSSL"
    help
        This backend provides an OpenSSL based osp_sec API implementation.
```

## src/lib/osp/kconfig/Kconfig.osp_sec.backend.key
```kconfig
config OSP_SEC_KEY_DEFAULT
    bool "Reference Rudimentary Key Generation"
    help
        Provides a rudimentary reference implementation of key generation 
        using some device ID and OpenSSL. You are strongly encouraged to
        provide your own private implementation of key generation. 
```

## src/lib/osp/kconfig/Kconfig.osp_tm
```kconfig
config OSP_TM_TEMP_SRC_MAX
    int "Maximum number of temperature sources"
    default 3
    help
        Represents the maximum number of sources used for reading
        the temperature on different components of the device. Used
        to determine the size of the thermal table the TM module.

config OSP_TM_TEMP_AVG_CNT
    int "Temperature averaging window size"
    default 3
    help
        Measure running average of temperature over this number of temperature
        samples. This is a compromise between a low number of samples to react to
        fast rising temperature, and a high number of samples to react to bad
        temperature readings.
```

## src/lib/osp/kconfig/Kconfig.osp_tm_sensors.backend
```kconfig
config OSP_TM_SENSORS_NULL
    bool "Null"
    help
        This backend implements a dummy implementation of the tm_sensors API.
        All functions in this implementation do nothing and return false so
        that the on-chip sensors are used by default.
```

## src/lib/osp/kconfig/Kconfig.osp_unit.backend
```kconfig
config OSP_UNIT_DEFAULT
    bool "Default"

    help
        Use a default implementation of OSP Unit API
```

## src/lib/osp/kconfig/Kconfig.osp_upg
```kconfig
if OSP_UPG_GEN
    menu "Generic upgrade options"
        config OSP_UPG_GEN_DIR
            string "Download folder"
            default "/tmp/firmware"
            help
                Folder that will be used for downloading the upgrade image and
                other upgrade related files.

        config OSP_UPG_GEN_FREE_SPACE
            int "Minimum free space (kB)"
            default 0
            help
                Minimum free space required for upgrade.

                The filesystem on which the download directory is located must
                have at least this number of free kilobytes in order to pass
                the pre-upgrade checks.

                Use 0 to disable.

        config OSP_UPG_GEN_UPGRADE_SCRIPT
            string "Upgrade script"
            default "safeupdate ${2:+ -P \"$2\"} -w \"$1\""
            help
                This option defines the script that will be executed for the
                system upgrade. The string must contain a valid shell expression.
                The script executed with the following parameters:

                    - $1 - the path to the downloaded firmware image
                    - $2 - (optional) the decryption password

                The return value of the script must be an integer corresponding
                to the error codes defined in `osp_upg.h`.

        config OSP_UPG_GEN_CHECKSYSTEM_SCRIPT
            string "System check script"
            default "exit 0"
            help
                This script is executed before the upgrade in order to verify
                the system readiness in terms of upgrade.

                The string must be a correct shell expression.

                The return value of the script must be an integer corresponding
                to the error codes defined in `osp_upg.h`.

        config OSP_UPG_GEN_COMMIT_SCRIPT
            string "Commit script"
            default "exit 0"

            help
                This script is executed after the upgrade. It is typically used
                to activate the inactive (freshly upgraded) partition.

                The string must be a correct shell expression.

                The return value of the script must be an integer corresponding
                to the error codes defined in `osp_upg.h`.

        choice
            prompt "File integrity verification"
            default OSP_UPG_CRC_MD5
            help
                The algorithm is used for file integrity verification.

            config OSP_UPG_CRC_NONE
                bool "None"
                help
                    None -- do not perform any MD5 checksum verification.

            config OSP_UPG_CRC_MD5
                bool "OpenSSL MD5"
                help
                    Use OpenSSL's implementation of the MD5 algorithm to verify
                    the image integrity.
        endchoice
    endmenu
endif
```

## src/lib/osp/kconfig/Kconfig.osp_upg.backend
```kconfig
config OSP_UPG_NULL
    bool "Null"
    help
        Null osp_upg backend. All functions in this implementation return an
        error.

config OSP_UPG_GEN
    bool "Generic"
    help
        Generic upgrade backend. This backend uses various scripts to implement
        system upgrade.

        Three scripts must be provided in order for the upgrade backend to be
        functional:
            - a system check script (OSP_UPG_GEN_CHECKSYSTEM_SCRIPT)
            - an upgrade script (OSP_UPG_GEN_UPGRADE_SCRIPT)
            - a commit script (OSP_UPG_GEN_COMMIT_SCRIPT)

        All scripts are defined via Kconfig.
```
