## src/lib/osn/kconfig/Kconfig.osn
```kconfig
menuconfig OSN_LINUX_ENABLED
    bool "Generic Linux Implementation"
    default y
    help
        Provide a generic Linux implementation of the OSN API. This includes:
            - Linux L2 interface support (via ioctl())
            - IPv4 support (via iproute2)
            - IPv6 support (via iproute2)
            - DHCPv4 server support (via dnsmasq)
            - DHCPv4 client support (via udhcpc)
            - DHCPv6 server support (via dnsmasq)
            - DHCPv6 client support (via odhcp6c)
            - Router Advertisement support (via dnsmasq)
            - UPnP support (via miniupnpd)
            - PPPoE support (via pppd)
            - VLAN support (via iproute2)
            - QoS support (via tc)
            - LTE support (via quectel)
            - IPsec support (via strongSwan)
            - Packet Classifier support (via tc)
            - Policy Routing support (via iproute2)

if OSN_LINUX_ENABLED
    config OSN_LINUX_NETIF
        bool "Linux L2 interface control"
        default y
        select OSN_LINUX_NETLINK
        help
            OpenSync L2 interface control implementation (generic Linux)

            This option implements the lnx_netif API and enables the
            "Linux L2 control" backend (osn_netif).

    config OSN_LINUX_IP
        bool "Linux IPv4"
        default y
        select OSN_LINUX_NETLINK
        help
            OpenSync IPv4 implementation (generic Linux)

            This option implements the lnx_ip API and enables the
            "Linux IPv4" backend (osn_ip).

    config OSN_LINUX_IPV6
        bool "Linux IPv6"
        default y
        select OSN_LINUX_NETLINK
        help
            OpenSync IPv6 implementation (generic Linux)

            This option implements the lnx_ip6 API and enables the
            "Linux IPv6" backend (osn_ip6).

    config OSN_SKIP_ACCEL
        string
        default "SKIPLOG" if PLATFORM_IS_BCM
        default "skipaccel"
        help
            OpenSync SKIP-ACCEL mechanism using xtables

            The set value if provided to NFM so that it never
            tries to create a chain with the given name. This
            can prevent unnecessary error messages when targets
            with the same name are available on the system (e.g.,
            `SKIPLOG` or `skipaccel`).

    menuconfig OSN_UDHCPC
        bool "udhcp DHCPv4 client"
        default y
        help
            OpenSync DHCPv4 client implementation using the busybox udhcpc

            This option implements the udhcp_client API and enables the
            "udhcp client" DHCPv4 client backend (osn_dhcp_client).

        if OSN_UDHCPC
            config OSN_UDHCPC_PATH
                string "Path to the udhcpc binary"
                default "/sbin/udhcpc"
                help
                    Full path to the udhcpc binary.
        endif

    menuconfig OSN_DNSMASQ
        bool "dnsmasq DHCPv4 server"
        default y
        help
            OpenSync DHCPv4 server implementation using dnsmasq

            This option exports the dnsmasq_server API and enables
            the "dnsmasq" DHCPv4 server backend (osn_dhcp_server).

        if OSN_DNSMASQ
            config OSN_DNSMASQ_PATH
                string "Path to the dnsmasq binary"
                default "/usr/sbin/dnsmasq"
                help
                    Full path to the dnsmasq binary

            config OSN_DNSMASQ_ETC_PATH
                string "dnsmasq configuration file path"
                default "/var/etc/dnsmasq.conf"
                help
                    This is the path where the dnsmasq configuration file
                    will be generated.

            config OSN_DNSMASQ_LEASE_PATH
                string "Location of the DHCP lease file"
                default "/tmp/dhcp.leases"
                help
                    Location of the "leases" file. This is the dnsmasq
                    DHCP lease database.

            config OSN_DNSMASQ_PID_PATH
                string "Location of the dnsmasq PID file"
                default "/var/run/dnsmasq/dnsmasq.pid"
                help
                    Location of the dnsmasq PID file.

            config OSN_DNSMASQ_KEEP_RUNNING
                bool 'Daemon should be always running'
                help
                    The default behavior is to kill dnsmasq as soon as there are
                    0 DHCP server configurations active. This option forces dnsmasq
                    to be active regardless of the DHCP server configuration.

                    This is useful on systems where dnsmasq is used as a DNS cache.

            config OSN_DNSMASQ_PORT
                string "dnsmasq port"
                default "53"
                help
                   Specify port to listen for DNS requests on (defaults to 53). Setting
                   this to 0 disables DNS function, leaving only DHCP and/or TFTP.

            config OSN_DNSMASQ_RESOLV_CONF_PATH
                string "Location of the resolv.conf file"
                default "/tmp/resolv.conf"
                help
                    Location of the resolv.conf file.

            config OSN_DNSMASQ_USER
                string "dnsmasq user"
                default "nobody"
                help
                   Change to this user after startup. (defaults to nobody).
        endif

    menuconfig OSN_ODHCP6
        bool "odhcp6 DHCPv6 and RA client"
        default y
        help
            OpenSync DHCPv6/RA client implementation using odhcp6c

            This option implements the odhcp6_client API and enables the
            "odhcp6 client" DHCPv6 client backend (osn_dhcpv6_client).

        if OSN_ODHCP6
            config OSN_ODHCP6_PATH
                string "Path to the odhcp6 binary"
                default "/usr/sbin/odhcp6c"
                help
                    Full path to the odhcp6c binary.

            config OSN_ODHCP6_SCRIPT_PATH
                string "Path to the odhcp6 script"
                default "$(INSTALL_PREFIX)/bin/odhcp6c.sh"

            config OSN_ODHCP6_OPTS_FILE
                string "Path to the option file"
                default "/var/run/odhcp6c_%s.opts"
                help
                    Note: %s will be replaced with the interface name.

            config OSN_ODHCP6_PID_FILE
                string "Path to the PID file"
                default "/var/run/odhcp6c_%s.pid"
                help
                    Note: %s will be replaced with the interface name.

            config OSN_ODHCP6_MODE_PREFIX_NO_ADDRESS
                string "Prefix-no-address mode"
                default "RAND_ADDRESS"

                help
                    Configure the behavior when a prefix through DHCPv6-PD is
                    received, but no IA_NA received, to help with connectivity.

                    Defined configuration options are:
                      - "NONE": No special logic for this case.
                      - "RAND_ADDRESS": Generate a random /128 address from the
                        prefix and assign it to the interface.
                      - "IP_UNNUMBERED": Generate a ::1/64 address from the prefix and
                        assign it to the LAN interface.

                        IP unnumbered is a technique where a network interface can use an
                        IP address without configuring a unique IP address on that interface.
                        Instead, the interface borrows the IP address from another interface.
        endif

    menuconfig OSN_DNSMASQ6
        bool "dnsmasq DHCPv6 and RA server"
        default y
        help
            OpenSync DHCPv6/RA server implementation using dnsmasq

            This option exports the dnsmasq6_server and dnsmasq6_radv APIs and
            enables the "dnsmasq6" DHCPv6 and RA server backends
            (osn_dhcpv6_server, osn_ip_radv).

        if OSN_DNSMASQ6
            config OSN_DNSMASQ6_PATH
                string "Path to the dnsmasq binary"
                default "/usr/sbin/dnsmasq"
                help
                    Full path to the dnsmasq binary

            config OSN_DNSMASQ6_ETC_PATH
                string "dnsmasq configuration file path"
                default "/var/etc/dnsmasq6.conf"
                help
                    This is the path where the dnsmasq configuration file
                    will be generated.

            config OSN_DNSMASQ6_LEASE_PATH
                string "Location of the DHCPv6 lease file"
                default "/tmp/dhcp6.leases"
                help
                    Location of the "leases" file. This is the dnsmasq
                    DHCP lease database.

            config OSN_DNSMASQ6_PID_PATH
                string "Location of the dnsmasq6 PID file"
                default "/var/run/dnsmasq/dnsmasq6.pid"
                help
                    Location of the dnsmasq PID file.

            config OSN_DNSMASQ6_PORT
                string "dnsmasq port"
                default "0"
                help
                   Specify port to listen for DNS requests on (defaults to 0). Setting
                   this to 0 disables DNS function, leaving only DHCP and/or TFTP.

            config OSN_DNSMASQ6_USER
                string "dnsmasq user"
                default "nobody"
                help
                   Change to this user after startup. (defaults to nobody).
        endif

    menuconfig OSN_MINIUPNPD
        bool "miniupnpd UPnP server"
        default y
        help
            OpenSync UPnP server implementation using miniupnpd.

            This option implements the mupnp_server API and enables the
            "miniupnp" UPnP backend (osn_upnp).

        if OSN_MINIUPNPD
            config OSN_MINIUPNPD_PATH
                string "Path to the miniupnpd binary"
                default "/usr/sbin/miniupnpd"
                help
                    Full path to the miniupnpd binary

            config OSN_MINIUPNPD_ETC
                string "miniupnpd configuration folder"
                default "/tmp/miniupnpd"
                help
                    This is the location where the miniupnpd.conf and upnpd.lease
                    files will be created.
        endif

    menuconfig OSN_LINUX_PPPOE
        bool "Linux pppd PPPoE support"
        default y
        help
            PPPoE support using the pppd daemon and the rp-pppoe plug-in.
            pppd version that supports the "ifname" config option is required.

        config OSN_LINUX_PPPOE_BIN
            depends on OSN_LINUX_PPPOE
            string "Path to the pppd binary"
            default "/usr/sbin/pppd"
            help
                Path to the pppd binary.

        config OSN_LINUX_PPPOE_ETC_DIR
            depends on OSN_LINUX_PPPOE
            string "Path to the pppd configuration directory"
            default "/tmp/ppp"
            help
                Path to the pppd configuration folder. This folder will be used
                to generate the pap-secrets, chap-secrets files and entries in
                peers sub-folder.

        config OSN_LINUX_PPPOE_ETC_SYMLINKS
            depends on OSN_LINUX_PPPOE
            bool "Create symlinks in /etc/ppp"
            default y
            help
                pppd has no options for changing the path of various
                configuration files. This problem is solved by installing
                symlinks in /etc/ppp which point to the actual configuration
                files (in /tmp/ppp). However some platforms patch pppd to provide
                alternative paths. In such cases it is not necessary to use
                symlinks.

                This options affects only the generation of rootfs.

    config OSN_LINUX_VLAN
        bool "Linux VLAN interface support"
        default y
        help
            VLAN support uses the iproute2 package to create VLAN interfaces

    config OSN_LINUX_QOS
        bool "Linux QoS"
        default y
        help
            QoS management via the tc/qdisc framework. This option implements
            the lnx_qos API and enables the "Linux" QoS backend (osn_qos).

    menuconfig OSN_ADAPTIVE_QOS_CAKE_AUTORATE
        bool "OpenSync Adaptive QoS support with cake-autorate"
        default n
        help
            OpenSync Adaptive QoS support with cake-autorate

        if OSN_ADAPTIVE_QOS_CAKE_AUTORATE
            config OSN_ADAPTIVE_QOS_CAKE_AUTORATE_PATH
            string "cake-autorate script path"
            default "/opt/cake-autorate/cake-autorate.sh"
            help
                Full path to cake-autorate script

            config OSN_ADAPTIVE_QOS_CAKE_AUTORATE_CONFIG
            string "cake-autorate configuration file"
            default "/opt/cake-autorate/config.primary.sh"
            help
                Full path to cake-autorate configuration file
        endif

    config OSN_LINUX_QDISC
        bool "Linux qdisc QoS"
        default y
        help
            Generic Linux qdisc-based QoS via the tc/qdisc framework. This option implements
            the lnx_qdisc API and enables the generic "Linux" qdisc-based backend (osn_qdisc).

    config OSN_LINUX_TC
        bool "Linux Packet Classifier"
        default y
        help
            Linux TC support which helps mirror or redirect traffic from both
            ingress and egress qdiscs to tap interfaces.

    config OSN_LINUX_BRIDGING
        bool "Linux Bridging"
        default y
        help
            Native Bridge implementation using Linux brctl commands.  This option implements
            lnx_bridge API using "brctl" commands to create and manage linux bridges.

    config OSN_LINUX_TAPIF
        bool "Linux TAP Interface Support"
        default y
        help
            Provide support for TAP interface type.  This option implements lnx_tap API
            and "Linux TAP Interface Support" backend (osn_tap).

    config OSN_LINUX_ROUTE
        bool "Linux routing table"
        default y
        select OSN_LINUX_NETLINK
        help
            Route notification using Linux interfaces:
                - /proc/net/route
                - NETLINK sockets

            This option implements the lnx_route API and enables the "Linux"
            route status backend (osn_route).

    choice
        prompt "Route Configuration Backend"
        default OSN_LINUX_ROUTE_LIBNL3

        config OSN_LINUX_ROUTE_LIBNL3
            bool "libnl3"
            help
                Route management using netlink library (libnl3)

                This option implements the osn_routes API and enables netlink based
                "Linux" route control backend (osn_route).

        config OSN_LINUX_ROUTE_IP
            bool "ip route"
            help
                Route management using the `ip route` command

                This option implements the osn_routes API and enables ip-route command
                based "Linux" route control backend (osn_route).
    endchoice

    choice
        prompt "Route State Backend"
        default OSN_LINUX_ROUTE_STATE_LIBNL3

        config OSN_LINUX_ROUTE_STATE_LIBNL3
            bool "libnl3"
            help
                Route state polling using netlink library (libnl3)

                This option implements the osn_route_state API and enables netlink/libnl3 based
                "Linux" route state polling.

                This implementation is able to:
                - Report routes from non-main routing tables.
                - Report other route attributes (such as preferred source IP address, etc).

                Polling via netlink should also provide better performance then other methods.

                libnl3 library must be available on the system.

        config OSN_LINUX_ROUTE_STATE_PROC
            bool "proc"
            help
                Route state polling by parsing /proc/net/route

                This option implements the osn_route_state API and enables polling
                of routes states by parsing /proc/net/route

                 Note: /proc/net/route is generally supported on any Linux system, but
                 it has limitations:
                     - Reports only routes from the main routing table.
                     - No other route attributes such as the preferred source address reported.
    endchoice

    config OSN_LINUX_ROUTE6
        bool "Linux IPv6 routing table"
        default y
        select OSN_LINUX_NETLINK
        help
            This option implements the lnx_route API and enables the "Linux"
            route status backend (osn_route).

    if OSN_LINUX_ROUTE6
        choice
            prompt "IPv6 Route Configuration Backend"
            default OSN_LINUX_ROUTE6_LIBNL3

            config OSN_LINUX_ROUTE6_LIBNL3
                bool "libnl3"
                help
                    Route management using netlink library (libnl3)

                    This option implements the osn_routes API and enables netlink based
                    "Linux" route control backend (osn_route).
        endchoice

        choice
            prompt "IPv6 Route State Backend"
            default OSN_LINUX_ROUTE6_STATE_LIBNL3

            config OSN_LINUX_ROUTE6_STATE_LIBNL3
                bool "libnl3"
                help
                    Route state polling using netlink library (libnl3)

                    This option implements the osn_route_state API and enables netlink/libnl3 based
                    "Linux" route state polling.

                    This implementation is able to:
                    - Report routes from non-main routing tables.
                    - Report other route attributes (such as preferred source IP address, etc).

                    libnl3 library must be available on the system.
        endchoice
    endif

    config OSN_LINUX_LTE
        bool "Linux LTE support"
        default y
        help
            LTE support using the quectel daemon and AT modem commands.

    menuconfig OSN_LINUX_NETLINK
        bool "Netlink socket support"
        default y
        help
            Support for NETLINK sockets.

        if OSN_LINUX_NETLINK
            config OSN_NETLINK_DEBOUNCE_MS
                int "Netlink event debouncing interval"
                default 300
                help
                    Delay processing of netlink events for this amount in milliseconds.

                    Netlink events may come in bursts. Delaying and aggregating them may
                    yield some performance boost.
        endif

    config OSN_LINUX_DEFAULT_ROUTES_VIA_NM
        bool "Handle default routes via Network Manager"
        default n
        help
            Install default routes via the Wifi_Route_Config table.

            This option enables the default routes to be handled by NM. This is
            required for LTE switchover and other functionalities that may
            require to change the route metrics dynamically.

            This affects submodules such as Static IPv4, DHCPv4 and PPPoE
            clients.

    config OSN_LINUX_IGMP
        bool "Linux IGMP configuration support"
        default y
        help
            IGMP support uses OVS to configure IGMP

    config OSN_LINUX_MLD
        bool "Linux MLD configuration support"
        default y
        help
            MLD support uses OVS to configure MLD

    menuconfig OSN_VPN
        bool "OpenSync Virtual Private Networks support"
        default y
        help
            OpenSync Virtual Private Networks support

        if OSN_VPN
            config OSN_VPN_IPSEC
            bool "OpenSync IPsec VPN support"
            default n
            help
                OpenSync IPsec VPN support

           if OSN_VPN_IPSEC
               config OSN_IPSEC_CONF_FILE_PATH
                   string "Path to the ipsec.conf file"
                   default "/etc/ipsec.conf"
                   help
                       Full path to the ipsec.conf file used by strongSwan

               config OSN_IPSEC_SECRETS_FILE_PATH
                   string "Path to the ipsec.secrets file"
                   default "/etc/ipsec.secrets"
                   help
                       Full path to the ipsec.secrets file used by strongSwan

               config OSN_IPSEC_CHARON_CONF_FILE_PATH
                   string "Path to the charon.conf file"
                   default "/etc/strongswan.d/charon.conf"
                   help
                       Full path to the charon.conf file used by strongSwan

               config OSN_IPSEC_RESOLVE_CONF_FILE_PATH
                   string "Path to the resolve.conf file"
                   default "/etc/strongswan.d/charon/resolve.conf"
                   help
                       Full path to the strongSwan resolve plugin configuration file.

               config OSN_IPSEC_BIN_PATH
                   string "Path to the strongSwan ipsec script"
                   default "/sbin/ipsec"
                   help
                       Full path to the strongSwan ipsec script

               config OSN_IPSEC_STARTER_PATH
                   string "Path to the strongSwan starter binary"
                   default "/libexec/ipsec/starter"
                   help
                       Full path to the strongSwan ipsec starter binary

               config OSN_IPSEC_DAEMON_PID_PATH
                   string "Path to the strongSwan daemon pid file"
                   default "/var/run/starter.charon.pid"
                   help
                       Full path to the strongSwan daemon (starter/charon) pid file path.
                       This is necessary to terminate any stale instances of the
                       strongSwan daemon(s), for instance after a restart. This
                       would typically need to be set to the starter pid path as
                       terminating starter would terminate charon daemon as well.

               config OSN_IPSEC_TMPFS_CONF_FILE_PATH
                   string "Temporary ipsec.conf file path"
                   default "/var/etc/ipsec.conf"
                   help
                       Full path to the ipsec.conf file in tmpfs written to by OpenSync

               config OSN_IPSEC_TMPFS_SECRETS_FILE_PATH
                   string "Temporary ipsec.secrets file path"
                   default "/var/etc/ipsec.secrets"
                   help
                       Full path to the ipsec.secrets file in tmpfs written to by OpenSync

               config OSN_IPSEC_TMPFS_CHARON_CONF_FILE_PATH
                   string "Temporary charon.conf file path"
                   default "/var/etc/strongswan.d/charon.conf"
                   help
                       Full path to the charon.conf file in tmpfs written to by OpenSync

               config OSN_IPSEC_TMPFS_RESOLVE_CONF_FILE_PATH
                   string "Temporary resolve.conf file path"
                   default "/var/etc/strongswan.d/charon/resolve.conf"
                   help
                       Full path to the resolve.conf file in tmpfs written to by OpenSync

               config OSN_IPSEC_TMPFS_STATUS_DIR
                   string "OpenSync ipsec status directory"
                   default "/var/run/ipsec"
                   help
                       Full path to the OpenSync ipsec status directory in tmpfs.
                       This path is written to by OpenSync updown script and
                       read by OpenSync IPsec OSN layer.

               config OSN_IPSEC_DISABLE_POLICY_IFACE_LIST
                   string "System interfaces for which to disable IPsec policy"
                   default ""
                   help
                       A list of system interfaces for which to disable IPsec policy
                       via /proc/sys interface. This may be needed on some platforms
                       for route-based IPsec configurations to function properly or
                       optimally.

               config OSN_IPSEC_SUPPORTED_CIPHERS_ENC
                   string "Supported encryption algorithm list"
                   default "aes256,aes192,aes128,3des"
                   help
                       A comma-separated list of supported encryption algorithms.
                       OpenSync will allow configuring a subset of these.
                       The possible values are as defined in the OVSDB schema for
                       IPSec_Config. The order may be important for IPsec implementations
                       and configurations where it is possible to configure more then
                       one algorithm in a proposal and where the order is taken into account.
                       The suggested order is strongest ciphers first.
                       A target may override this list with a smaller subset.

               config OSN_IPSEC_SUPPORTED_CIPHERS_AUTH
                   string "Supported authentication algorithm list"
                   default "sha256,sha1,md5"
                   help
                       A comma-separated list of supported authentication algorithms.
                       OpenSync will allow configuring a subset of these.
                       The possible values are as defined in the OVSDB schema for
                       IPSec_Config. The order may be important for IPsec implementations
                       and configurations where it is possible to configure more then
                       one algorithm in a proposal and where the order is taken into account.
                       The suggested order is strongest ciphers first.
                       A target may override this list with a smaller subset.

               config OSN_IPSEC_SUPPORTED_CIPHERS_DH
                   string "Supported Diffie-Hellman groups list"
                   default "14,5,2,1"
                   help
                       A comma-separated list of supported Diffie-Hellman groups.
                       OpenSync will allow configuring a subset of these.
                       The possible values are as defined in the OVSDB schema for
                       IPSec_Config. The order may be important for IPsec implementations
                       and configurations where it is possible to configure more then
                       one algorithm in a proposal and where the order is taken into account.
                       The suggested order is strongest ciphers first.
                       A target may override this list with a smaller subset.

           endif
        endif

        config OSN_LINUX_TUNNEL_IFACE
            bool "Linux tunnel interface support"
            default y
            help
                Linux tunnel interface support

           if OSN_LINUX_TUNNEL_IFACE

               config OSN_TUNNEL_IFACE_ROUTE_BASED_TWEAKS
               bool "Tunnel interface route-based tweaks"
               default y
               help
                   Apply a few /proc/sys settings to tunnel interfaces created
                   that may be needed for route-based tunnels to function
                   properly or optimally.

           endif

        config OSN_LINUX_ROUTE_RULE
            bool "Linux policy routing rules support"
            default y
            help
                Linux policy routing rules support

            choice
                prompt "Route Rule Configuration Backend"
                default OSN_LINUX_ROUTE_RULE_IP

                config OSN_LINUX_ROUTE_RULE_IP
                    bool "ip rule"
                    help
                        Route rules management using the `ip rule` command

                        This option implements the osn_route_rule API and enables ip-rule command
                        based "Linux" policy route rules control backend (osn_route_rule).
            endchoice

    choice
        prompt "MAP-T Backend"
        default OSN_LINUX_MAPT_NAT46

        config OSN_LINUX_MAPT_NAT46
            bool "nat46"
            help
                Use the Generic stateless NAT46 kernel module for Linux (nat46)

                https://github.com/ayourtch/nat46/tree/master/nat46/modules

        config OSN_LINUX_MAPT_NULL
            bool "null"
            help
                Use the NULL dummy MAP-T implementation

    endchoice

    choice
        prompt "MAP-E Backend"
        default OSN_LINUX_MAPE_IP6TNL

        config OSN_LINUX_MAPE_IP6TNL
            bool "ip6tnl"
            help
                Use the MAP-E backend implementation using ip6tnl

        config OSN_LINUX_MAPE_NULL
            bool "null"
            help
                Use the NULL dummy MAP-E implementation.
                This option can also be chosen in cases where MAP-E ip6tnl interfaces are to
                be configured by the controller via Tunnel_Interfaces OVSDB API
                (Note, however, that Tunnel_Interface APIs may not support all the
                MAP-E features, such as FMR rules)

    endchoice

endif
```
