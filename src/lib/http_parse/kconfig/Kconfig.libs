## src/lib/inet/kconfig/Kconfig.libs
```kconfig
menu "libinet Configuration"
    config INET_ETH_LINUX
        bool "Linux Ethernet interfaces"
        default y
        help
            Select to include generic Linux ethernet interface support.

            Applicable to most Linux platforms. If not selected, the
            platform/device specific code should provide its own implementation.

            This option implements the inet_eth_t class.

    config INET_VIF_LINUX
        bool "Linux VIF interfaces"
        depends on INET_ETH_LINUX
        default y
        help
            Select to include generic Linux VIF interface support.

            Applicable to most Linux platforms. If not selected, the
            platform/device specific code should provide its own implementation.

            This option implements the inet_vif_t class.

    config INET_GRETAP
        bool "Linux GRETAP interfaces"
        depends on INET_ETH_LINUX
        default y
        help
            Select to include generic Linux GRETAP interface support.

            Applicable to most Linux platforms. If not selected, the
            platform/device specific code should provide its own implementation.

            This option implements the inet_gretap_t class.

    config INET_GRE_USE_GRETAP
        bool "Use GRETAP as default GRE protocol implementation"
        depends on INET_GRETAP
        default y
        help
            Use the inet_gretap_t class as the default GRE implementation.
            This option defines a inet_gre_new() function which instantiates
            a class of type inet_gretap_t. If not selected, the platform/device
            specific code should define inet_gre_new() function which returns a
            suitable interface object that implements a tunneling protocol.

    menuconfig INET_FW_ENABLED
        bool "Firewall"
        default y
        help
            Use Firewall implementation provided by INET. Available modules are: Null, Iptables

            This option implements the inet_fw_t class.

        if INET_FW_ENABLED
            comment "INET firewall configuration"
            choice
                prompt "Firewall implementation"
                default INET_FW_IPTABLES if OPENSYNC_LEGACY_FIREWALL
                default INET_FW_NFM if OPENSYNC_NFM_FIREWALL

                config INET_FW_NULL
                    bool "Null"
                    help
                        Use the dummy firewall implementation. Use this on platforms
                        that do not have firewall functionality or firewall is not
                        under OpenSync control.

                config INET_FW_IPTABLES
                    bool "iptables"
                    depends on OPENSYNC_LEGACY_FIREWALL
                    help
                        Use the generic Linux iptables firewall implementation.

                config INET_FW_NFM
                    bool "Netfilter Manager"
                    depends on OPENSYNC_NFM_FIREWALL
                    help
                        Use NFM for firewall management. With this option enabled,
                        libinet will use the Netfilter table to manage NAT/LAN and
                        port forwarding firewall rules. NFM should be enabled in
                        order to apply rules from the Netfilter table to the system.
            endchoice

            if INET_FW_IPTABLES
                comment "INET iptables configuration"
                config INET_FW_IPTABLES_PATH
                    string '"iptables" binary path'
                    default "/usr/sbin/iptables"
                    help
                        Full path to the iptables binary

                config INET_FW_IP6TABLES_PATH
                    string '"ip6tables" binary path'
                    default "/usr/sbin/ip6tables"
                    help
                        Full path to the ip6tables binary
            endif
        endif

    menuconfig INET_DNS_ENABLED
        bool "DNS resolver"
        default y
        help
            Use DNS resolver implementation provided by INET.

            This option implements the inet_dns_t class.

        if INET_DNS_ENABLED
            comment "INET DNS resolver configuration"
            choice
                prompt "DNS resolver implementation"
                default INET_DNS_NULL

                config INET_DNS_NULL
                    bool "Null"
                    help
                        Dummy DNS resolver implementation. Use this on platforms that do not
                        support configuration of the DNS resolver or it is not managed by OpenSync

                config INET_DNS_RESOLVCONF
                    bool "resolv.conf"
                    help
                        Use "resolv.conf" for DNS resolver configuration. Supported by most Linux
                        platforms.
            endchoice

            if INET_DNS_RESOLVCONF
                comment "INET resolv.conf configuration"
                config INET_RESOLVCONF_PATH
                    string 'Path to the "resolv.conf" file'
                    default "/tmp/resolv.conf"
                    help
                        Path to the "resolv.conf" file. On embedded systems this is typically
                        somewhere on /tmp

                config INET_RESOLVCONF_TMP
                    string "Path to the temporary DNS folders"
                    default "/tmp/dns"
                    help
                        This path is used to store intermediate DNS files. Each interface
                        creates one such file (in resolv.conf format). The final "resolv.conf"
                        file is aggregated from all intermediate files.
            endif
        endif

    menuconfig INET_DHSNIFF_ENABLED
        bool "DHCP sniffing"
        default y
        help
            Use DHCP sniffing implementation as provided by LIBINET

            This option implements the inet_dhsniff_t class.

        if INET_DHSNIFF_ENABLED
            comment "INET DHCP sniffing configuration"
            choice
                prompt "DHCP sniffing implementation"
                default INET_DHSNIFF_NULL

                config INET_DHSNIFF_NULL
                    bool "Null"
                    help
                        Dummy DHCP sniffing implementation. Use this on platforms that do not
                        support DHCP sniffing.

                config INET_DHSNIFF_PCAP
                    bool "Packet capture (libpcap)"
                    help
                        Use a libpcap based DHCP sniffing implementation. Applicable to most
                        Linux platformns.
            endchoice

            if INET_DHSNIFF_PCAP
                config DHSNIFF_PCAP_IMMEDIATE
                    bool "Use immediate mode"
                    default y
                    help
                        This option enables PCAP "immediate" mode. Apparently this instructs
                        PCAP to deliver packets as fast as possible instead of buffering.

                config DHSNIFF_PCAP_PROMISC
                    bool "Use promiscuous mode"
                    help
                        This option enables the calling of pcap_set_promisc() to enable
                        promiscuous mode.

                        If unsure, select 'n'.

                config DHSNIFF_PCAP_BUFFER_SIZE
                    int "Set libpcap buffer size"
                    default 0
                    help
                        By default libpcap uses a buffer size of 2MB or more. On systems
                        with low memory you may want to set this to something reasonably small.
                        The buffer size must be greater than the current snapshot length (plus some overhead).

                        If unsure, use 0 (use libpcap default).

                config DHSNIFF_PCAP_SNAPLEN
                    int "Set snapshot len"
                    default 0
                    help
                        Set a custom snapshot length.

                        If unsure, use 0 (use libpcap default - 65535).
            endif
        endif

    menuconfig INET_IGMP_SNOOPING_ENABLED
        bool "IGMP snooping"
        default y
        help
            Use IGMP snooping enabling/disabling implementation as provided by LIBINET.

            This option implements the inet_igmp_t class.

        if INET_IGMP_SNOOPING_ENABLED
            comment "INET IGMP snooping configuration"
            choice
                prompt "IGMP snooping implementation"
                default INET_IGMP_NULL

                config INET_IGMP_NULL
                    bool "Null"
                    help
                        Dummy igmp snooping implementation. Use this on platforms that do not
                        support igmp snooping.

                config INET_IGMP_SNOOPING
                    bool "Linux igmp snooping implementation"
                    help
                        Use Wifi_Inet_Config table to enable or disable igmp snooping on device.
            endchoice
        endif
endmenu
```

## src/lib/l2uf_parse/kconfig/Kconfig.libs
```kconfig
menuconfig LIB_LEGACY_FSM_L2UF_PARSER
    bool "Enables Opensync legacy FSM L2UF parser"
    default n
    help
       N/A
```

## src/lib/log/kconfig/Kconfig.libs
```kconfig
menu "liblog Configuration"
    config LOG_USE_PREFIX
        bool "Use custom log prefix"
        default n

        help
            Use custom prefix for OpenSync log messages

    config LOG_PREFIX
        string "Custom log prefix string"
        default "OSYNC"
        depends on LOG_USE_PREFIX
        help
            Prefix to use for all log messages generated by OpenSync.

    config LOG_REMOTE
        bool "Remote logging"
        default y
        depends on MANAGER_QM
        help
            Enable support for remote logging via MQTT. This feature requires QM.
endmenu
```

## src/lib/mdns_plugin/kconfig/Kconfig.libs
```kconfig
menuconfig LIB_LEGACY_FSM_MDNS_PARSER
    bool "Enables Opensync legacy FSM mDNS parser"
    default n
    help
       N/A
```

## src/lib/ndp_parse/kconfig/Kconfig.libs
```kconfig
menuconfig LIB_LEGACY_FSM_NDP_PARSER
    bool "Enables Opensync legacy FSM DNS parser"
    default n
    help
       N/A
```

## src/lib/network_zone/kconfig/Kconfig.libs
```kconfig
menuconfig LIB_NETWORK_ZONE
    bool "Enables network zone management"
        default y
        help
            N/A
```

## src/lib/nfe/kconfig/Kconfig.libs
```kconfig
menuconfig WALLEYE_NFE_RELEASE_BUILD
    bool "Walleye NFE library release mode"
    default y
    depends on MANAGER_FSM
    help
        The Walleye NFE library will be built in release mode
```

## src/lib/objmfs/kconfig/Kconfig
```kconfig
if OSP_OBJM_OBJMFS

menuconfig OBJMFS_ENABLED
    bool "OBJMFS Backend"
    default n
    help
        OBJMFS is short for Object management file system and is a library
        that implements object management on read-write filesystem

    comment "OBJMFS Options"
        depends on OBJMFS_ENABLED

    config OBJMFS_DIR
        depends on OBJMFS_ENABLED
        string "Folder location"
        default "$(INSTALL_PREFIX)/storage"
        help
            Folder location where installed objects are stored. Objects are
            stored in sub-folders as <name>/<version>

endif
```

## src/lib/osa/kconfig/Kconfig.libs
```kconfig
menu "OS Backtrace Path Configuration"
    config OS_BACKTRACE_DUMP_PATH
        string "Default path for backtrace logs"
        default "/var/log/opensync/crash"
        help
            Path to a destination directory for backtrace logs
endmenu

menu "Core Dump File Saving Configuration"
    config SAVE_CORE_DUMP_FILES
    	bool "Enable saving of core dump files"
        default y
        help
            This enables saving crash core dump files using a
            custom wrapper script and collecting them in log
            pulls.

        config CORE_DUMP_FILES_SAVE_PATH
            depends on SAVE_CORE_DUMP_FILES
            string "Path to core dump files"
            default "/tmp"
            help
                File system path where core dump files will be
                saved.
endmenu
```

## src/lib/osbus/kconfig/Kconfig.libs
```kconfig
menu "OSBUS Configuration"

    config OSBUS_LIB
        bool "OSBUS Support"
        default n
        help
            Select to include OSBUS Support

    config OSBUS_UBUS
        bool "OSBUS UBUS Support"
        depends on OSBUS_LIB
        default n
        help
            Select to include UBUS Support

    config OSBUS_RBUS
        bool "OSBUS RBUS Support"
        depends on OSBUS_LIB
        default n
        help
            Select to include RBUS Support

    if OSBUS_LIB
        choice
            prompt "OSBUS default bus"
            default OSBUS_DEFAULT_UBUS if OSBUS_UBUS
            default OSBUS_DEFAULT_RBUS if OSBUS_RBUS

            config OSBUS_DEFAULT_NONE
                bool "None"
                help
                    No default BUS selection

            config OSBUS_DEFAULT_UBUS
                bool "UBUS"
                depends on OSBUS_UBUS
                help
                    Use UBUS as default OSBUS bus.

            config OSBUS_DEFAULT_RBUS
                bool "RBUS"
                depends on OSBUS_RBUS
                help
                    Use RBUS as default OSBUS bus.
        endchoice
    endif

    config USE_OSBUS
        depends on OSBUS_LIB
        bool "Use OSBUS in managers"
        default n
        help
            Use OSBUS in managers

endmenu
```
