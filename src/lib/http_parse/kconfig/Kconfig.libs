## src/lib/osn/kconfig/Kconfig.osn.adaptive_qos_backend
```kconfig
config OSN_BACKEND_ADAPTIVE_QOS_NULL
    bool "Null"

    help
        Use dummy implementation

config OSN_BACKEND_ADAPTIVE_QOS_CAKE_AUTORATE
    bool "cake-autorate"

    select OSN_LINUX_ENABLED
    select OSN_BACKEND_QDISC_LINUX
    select OSN_ADAPTIVE_QOS_CAKE_AUTORATE
    help
        Enable the Adaptive QoS backend that uses the cake-autorate
        script to adaptively adjust the cake shaper settings.
```

## src/lib/osn/kconfig/Kconfig.osn.bridging_backend
```kconfig
config OSN_BACKEND_BRIDGING_NULL
    bool "Null"
    help
        Use a dummy Linux Bridging implementation.

config OSN_BACKEND_LINUX_BRIDGING
    bool "Linux"

    select OSN_LINUX_ENABLED
    select OSN_LINUX_BRIDGING
    help
        Use the Linux brctl command for managing bridge config.
```

## src/lib/osn/kconfig/Kconfig.osn.cell_backend
```kconfig
config OSN_BACKEND_CELL_NULL
    bool "Null"
    help
        Use dummy CELL implementation for platforms where CELL functionality is
        not desired or not supported.

config OSN_BACKEND_CELL_LINUX
    bool "Linux"
    select OSN_LINUX_ENABLED
    select OSN_LINUX_LTE
    help
        Use the Linux cellular implementation that uses the 3rdparty apps to initialize interfaces.
```

## src/lib/osn/kconfig/Kconfig.osn.dhcpv4_client_backend
```kconfig
config OSN_BACKEND_DHCPV4_CLIENT_NULL
    bool "Null"

    help
        Use a dummy DHCPv4 client backend.

config OSN_BACKEND_DHCPV4_CLIENT_UDHCP
    bool "udhcp client"
    select OSN_LINUX_ENABLED
    select OSN_UDHCPC
    help
        Use the the udhcp client backend provided by OpenSync
```

## src/lib/osn/kconfig/Kconfig.osn.dhcpv4_server_backend
```kconfig
config OSN_BACKEND_DHCPV4_SERVER_NULL
    bool "Null"

    help
        Use dummy implementation of the DHCPv4 server.

config OSN_BACKEND_DHCPV4_SERVER_DNSMASQ
    bool "dnsmasq"
    select OSN_LINUX_ENABLED
    select OSN_DNSMASQ
    help
        Use the dnsmasq backend provided by OpenSync
```

## src/lib/osn/kconfig/Kconfig.osn.dhcpv6_client_backend
```kconfig
config OSN_BACKEND_DHCPV6_CLIENT_NULL
    bool "Null"

    help
        Use a dummy DHCPv6 client backend.

config OSN_BACKEND_DHCPV6_CLIENT_ODHCP6
    bool "odhcp6 client"
    select OSN_LINUX_ENABLED
    select OSN_ODHCP6
    help
        Use the odhcp6 client backend provided by OpenSync
```

## src/lib/osn/kconfig/Kconfig.osn.dhcpv6_server_backend
```kconfig
config OSN_BACKEND_DHCPV6_SERVER_NULL
    bool "Null"

    help
        Use dummy implementation of the DHCPv6 server.

config OSN_BACKEND_DHCPV6_SERVER_DNSMASQ6
    bool "dnsmasq6"
    select OSN_LINUX_ENABLED
    select OSN_DNSMASQ6
    help
        Use the dnsmasq backend provided by OpenSync
```

## src/lib/osn/kconfig/Kconfig.osn.fw
```kconfig
if OSN_BACKEND_FW_IPTABLES_FULL
    comment "iptables full options"
    menu "Default Policy"
        comment "FILTER Table"
        choice
            prompt "INPUT"
            default OSN_FW_IPTABLES_POLICY_FILTER_INPUT_DROP

            config OSN_FW_IPTABLES_POLICY_FILTER_INPUT_ACCEPT
                bool "Accept"

            config OSN_FW_IPTABLES_POLICY_FILTER_INPUT_REJECT
                bool "Reject"

            config OSN_FW_IPTABLES_POLICY_FILTER_INPUT_DROP
                bool "Drop"
        endchoice

        choice
            prompt "OUTPUT"
            default OSN_FW_IPTABLES_POLICY_FILTER_OUTPUT_ACCEPT

            config OSN_FW_IPTABLES_POLICY_FILTER_OUTPUT_ACCEPT
                bool "Accept"

            config OSN_FW_IPTABLES_POLICY_FILTER_OUTPUT_REJECT
                bool "Reject"

            config OSN_FW_IPTABLES_POLICY_FILTER_OUTPUT_DROP
                bool "Drop"
        endchoice

        choice
            prompt "FORWARD"
            default OSN_FW_IPTABLES_POLICY_FILTER_FORWARD_ACCEPT

            config OSN_FW_IPTABLES_POLICY_FILTER_FORWARD_ACCEPT
                bool "Accept"

            config OSN_FW_IPTABLES_POLICY_FILTER_FORWARD_REJECT
                bool "Reject"

            config OSN_FW_IPTABLES_POLICY_FILTER_FORWARD_DROP
                bool "Drop"
        endchoice

        comment "NAT Table"
        choice
            prompt "PREROUTING"
            default OSN_FW_IPTABLES_POLICY_NAT_PREROUTING_ACCEPT

            config OSN_FW_IPTABLES_POLICY_NAT_PREROUTING_ACCEPT
                bool "Accept"

            config OSN_FW_IPTABLES_POLICY_NAT_PREROUTING_DROP
                bool "Drop"
        endchoice

        choice
            prompt "OUTPUT"
            default OSN_FW_IPTABLES_POLICY_NAT_OUTPUT_ACCEPT

            config OSN_FW_IPTABLES_POLICY_NAT_OUTPUT_ACCEPT
                bool "Accept"

            config OSN_FW_IPTABLES_POLICY_NAT_OUTPUT_DROP
                bool "Drop"
        endchoice

        choice
            prompt "POSTROUTING"
            default OSN_FW_IPTABLES_POLICY_NAT_POSTROUTING_ACCEPT

            config OSN_FW_IPTABLES_POLICY_NAT_POSTROUTING_ACCEPT
                bool "Accept"

            config OSN_FW_IPTABLES_POLICY_NAT_POSTROUTING_DROP
                bool "Drop"
        endchoice

        comment "MANGLE Table"
        choice
            prompt "PREROUTING"
            default OSN_FW_IPTABLES_POLICY_MANGLE_PREROUTING_ACCEPT

            config OSN_FW_IPTABLES_POLICY_MANGLE_PREROUTING_ACCEPT
                bool "Accept"

            config OSN_FW_IPTABLES_POLICY_MANGLE_PREROUTING_DROP
                bool "Drop"
        endchoice

        choice
            prompt "INPUT"
            default OSN_FW_IPTABLES_POLICY_MANGLE_INPUT_ACCEPT

            config OSN_FW_IPTABLES_POLICY_MANGLE_INPUT_ACCEPT
                bool "Accept"

            config OSN_FW_IPTABLES_POLICY_MANGLE_INPUT_DROP
                bool "Drop"
        endchoice

        choice
            prompt "FORWARD"
            default OSN_FW_IPTABLES_POLICY_MANGLE_FORWARD_ACCEPT

            config OSN_FW_IPTABLES_POLICY_MANGLE_FORWARD_ACCEPT
                bool "Accept"

            config OSN_FW_IPTABLES_POLICY_MANGLE_FORWARD_DROP
                bool "Drop"
        endchoice

        choice
            prompt "OUTPUT"
            default OSN_FW_IPTABLES_POLICY_MANGLE_OUTPUT_ACCEPT

            config OSN_FW_IPTABLES_POLICY_MANGLE_OUTPUT_ACCEPT
                bool "Accept"

            config OSN_FW_IPTABLES_POLICY_MANGLE_OUTPUT_DROP
                bool "Drop"
        endchoice

        choice
            prompt "POSTROUTING"
            default OSN_FW_IPTABLES_POLICY_MANGLE_POSTROUTING_ACCEPT

            config OSN_FW_IPTABLES_POLICY_MANGLE_POSTROUTING_ACCEPT
                bool "Accept"

            config OSN_FW_IPTABLES_POLICY_MANGLE_POSTROUTING_DROP
                bool "Drop"
        endchoice

        comment "RAW Table"
        choice
            prompt "PREROUTING"
            default OSN_FW_IPTABLES_POLICY_RAW_PREROUTING_ACCEPT

            config OSN_FW_IPTABLES_POLICY_RAW_PREROUTING_ACCEPT
                bool "Accept"

            config OSN_FW_IPTABLES_POLICY_RAW_PREROUTING_DROP
                bool "Drop"
        endchoice

        choice
            prompt "OUTPUT"
            default OSN_FW_IPTABLES_POLICY_RAW_OUTPUT_ACCEPT

            config OSN_FW_IPTABLES_POLICY_RAW_OUTPUT_ACCEPT
                bool "Accept"

            config OSN_FW_IPTABLES_POLICY_RAW_OUTPUT_DROP
                bool "Drop"
        endchoice

        comment "SECURITY Table"
        choice
            prompt "INPUT"
            default OSN_FW_IPTABLES_POLICY_SECURITY_INPUT_ACCEPT

            config OSN_FW_IPTABLES_POLICY_SECURITY_INPUT_ACCEPT
                bool "Accept"

            config OSN_FW_IPTABLES_POLICY_SECURITY_INPUT_DROP
                bool "Drop"
        endchoice

        choice
            prompt "FORWARD"
            default OSN_FW_IPTABLES_POLICY_SECURITY_FORWARD_ACCEPT

            config OSN_FW_IPTABLES_POLICY_SECURITY_FORWARD_ACCEPT
                bool "Accept"

            config OSN_FW_IPTABLES_POLICY_SECURITY_FORWARD_DROP
                bool "Drop"
        endchoice
        choice
            prompt "OUTPUT"
            default OSN_FW_IPTABLES_POLICY_SECURITY_OUTPUT_ACCEPT

            config OSN_FW_IPTABLES_POLICY_SECURITY_OUTPUT_ACCEPT
                bool "Accept"

            config OSN_FW_IPTABLES_POLICY_SECURITY_OUTPUT_DROP
                bool "Drop"
        endchoice
    endmenu
endif
```

## src/lib/osn/kconfig/Kconfig.osn.fw_backend
```kconfig
config OSN_BACKEND_FW_NULL
    bool "Null"
    help
        Use dummy Firewall implementation

config OSN_BACKEND_FW_IPTABLES_FULL
    bool "iptables full"
    help
        Use the iptables full backend.

        This implementation uses the iptables-restore command to apply firewall
        rules and fully takes control over system firewall configuration. This
        means that any rules that were not applied via this API will be
        destroyed. This allows for tighter control of firewall rules and
        guarantees atomicity.

config OSN_BACKEND_FW_IPTABLES_THIN
    bool "iptables thin"
    help
        Use the iptables thin backend.

        As opposed to the full implementation, the thin implementation uses the
        standard `iptables` command to manipulate firewall rules. It works on a
        iptables chain scope, meaning that it does not touch tables or chains
        that are not referenced in the Netfilter table.

        Use this option when you just want NFM to manage selected chains instead
        of the global firewall configuration.
```

## src/lib/osn/kconfig/Kconfig.osn.igmp_backend
```kconfig
config OSN_BACKEND_IGMP_NULL
    bool "Null"

    help
        Use dummy implementation of IGMP networking.

config OSN_BACKEND_IGMP_LINUX
    bool "Linux"
    select OSN_LINUX_ENABLED
    select OSN_LINUX_IGMP
    help
        Use the Linux IGMP backend provided by OpenSync
```

## src/lib/osn/kconfig/Kconfig.osn.ipsec_backend
```kconfig
config OSN_BACKEND_IPSEC_NULL
    bool "Null"
    help
        Use dummy implementation of IPsec

config OSN_BACKEND_IPSEC_LINUX_STRONGSWAN
    bool "Linux"
    select OSN_LINUX_ENABLED
    select OSN_VPN
    select OSN_VPN_IPSEC
    select OSN_LINUX_TUNNEL_IFACE
    help
        Use the Linux strongSwan IPsec backend provided by OpenSync
```
