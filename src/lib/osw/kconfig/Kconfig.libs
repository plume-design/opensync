## src/lib/osw/kconfig/Kconfig.libs
```kconfig
menu "OSW Configuration"
    config OSW_UT
        bool "Built unit tests"
        default n
        help
            OSW unit tests
endmenu
```

## src/lib/otbr_cli/kconfig/Kconfig.libs
```kconfig
menuconfig OTBR_CLI
    bool "OpenThread Border Router Agent CLI library"
    default n
    help
        This library runs OTBR Agent daemon and controls it using
        OpenThread CLI commands via IPC sockets (similar to how
        the ot-ctl tool operates).

    if OTBR_CLI
        config OTBR_CLI_THREAD_RADIO_URL
            string "Thread radio URL (IEEE802.15.4 or TREL radio)"
            help
                URL used for connecting to the Thread radio.
                For UART devices this is in format:
                "spinel+hdlc+uart://<PATH_TO_UART_DEVICE>?<Parameters>"
                Example for USB attached UART device:
                "spinel+hdlc+uart:///dev/ttyUSB0"

        config OTBR_CLI_AGENT_DAEMON_PATH
            string "Path to the otbr-agent daemon executable"
            default "/usr/sbin/otbr-agent"

        config OTBR_CLI_AGENT_DAEMON_PID_FILE
            string "PID file used for running otbr-agent as a daemon"
            default "/var/run/otbr-agent.pid"

        config OTBR_CLI_AGENT_DAEMON_SOCKET_NAME_TEMPLATE
            string "Socket name template used by otbr-agent daemon"
            default "/var/run/openthread-%s.sock"
            help
                The socket name template shall contain exactly one '%s'
                which will be replaced by Thread network interface name.
                It shall be the same as OPENTHREAD_POSIX_DAEMON_SOCKET_NAME
                definition used for compilation of the otbr-agent daemon.

    endif
```

## src/lib/ow/kconfig/Kconfig.libs
```kconfig
menuconfig OW
    bool "Opensync Wireless / One Wifi Library (OW)"
    default y
    help
        This provides business logic for wireless related
        operations in opensync.

        This can be used by 3rd parties by linking to
        libopensync.so, although care must be taken.

        The library can be embedded into an existing libev
        mainloop, or it can be used as a separate thread.
        The later requires careful API accesses because most
        calls are not thread safe.
```

## src/lib/psfs/kconfig/Kconfig
```kconfig
if OSP_PS_PSFS

menuconfig PSFS_ENABLED
    bool "PSFS Backend"
    default n
    help
        PSFS is short for Persistent Storage File System and is a library
        that implements persistent storage using the file system.

    comment "PSFS Options"
        depends on PSFS_ENABLED

    config PSFS_DIR
        depends on PSFS_ENABLED
        string "Primary folder"
        default "$(INSTALL_PREFIX)/data"
        help
            The primary storage folder for PSFS. This is a folder location
            that is not preserved across system upgrades.

    config PSFS_PRESERVE_DIR
        depends on PSFS_ENABLED
        string "Preserved folder"
        default "$(INSTALL_PREFIX)/pdata"
        help
            The PSFS storage folder location that is preserved across system
            upgrades.

    config PSFS_SYNC_MIN
        depends on PSFS_ENABLED
        int "Minimum store file size before pruning is attempted (kB)"
        default 8
        help
            Pruning is an operation where the whole content of the database
            is copied and stale entries are pruned. Files smaller than this
            size are never pruned -- unless forced.


    config PSFS_SYNC_WASTED_MAX
        depends on PSFS_ENABLED
        int "Maximum wasted space after which pruning is enforced (kB)"
        default 32
        help
            Pruning is an operation where the whole content of the database
            is copied and stale entries are pruned. Stores that have at least
            this amount of wasted bytes (used by inactive or deleted records)
            are force pruned.

    config PSFS_SYNC_WASTED_RATIO_MAX
        depends on PSFS_ENABLED
        int "When wasted bytes account for more than this percent, always sync in prune mode"
        default 50
        help
            If wasted bytes vs good bytes is more than this percent, force
            prune mode on close or sync.

endif
```

## src/lib/reboot_flags/kconfig/Kconfig.libs
```kconfig
menu "lib reboot_flags Configuration"
    config NO_REBOOT_DIR
    string 'no_reboot directory'
    default "/tmp/.no_reboot"
    help
        Full path to the no_reboot working directory
endmenu
```

## src/lib/revssh/kconfig/Kconfig.libs
```kconfig
menuconfig REVSSH_ENABLED
    bool "Enable OpenSync Reverse SSH Support"
    default y
    help
        This enables OpenSync support for configuring
        reverse SSH tunneling with remote port forwarding.

if REVSSH_ENABLED
    config REVSSH_TMP_DIR
        string "Reverse SSH temporary directory"
        default "/tmp/revssh"
        help
            Full path to the directory in tmpfs that will be
            dedicated to temporary RevSSH files and resources.

    config REVSSH_DEFAULT_IDLE_TIMEOUT
    int "Default RevSSH session idle timeout"
    default 10
    help
        Default RevSSH session inactivity/idle timeout.
        In minutes. This configures the default, the value can be
        overridden by OVSDB config. If a user ssh session is idle
        (inactive) for this amount of time, it is automatically closed.

    config REVSSH_DEFAULT_SESSION_MAX_TIME
    int "Default RevSSH session maximum time"
    default 480
    help
        Default RevSSH session maximum time regardless if active or not.
        In minutes. This configures the default, the value can be
        overridden by OVSDB config. If this time is reached, regardless
        if user session is active or not, the whole RevSSH session is
        destroyed and resources cleaned up.

    choice
        prompt "RevSSH Backend"
        default REVSSH_BACKEND_DROPBEAR

        config REVSSH_BACKEND_DROPBEAR
            bool "Dropbear"
            help
                Use the RevSSH backend implementation using Dropbear

        if REVSSH_BACKEND_DROPBEAR
            config REVSSH_DROPBEAR_SERVER
            string "Dropbear server"
            default "dropbear"
            help
                Dropbear server command or full path to executable.

            config REVSSH_DROPBEAR_CLIENT
            string "Dropbear client"
            default "dbclient"
            help
                Dropbear client command or full path to executable.

            config REVSSH_DROPBEAR_KEYTOOL
            string "Dropbear keytool"
            default "dropbearkey"
            help
                Dropbear keytool command or full path to executable.

            config REVSSH_DROPBEAR_KEYFILE
            string "Path to the default Dropbear host key file"
            default "/etc/dropbear/dropbear_ed25519_host_key"
            help
                Full path to the default Dropbear host key file.

            config REVSSH_DROPBEAR_AUTHORIZED_KEYS_FILE
            string "Dropbear authorized_keys file path"
            default "/etc/dropbear/authorized_keys"
            help
                Full path to Dropbear authorized_keys file.

        endif

        config REVSSH_BACKEND_NULL
            bool "Null"
            help
                Use the dumy Null RevSSH backend.

    endchoice
endif
```

## src/lib/rts/kconfig/Kconfig.libs
```kconfig
menuconfig WALLEYE_RTS_RELEASE_BUILD
    bool "Walleye RTS library release mode"
    default y
    depends on MANAGER_FSM
    help
        The Walleye RTS library will be built in release mode
```

## src/lib/target/kconfig/Kconfig
```kconfig
OPENSYNC_DIR := $(INSTALL_PREFIX)
TOOLS_DIR := $(OPENSYNC_DIR)/tools
OPENSYNC_BIN := $(OPENSYNC_DIR)/bin
LOG_DIR := /var/log/opensync

menu "WAN link selection"
    config TARGET_ENABLE_WAN_LINK_SELECTION
        bool "Enable WAN link selection by CM"
        default y
        help
            If building an OpenSync extender, CM's WAN link selection logic
            should probably be used, therefore this option should be enabled.

            If building an OpenSync aware residential gateway this option
            should probably not be set since these tend to run their own WAN
            management software.
endmenu

menu "Target paths"
    config TARGET_PATH_BIN
        string "Path to binaries/managers"
        default "$(OPENSYNC_BIN)"

    config TARGET_PATH_TOOLS
        string "Path to tools folder"
        default "$(OPENSYNC_DIR)/tools"

    config TARGET_PATH_SCRIPTS
        string "Path to scripts folder"
        default "$(OPENSYNC_BIN)"

    config TARGET_PATH_PERSISTENT
        string "Path to persistent storage"
        default "/etc/opensync"

    config TARGET_PATH_LOG_STATE
        string "Path to the log state config file"
        default "/etc/log-state.conf"
        help
            This is used for dynamically adjusting log and severity levels
            On systems with buggy inotify and overlayfs (QSDK 2.0),
            use the overlay path instead (/overlay/etc/log-state.conf)
            To disable dynamic log set to an empty string

    config TARGET_PATH_LOG_TRIGGER
        string "Path to the log trigger folder"
        default "$(LOG_DIR)/tmp"
        help
            To disable log trigger set to an empty string

    config TARGET_PATH_DISABLE_FATAL_STATE
        string "Path to the fatal state inhibit file"
        default "/opt/tb/cm-disable-fatal"
        help
            This file inhibits the manager restart action -- use for testing only.

    config TARGET_PATH_CERT
        string "Path to the certificate files used to authenticate with cloud"
        default "/var/certs"

    config TARGET_PATH_CERT_CA
        string "Filename of the CA certificate used to authenticate with cloud"
        default "ca.pem"

    config TARGET_PATH_PRIV_CERT
        string "Filename of my certificate used to authenticate with cloud"
        default "client.pem"

    config TARGET_PATH_PRIV_KEY
        string "Filename of my private key used to authenticate with cloud"
        default "client_dec.key"

    config TARGET_OPENSYNC_CAFILE
        string "Filename of CA certificate used by OpenSync features such as logpull."
        default "opensync_ca.pem"

    config TARGET_PATH_OVSDB_SOCK
        string "Path to OVSDB socket"
        default "/var/run/db.sock"

    config TARGET_PATH_OPENSYNC_CERTS
        string "Path to OpenSync certs folder"
        default "$(OPENSYNC_DIR)/certs"
endmenu

menuconfig TARGET_ETH_LIST
    bool "Ethernet interface list"
    default y
    help
        Use a hardcoded ethernet interface list.

        This option implements the target_ethclient_iflist_get() function.

if TARGET_ETH_LIST
    config TARGET_ETH0_LIST
        bool "Ethernet[0]"
        default y

    config TARGET_ETH0_NAME
        string "Ifname[0]"
        depends on TARGET_ETH0_LIST
        default "eth0"

    config TARGET_ETH1_LIST
        bool "Ethernet[1]"

    config TARGET_ETH1_NAME
        string "Ifname[1]"
        depends on TARGET_ETH1_LIST

    config TARGET_ETH2_LIST
        bool "Ethernet[2]"

    config TARGET_ETH2_NAME
        string "Ifname[2]"
        depends on TARGET_ETH2_LIST

    config TARGET_ETH3_LIST
        bool "Ethernet[3]"

    config TARGET_ETH3_NAME
        string "Ifname[3]"
        depends on TARGET_ETH3_LIST

    config TARGET_ETH4_LIST
        bool "Ethernet[4]"

    config TARGET_ETH4_NAME
        string "Ifname[4]"
        depends on TARGET_ETH4_LIST

    config TARGET_ETH5_LIST
        bool "Ethernet[5]"

    config TARGET_ETH5_NAME
        string "Ifname[5]"
        depends on TARGET_ETH5_LIST
endif

config TARGET_LAN_BRIDGE_NAME
    string "LAN bridge name"
    default "br-home"
    help
        LAN bridge name that will be used

config TARGET_LAN_SET_LOCAL_MAC_BIT
    bool "Local MAC bit on LAN bridge interface"
    default y
    help
        Toggle of whether setting local bit on MAC address
        of LAN bridge to avoid having the same MAC address
        on ethernet interfaces.

config TARGET_ETH_FOR_LAN_BRIDGE
    string "Ethernet port for LAN bridge"
    default "eth0"
    help
        Provide ethernet port which should be used for LAN bridge
        The MAC of the selected port will be used on the LAN bridge

menu "Misc..."
config TARGET_RESTART_SCRIPT
    bool "Use a script to restart managers"
    default y
    help
        Use a script to execute a manager restart

config TARGET_RESTART_SCRIPT_CMD
    string "Command to execute"
    default "$(OPENSYNC_BIN)/restart.sh"
    depends on TARGET_RESTART_SCRIPT

config TARGET_LOGPULL_REMOTE
    bool "Enables support for remote logpulls"
    default y
    help
        This option enables support for remote logpulls in
        OpenSync target layer and logpull.sh.

config TARGET_LINUX_EXECUTE
    bool "Use generic Linux execute"
    default y
    help
        This implements the target_device_execute() function using the standard
        Linux system() call.

        You may want to select 'Y' here for most Linux-based SDKs.

config TARGET_CM_LINUX_SUPPORT_PACKAGE
    bool "CM Linux support package"
    default y

    help
        Various collection of functions that are mostly common for
        all Linux platforms.

        Required by CM2.

config TARGET_IMC
    bool "Inter manager communication"
    default y
    help
        Select this option to enable communication between the FSM and FCM managers

endmenu
```

## src/lib/upnp_parse/kconfig/Kconfig.libs
```kconfig
menuconfig LIB_LEGACY_FSM_UPNP_PARSER
     bool "Enables Opensync legacy FSM UPnP parser"
     default n
     help
        N/A
```

## src/lib/ustack/kconfig/Kconfig.libs
```kconfig
menuconfig LIB_USTACK
    bool "Enables the network header parser"
        default y
        help
            Enable the parsing of network headers for packet inspection
```

## src/lib/walleye/kconfig/Kconfig.libs
```kconfig
menuconfig WALLEYE_DPI_ENGINE
    bool "Walleye DPI engine support"
    default y
    depends on MANAGER_FSM
    help
        Enable Walleye DPI engine support for FSM

    config WALLEYE_DPI_ENGINE_SANDBOX_SIZE
        int "Walleye DPI engine sandbox memory size in MB"
        default 2
        help
            The Walleye DPI engine provisions the memory amount it will need to parse
            presented flows.
```

## src/lib/we/kconfig/Kconfig.libs
```kconfig
menuconfig LIB_WE
    bool "WE library for the agent"
    default y
    depends on WE_DPI_ENGINE
    help
        Enable WE library for the agent

    config WE_AGENT_MEMPOOL
        depends on LIB_WE
        bool "Use a memory pool for WE memory allocations"
        default y
        help
            To improve performance, a pre-allocated memory pool will
            be used for WE. During initialization, this pool is created, 
            and subsequent memory requests will be fulfilled from it,
            replacing calls to malloc and calloc.

    config WE_MEMPOOL_SIZE
        int "WE memory pool size in MB"
        default 10
        help
            Specifies the size of the WE memory pool in megabytes.
```

## src/lib/we_dpi/kconfig/Kconfig.libs
```kconfig
menuconfig WE_DPI_ENGINE
    bool "WE DPI engine support"
    default y
    depends on MANAGER_FSM
    help
        Enable WE DPI engine support for FSM

    config WE_AGENT_BINARY
        bool "Install WE Agent binary"
        default y

        help
            Install the WE Agent binary
```

## src/lm/kconfig/Kconfig.managers
```kconfig
menuconfig MANAGER_LM
    bool "Log Manager (LM)"
    default n
    help
        Enable Log Manager (LM)

    config MANAGER_LM_CFG
        depends on MANAGER_LM
        string "LM Startup configuration"
        default "lm;true;needs_plan_b=true"
        help
            Log Manager startup configuration
```
