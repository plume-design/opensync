## src/sm/kconfig/Kconfig.managers
```kconfig
menuconfig MANAGER_SM
    bool "Statistics Manager (SM)"
    default y
    select MANAGER_QM
    help
        Enable Statistics Manager (SM)

    config MANAGER_SM_CFG
        depends on MANAGER_SM
        string "SM Startup configuration"
        default "sm;true;max_memory=20000"
        help
            Statistics Manager startup configuration

    config SM_LATENCY_STATS
        depends on MANAGER_SM
        bool "Latency statistics"
        default y
        help
            Support for latency statistics for SM.

            Remember to select an adequate implementation backend.

    choice
        prompt "Latency stats implementation backend"
        depends on MANAGER_SM && SM_LATENCY_STATS
        default SM_LATENCY_IMPL_NONE
        config SM_LATENCY_IMPL_NONE
            bool "none"
            help
                This is a stub latency backend implementation.
                It does nothing. Just satisfying build time and
                linking mechanics.

                This isn't all that useful except for development and
                testing of core logic that ingests configuration and
                to check plumbing.

                It makes little sense in enabling SM_LATENCY_STATS
                with SM_LATENCY_IMPL_NONE for deployment.
        config SM_LATENCY_IMPL_EPPING
            bool "epping"
            help
                This uses XDP and epping to passively monitor
                latency of running flows by performing DPI
                on their metadata to infer RTT.

                Requires fairly recent Linux kernel to run.

                May interact poorly with HW and SW datapath accelerator.
    endchoice

    config SM_CAPACITY_QUEUE_STATS
        depends on MANAGER_SM
        bool "Capacity Queue Stats"
        default n
        help
            Enable capacity queue statistics

            Note: This may require support from platform modules.

    config SM_BACKEND_RADIUS_STATS_HAPD
        depends on MANAGER_SM
        bool "hostapd backend for radius statistics"
        default n
        help
            Use hostapd backend for radius stats SM module.

    config SM_BACKEND_RADIUS_STATS_NULL
        depends on MANAGER_SM
        bool "dummy/null backend for radius statistics"
        default y if !SM_BACKEND_RADIUS_STATS_HAPD
        help
            Use dummy implementation for radius stats SM module.

    config SM_BACKEND_CLIENT_AUTH_FAILS_HAPD
        depends on MANAGER_SM
        bool "hostapd backend for client auth fails stats"
        default n
        help
            Use hostapd backend for radius stats SM module.

    config SM_BACKEND_CLIENT_AUTH_FAILS_NULL
        depends on MANAGER_SM
        bool "dummy/null backend for radius statistics"
        default y if !SM_BACKEND_CLIENT_AUTH_FAILS_HAPD
        help
            Use hostapd backend for client auth fails SM module.

    config SM_BACKEND_HAPD_CLIENTS_AUTH_FAILS_PER_VAP_LIMIT
        depends on MANAGER_SM
        int "Clients auth fails limit per VAP per report"
        default 256
        help
            An upper bound of unique clients' authentication failure counters
            stored per VAP per one reporting interval.

            This value should be always greater than or equal to 2 and be a
            power of 2.

    config SM_UPLINK_STATS
        depends on MANAGER_SM && MANAGER_CM
        bool "Stats about uplink usage in Client report"
        default n
        help
            Enable uplink type info in Client report
```

## src/tools/logread-osync/kconfig/Kconfig.tools
```kconfig
menuconfig LOGREAD_OSYNC
    bool "Logread OpenSync"
    default y
    help
        This option enables the logread OpenSync tool. The logread tool is used
        to read syslog messages from the systemd log file.

    config LOGREAD_OSYNC_LOG_HAS_HOSTNAME
        bool "The syslog log message contains the hostname"
        default n
        help
            This option is required to parse system logs that include a hostname
            in each log line. For example:
                n: 'Jan  1 12:00:00 systemd[1]: Starting Service...'
                y: 'Jan  1 12:00:00 my-hostname systemd[1]: Starting Service...'

    config LOGREAD_OSYNC_LOG_HAS_YEAR
        bool "The syslog timestamp includes the year"
        default n
        help
            This option is required to parse system logs where the timestamp
            includes the year. For example:
                n: 'Jan  1 12:00:00 systemd[1]: Starting Service...'
                y: '2023 Jan  1 12:00:00 systemd[1]: Starting Service...'

    config LOGREAD_OSYNC_LOG_HAS_LEVEL
        bool "The syslog log message contains the log level"
        default n
        help
            This option is required to parse system logs that include a log level
            field (e.g., INFO, ERROR, DEBUG) in each log line. For example:
                n: 'Jan  1 12:00:00 systemd[1]: Starting Service...'
                y: 'Jan  1 12:00:00 INFO systemd[1]: Starting Service...'
```

## src/tools/osps/kconfig/Kconfig.tools
```kconfig
menuconfig OSPS_ENABLED
    bool "osps"
    default y
    help
        Tool for accessing persistent storage from the shell.

config OSPS_PSFS
    bool "Enable PSFS specific functionality"
    default y
    depends on PSFS_ENABLED && OSPS_ENABLED
    help
        Provides additional commands for PSFS like pruning and listing keys.
```

## src/tools/plookup/kconfig/Kconfig.tools
```kconfig
menuconfig OPENSYNC_NSLOOKUP
    bool "OpenSync simple nslookup"
    default y
    help
        Simple nslookup like utility designed to handle both ipv4 and ipv6 addresses and lookup queries.
```

## src/tools/preboot/kconfig/Kconfig.osp_reboot
```kconfig
#
# "reboot" command overrides and options
#
config OSP_REBOOT_CLI_OVERRIDE
    bool "Install a \"reboot\" command wrapper"
    default y
    help
        This option will override the system "reboot" command with a OSync
        wrapper tool. The tool will record the reboot reason before executing the
        real reboot command.  On systems running busybox, the original "reboot"
        behavior can be achieved by using the "busybox reboot" command.

config OSP_REBOOT_COMMAND
    string "Command to execute for system reboot"
    depends on OSP_REBOOT_CLI_OVERRIDE
    default "/bin/busybox reboot"
    help
        Specify the command that shall be used to issue a system reboot.

        Note that if OSP_REBOOT_CLI_OVERRIDE is active, this option must specify
        the real command that is used to reboot the system as "/sbin/reboot" will
        be just a wrapper around it.
```

## src/um/kconfig/Kconfig.managers
```kconfig
menuconfig MANAGER_UM
    bool "Upgrade Manager (UM)"
    default y
    help
        Enable Upgrade Manager (UM)

    config MANAGER_UM_CFG
        depends on MANAGER_UM
        string "UM Startup configuration"
        default "um;true;needs_plan_b=true"
        help
            Upgrade Manager startup configuration
```
