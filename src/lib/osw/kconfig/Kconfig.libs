## src/ltem/kconfig/Kconfig.managers
```kconfig
menuconfig MANAGER_LTEM
    bool "LTE Manager (LTEM)"
    default n
    help
        Enable LTE Manager (LTEM)

    config MANAGER_LTEM_CFG
        depends on MANAGER_LTEM
        string "LTEM Startup configuration"
        default "ltem;true;always_restart=true;restart_delay=-1"
        help
            LTE Manager startup configuration
```

## src/maptm/kconfig/Kconfig.managers
```kconfig
menuconfig MANAGER_MAPTM
    depends on !MANAGER_WANO && !CM2_USE_WAN_LINK_MANAGEMENT
    bool "MAP-T Manager (MAPTM)"
    default n
    help
        Enable MAP-T Manager (MAPTM)

    config MANAGER_MAPTM_CFG
        depends on MANAGER_MAPTM
        string "MAPTM Startup configuration"
        default "maptm;true"
        help
            MAP-T Manager startup configuration
            
    config MAPTM_WAN_MAP
        depends on MANAGER_MAPTM
        string "MAPTM Eligibility mode"
        default "map"
        
    config MAPTM_WAN_DUALSTACK
        depends on MANAGER_MAPTM
        string "MAPTM Eligibility mode"
        default "dualstack"

    config TARGET_LAN_BRIDGE_NAME
        depends on MANAGER_MAPTM
        string "LAN bridge name"
        default "BR_LAN"

    config TARGET_WAN_BRIDGE_NAME
        depends on MANAGER_MAPTM
        string "WAN bridge name"
        default "br-wan"
```

## src/nm2/kconfig/Kconfig.managers
```kconfig
menuconfig MANAGER_NM
    bool "Network Manager (NM)"
    default y
    help
        Enable Network Manager (NM)

    config MANAGER_NM_CFG
        depends on MANAGER_NM
        string "NM Startup configuration"
        default "nm;true;needs_plan_b=true;max_memory=20000"
        help
            Network Manager startup configuration

    config MANAGER_NM_MCAST_EXCEPTIONS
        depends on MANAGER_NM
        bool "NM Configure OVS mcast exceptions"
        default n
        help
            Network Manager configures OVS multicast exceptions when Snooping enabled

    config MANAGER_NM_ROUTE_BASE_METRIC
        depends on MANAGER_NM
        int "Routes base metric"
        default 100

        help
            For any route metric in the Wifi_Route_Config table that has an unset
            value, calculate the metric value by using the interface type and the
            the value of this option.

            A metric modifier is calculated from the interface type in this
            order of priority:
                - bridge, eth, vlan
                - gre
                - tap
                - wifi
                - PPPoE
                - LTE
                - Everything else

            The metric is then calculated by adding the modifier to the
            MANAGER_NM_ROUTE_BASE_METRIC value.

            This ensures proper WAN priority across different interface types.

    config MANAGER_NM_PROBE_ETH_CLIENTS_PERIOD_DEFAULT
        depends on MANAGER_NM
        int "Default probing period"
        default 150
        help
            Default probing period, in seconds.
```

## src/pm/kconfig/Kconfig.managers
```kconfig
menuconfig MANAGER_PM
    bool "Platform Manager (PM)"
    default y
    help
        Enable Platform Manager (PM)

if MANAGER_PM
    config MANAGER_PM_CFG
        string "Startup configuration"
        default "pm;true"
        help
            Startup configuration

    config PM_ENABLE_CLIENT_FREEZE
        bool "Enable support for client freeze"
        default n
        help
            Use non-standard client freeze implementation

    config PM_ENABLE_CLIENT_NICKNAME
        bool "Enable support for client nickname"
        default n
        help
            Enable client nickname feature Web UI synchronization


    config PM_HW_ACC
        bool "Enable or disable acceleration for testing purposes."
        default y
        help
            Enable or disable acceleration.

    config PM_ENABLE_FF_OVSDB_PS
        bool "Enable support for feature flags persistent storage to be updated by OVSDB"
        default y
        help
           Monitor OVSDB for changes in feature flags and reflect them in persistent storage

    menuconfig PM_ENABLE_LED
        bool "Enable support for LED"
        default n
        select OSP_LED
        help
            Select to include OpenSync LED manager.
            In case LED manager is selected, it will take full control of LED on the platform.


        if PM_ENABLE_LED
            config PM_LED_CONNECTING_TIMEOUT
                int "Timeout in seconds to change from connected to connecting state"
                default 180

            config PM_LED_CONNECT_FAIL_TIMEOUT
                int "Timeout in seconds to change from connecting to connect failed state"
                default 0

            config LEGACY_LED_STATE_MAPPING
                bool "Enable support for LED state mapping"
                default y

            config OSP_LED_COUNT
                int "Number of LEDs"
                range 0 255
                default 1
                help
                    Number of LEDs which need to be controlled
        endif


    menuconfig PM_ENABLE_TM
        bool "Enable support for Thermal Management"
        default n
        help
           Select to include thermal management as part of PM (Platform manager)

        if PM_ENABLE_TM
            config PM_TM_PERIOD_INTERVAL
                int "Interval in seconds at which thermal loop is run at"
                default 10
                help
                    At every period the thermal loop will read temperature
                    and fan RPM, and set appropriate fan RPM and wifi Tx chainmasks.

            config PM_TM_TEMPERATURE_HYSTERESIS
                int "Temperature hysteresis in degrees centigrade"
                default 3
                help
                    Thermal loop will decrease the thermal state only after
                    the temperature source is lower by this value in degrees
                    centigrade.

            config PM_TM_FAN_RPM_TOLERANCE
                int "Tolerance in RPM between actual and set RPM"
                default 300
                help
                    Tolerance in fan RPM, between the RPM we set to the hardware,
                    and the actual RPM read, before we report a fan error.

            config PM_TM_FAN_ERROR_PERIOD_TOLERANCE
                int "Tolerance of fan RPM errors before reporting error"
                default 1
                help
                    If thermal loop detects an error in the fan RPM,
                    it will wait this amount of thermal loops before reporting
                    an error.
                    This option prevents some flukes with the fan hardware,
                    where controller in fan will independently lower fan RPM.

            config PM_TM_CRITICAL_TEMPERATURE_PERIOD_TOLERANCE
                int "Tolerance of number of critical temperature readings before rebooting"
                default 2
                help
                    If thermal loop reads a temperature that is higher than
                    the highest thermal state in thermal state table, it will
                    issue a software reboot.
                    This option prevents some flukes in the temperature readings.

            config PM_TM_DISABLE_NODE_CONFIG_OVERRIDE
                bool "Disable override of thermal states table values via Node_Config"
                default n
                help
                    Thermal states table(which is usually compiled into the Platform
                    Manager) can be overridden by writing the fields into Node_Config
                    OVSDB table. This option disables the ability to override the
                    default configuration values.

            menuconfig PM_ENABLE_FAN_DUTY_CYCLE
                bool "Enable duty cycling the fan based on time spent in a state"
                default n
                help
                    Select to include fan duty cycling as part of Thermal Management

                if PM_ENABLE_FAN_DUTY_CYCLE
                    config PM_TM_FAN_DUTY_CYCLE_ON_PERIOD
                        int "Fan duty cycle on period"
                        default 270
                        help
                            The amount of seconds the fan should be turned on in a state when
                            duty cycling for that state is enabled.

                    config PM_TM_FAN_DUTY_CYCLE_OFF_PERIOD
                        int "Fan duty cycle off period"
                        default 240
                        help
                            The amount of seconds the fan should be turned off in a state when
                            duty cycling for that state is enabled.

                    config PM_TM_FAN_DUTY_CYCLE_STATE_BITMASK
                        int "Bitmask of states in which the fan is duty cycled"
                        default 2
                        help
                            Fan duty cycling may be enabled in certain states and disabled in others.
                            When converted to binary, this integer value represents the states in which
                            it should be enabled. The binary value's bit indices starting from the right
                            correspond to states.
                endif
        endif


    config PM_ENABLE_LM
        bool "Enable support for Log Management"
        default y
        help
            Select to include log management as part of PM (Platform manager)

    menuconfig PM_ENABLE_OBJM
        bool "Enable support for Object Management"
        default n
        help
            Select to include Object management as part of PM (Platform manager)

        if PM_ENABLE_OBJM
            config PM_OBJM_DOWNLOAD_DIR
            string "Location of tmp download dir"
            default "/tmp/obj-dl"
            help
                Location of temporary folder where all the objects are downloaded before installing

            config PM_OBJM_INTEGRATED_DIR
            string "Location of pre integrated dir"
            default "$(INSTALL_PREFIX)/storage"
            help
                Location of preintegrated packages
        endif

    config PM_GW_OFFLINE_CFG
        bool "Enable support for GW offline config"
        default n
        help
            Ability to recover previously working ethernet connected POD acting as a GW
            on reboot with loss of Internet access with local HOME LAN service
            from stored subset of Cloud-provisioned OVSDB configuration.

    config PM_TS_CFG
        bool "Enable support for topology snapshot restore"
        default n
        help
            Ability to recover previously working wifi backhaul connection
            on node acting as a leaf on reboot.

    if PM_TS_CFG
        config PM_TS_RESTORE_TIMEOUT
            int "Timeout for restoring onboarding networks"
            default 90
            help
                When feature flag use_only_preferred_network is set or stored network is multiap then
                node temporary disables default onboard network to promote last connection only.
                Default value is 90 as this is value that should be sufficient to establish connection
                with counting DFS CAC waiting (60s CAC + 30s system connection).
                Integrators can finetune timeout using this option.
                As a fallback mechanism default network can be reenabled after timeout.
    endif

# Include options from vendor

    osource "vendor/*/src/pm/kconfig/Kconfig.managers"
endif
```

## src/pwm/kconfig/Kconfig.managers
```kconfig
menuconfig MANAGER_PWM
    bool "PW Manager (PWM)"
    default n
    help
        PWM (Public Wifi Manager) manages the broadcast
        of a public SSID on top of all radios

    config MANAGER_PWM_CFG
        depends on MANAGER_PWM
        string "PWM Startup configuration"
        default "pwm;true;needs_plan_b=true"
        help
            PW Manager startup configuration

    config DHCP_RELAY_OPTIONS_CONF
        depends on MANAGER_PWM
        string "PWM DHCP relay configuration"
        default "/tmp/dhcp_relay.conf"
        help
            PW Manager DHCP relay configuration

    config PWM_WAN_IF_NAME
        depends on MANAGER_PWM
        string "PWM WAN ifname configuration"
        default "br-wan"
        help
            PW Manager WAN ifname  configuration

    config PWM_BR_IF_NAME
        depends on MANAGER_PWM
        string "PWM bridge ifname configuration"
        default "br-pw"
        help
            PW Manager bridge ifname  configuration

    config PWM_ENTERPRISE_ID
        depends on MANAGER_PWM
        int "PWM entreprise id"
        default 9914
        help
            PW Manager entreprise id configuration
```
