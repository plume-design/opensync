## src/lib/osn/kconfig/Kconfig.osn.ipset_backend
```kconfig
config OSN_BACKEND_IPSET_NULL
    bool "Null"
    help
        Use a dummy ipset implementation.

        This option provides an stub implementation of the osn_ipset_t API.

config OSN_BACKEND_IPSET_LINUX
    bool "ipset"
    depends on OSN_BACKEND_FW_IPTABLES_FULL || OSN_BACKEND_FW_IPTABLES_THIN
    help
        Use the ipset generic Linux backend.

        This backend uses the `ipset` linux command to manage iptables
        ipsets. The target platform must provide the `ipset` command line
        utility.
```

## src/lib/osn/kconfig/Kconfig.osn.ipv4_backend
```kconfig
config OSN_BACKEND_IPV4_NULL
    bool "Null"

    help
        Use dummy implementation of IPv4 networking.

config OSN_BACKEND_IPV4_LINUX
    bool "Linux"
    select OSN_LINUX_ENABLED
    select OSN_LINUX_IP
    help
        Use the Linux IPv4 backend provided by OpenSync
```

## src/lib/osn/kconfig/Kconfig.osn.ipv6_backend
```kconfig
config OSN_BACKEND_IPV6_NULL
    bool "Null"

    help
        Use dummy implementation of IPv6 networking.

config OSN_BACKEND_IPV6_LINUX
    bool "Linux"
    select OSN_LINUX_ENABLED
    select OSN_LINUX_IPV6
    help
        Use the Linux IPv6 backend provided by OpenSync
```

## src/lib/osn/kconfig/Kconfig.osn.ipv6_radv_backend
```kconfig
config OSN_BACKEND_IPV6_RADV_NULL
    bool "Null"

    help
        Use dummy implementation of the IPv6 Router Advertisement server.

config OSN_BACKEND_IPV6_RADV_DNSMASQ6
    bool "dnsmasq6"
    select OSN_LINUX_ENABLED
    select OSN_DNSMASQ6
    help
        Use the dnsmasq backend provided by OpenSync
```

## src/lib/osn/kconfig/Kconfig.osn.lte_backend
```kconfig
config OSN_BACKEND_LTE_NULL
    bool "Null"
    help
        Use dummy LTE implementation for platforms where LTE functionality is
        not desired or not supported.

config OSN_BACKEND_LTE_LINUX
    bool "Linux"
    select OSN_LINUX_ENABLED
    select OSN_LINUX_LTE
    help
        Use the Linux LTE implementation that uses the Quectel app to initialize LTE interfaces.
```

## src/lib/osn/kconfig/Kconfig.osn.lte_modem_backend
```kconfig
config OSN_BACKEND_LTE_MODEM
    bool "Linux"
    select OSN_LINUX_ENABLED
    select OSN_LINUX_LTE_MODEM
    help
        Use the Linux LTE implementation.
```

## src/lib/osn/kconfig/Kconfig.osn.map_backend
```kconfig
config OSN_BACKEND_MAP_NULL
    bool "Null"

    help
        Use dummy implementation of MAP-T/MAP-E

config OSN_BACKEND_MAP_LINUX
    bool "MAP-T/MAP-E Linux backend"
    select OSN_LINUX_ENABLED
    help
        Use the Linux MAP-T/MAP-E backend provided by OpenSync
```

## src/lib/osn/kconfig/Kconfig.osn.map_v6plus
```kconfig
if OSN_BACKEND_MAP_LINUX
    menu "v6plus MAP-E Configuration"
        config OSN_MAP_V6PLUS_MANUFACTURER_CODE
            string "v6Plus Manufacturer code"
            default ""
            help
                v6Plus Manufacturer code string used to construct the URL
                for fetching MAP rules from a rule distribution server.
                The Kconfig-configured manufacturer code is used by default,
                unless overridden by OVSDB setting in MAP_Config.

                Manufacturer code is issued for each manufacturer,
                and universal for a product.
    endmenu
endif
```

## src/lib/osn/kconfig/Kconfig.osn.mapt_backend
```kconfig
config OSN_BACKEND_MAPT_NULL
    bool "Null"

    help
        Use dummy implementation of MAP-T

config OSN_BACKEND_MAPT_CERNET
    bool "CERNET"
    help
        Use the CERNET MAP-T implementation (typically found on BCM devices).

        https://github.com/cernet/MAP
```

## src/lib/osn/kconfig/Kconfig.osn.mld_backend
```kconfig
config OSN_BACKEND_MLD_NULL
    bool "Null"

    help
        Use dummy implementation of MLD networking.

config OSN_BACKEND_MLD_LINUX
    bool "Linux"
    select OSN_LINUX_ENABLED
    select OSN_LINUX_MLD
    help
        Use the Linux MLD backend provided by OpenSync
```

## src/lib/osn/kconfig/Kconfig.osn.netif_backend
```kconfig
config OSN_BACKEND_NETIF_NULL
    bool "Null"

    help
        Use dummy implementation of L2 interface control

config OSN_BACKEND_NETIF_LINUX
    bool "Linux"
    select OSN_LINUX_ENABLED
    select OSN_LINUX_NETIF
    help
        Use the Linux L2 network interface backend provided by OpenSync
```

## src/lib/osn/kconfig/Kconfig.osn.nflog_backend
```kconfig
config OSN_BACKEND_NFLOG_NULL
    bool "Null"

    help
        Use NFLOG dummy implementation

config OSN_BACKEND_NFLOG_LINUX
    bool "Linux"

    help
        Use the Linux NFLOG implementation that uses NETLINK sockets to capture
        NFLOG packets
```

## src/lib/osn/kconfig/Kconfig.osn.pppoe_backend
```kconfig
config OSN_BACKEND_PPPOE_NULL
    bool "Null"
    help
        Use dummy PPPoE implementation for platforms that do not support it.

config OSN_BACKEND_PPPOE_LINUX
    bool "Linux"
    select OSN_LINUX_ENABLED
    select OSN_LINUX_PPPOE
    help
        Use the Linux PPPoE implementation that uses the pppd daemon and the
        rp-pppoe plug-in.

config OSN_BACKEND_PPPOE_NAME_TEMPLATE
    string "PPPoE interface naming template"
    default "ppp-@P"
    help
        Customize the PPPoE interface naming with pre-defined variables.

        Pre-defined variables:
        @P represents the parent interface name
        @I represents the interface index

        The default is set to ppp-@P so the naming is ppp-eth1 for example.
```

## src/lib/osn/kconfig/Kconfig.osn.qdisc_backend
```kconfig
config OSN_BACKEND_QDISC_NULL
    bool "Null"

    help
        Use dummy implementation

config OSN_BACKEND_QDISC_LINUX
    bool "Linux"

    select OSN_LINUX_ENABLED
    select OSN_LINUX_QDISC
    help
        Enable the generic Linux qdisc-based QoS that uses the tc tool
        to configure interface qdiscs.
```

## src/lib/osn/kconfig/Kconfig.osn.qos_backend
```kconfig
config OSN_BACKEND_QOS_NULL
    bool "Null"

    help
        Use QoS dummy implementation

config OSN_BACKEND_QOS_LINUX
    bool "Linux"

    select OSN_LINUX_ENABLED
    select OSN_LINUX_QOS
    help
        Use the Linux QoS implementation that uses the tc tool to configure 
        interface qdiscs/queues.
```

## src/lib/osn/kconfig/Kconfig.osn.route_rule_backend
```kconfig
config OSN_BACKEND_ROUTE_RULE_NULL
    bool "Null"
    help
        Use dummy implementation of policy route rule

config OSN_BACKEND_ROUTE_RULE_LINUX
    bool "Linux"
    select OSN_LINUX_ENABLED
    select OSN_LINUX_ROUTE_RULE
    help
        Use the Linux backend implementation for policy routing rules provided by OpenSync
```

## src/lib/osn/kconfig/Kconfig.osn.routev4_backend
```kconfig
config OSN_BACKEND_ROUTEV4_NULL
    bool "Null"

    help
        Use dummy implementation of IPv4 route control

config OSN_BACKEND_ROUTEV4_LINUX
    bool "Linux"
    select OSN_LINUX_ENABLED
    help
        Use the Linux route control backend provided by OpenSync

        Please refer to OSN_LINUX_ROUTE_IP and OSN_LINUX_ROUTE_LIBNL3 to
        select between various available subsystems.
```

## src/lib/osn/kconfig/Kconfig.osn.routev6_backend
```kconfig
config OSN_BACKEND_ROUTEV6_NULL
    bool "Null"

    help
        Use dummy implementation of IPv6 route control

config OSN_BACKEND_ROUTEV6_LINUX
    bool "Linux"
    select OSN_LINUX_ENABLED
    help
        Use the Linux route control backend provided by OpenSync
```

## src/lib/osn/kconfig/Kconfig.osn.tap_backend
```kconfig
config OSN_BACKEND_TAP_NULL
    bool "Null"
    help
        Use dummy TAP interface operations for platforms where TAP interface is
        not desired or not supported.

config OSN_BACKEND_TAP_INTERFACE
    bool "Linux"
    select OSN_LINUX_TAPIF
    help
        Use the Linux TAP Interface backend provided by OpenSync.
```

## src/lib/osn/kconfig/Kconfig.osn.tc_backend
```kconfig
config OSN_BACKEND_TC_NULL
    bool "Null"

    help
        Use TC dummy implementation

config OSN_BACKEND_TC_LINUX
    bool "Linux"

    select OSN_LINUX_ENABLED
    select OSN_LINUX_TC
    help
        Use the Linux TC implementation that uses the tc tool to configure
        interface mirroring and redirecting traffic.
```

## src/lib/osn/kconfig/Kconfig.osn.tunnif_backend
```kconfig
config OSN_BACKEND_TUNNEL_IFACE_NULL
    bool "Null"
    help
        Use dummy implementation of tunnel interface

config OSN_BACKEND_TUNNEL_IFACE_LINUX
    bool "Linux"
    select OSN_LINUX_ENABLED
    select OSN_LINUX_TUNNEL_IFACE
    help
        Use the Linux tunnel interface backend provided by OpenSync
```

## src/lib/osn/kconfig/Kconfig.osn.upnp_backend
```kconfig
config OSN_BACKEND_UPNP_NULL
    bool "Null"

    help
        Use dummy implementation of UPnP.

config OSN_BACKEND_UPNP_MINIUPNPD
    bool "miniupnpd"
    select OSN_LINUX_ENABLED
    select OSN_MINIUPNPD
    help
        Use the Linux UPnP backend provided by OpenSync
```

## src/lib/osn/kconfig/Kconfig.osn.vlan_backend
```kconfig
config OSN_BACKEND_VLAN_NULL
    bool "Null"
    help
        Use dummy VLAN implementation for platforms where VLAN functionality is
        not desired or not supported.

config OSN_BACKEND_VLAN_LINUX
    bool "Linux"
    select OSN_LINUX_ENABLED
    select OSN_LINUX_VLAN
    help
        Use the Linux VLAN implementation that uses the iproute2 tool to create
        VLAN interfaces.
```

## src/lib/osn/kconfig/Kconfig.osn.vpn_backend
```kconfig
config OSN_BACKEND_VPN_NULL
    bool "Null"
    help
        Use dummy implementation of VPN

config OSN_BACKEND_VPN_LINUX
    bool "Linux"
    select OSN_LINUX_ENABLED
    select OSN_VPN
    help
        Use the Linux VPN backend provided by OpenSync
```

## src/lib/osp/kconfig/Kconfig.osp_ble.backend
```kconfig
config OSP_BLE_NULL
    bool "Null"

    help
        This backend implements a dummy implementation of the osp_ble API.
        All functions in this implementation return an error.
```
