## kconfig/Kconfig.osn.map_v6plus
```kconfig
# Include vendor's defaults first, if any:
osource "vendor/*/kconfig/Kconfig.osn.map_v6plus"

source "src/lib/osn/kconfig/Kconfig.osn.map_v6plus"
```

## kconfig/Kconfig.osn.mapt_backend
```kconfig
#
# OpenSync core MAP-T backends
#
source "src/lib/osn/kconfig/Kconfig.osn.mapt_backend"

#
# Platform/vendor MAP-T backends
#
osource "platform/*/kconfig/Kconfig.osn.mapt_backend"
osource "vendor/*/kconfig/Kconfig.osn.mapt_backend"
```

## kconfig/Kconfig.osn.mld_backend
```kconfig
#
# OpenSync core network MLD backend
#
source "src/lib/osn/kconfig/Kconfig.osn.mld_backend"

#
# Platform/vendor MLD backends
#
osource "platform/*/kconfig/Kconfig.osn.mld_backend"
osource "vendor/*/kconfig/Kconfig.osn.mld_backend"
```

## kconfig/Kconfig.osn.netif_backend
```kconfig
#
# OpenSync core network interface backend
#
source "src/lib/osn/kconfig/Kconfig.osn.netif_backend"

#
# Platform/vendor network interface backends
#
osource "platform/*/kconfig/Kconfig.osn.netif_backend"
osource "vendor/*/kconfig/Kconfig.osn.netif_backend"
```

## kconfig/Kconfig.osn.nflog_backend
```kconfig
#
# OpenSync core network NFLOG backend
#
source "src/lib/osn/kconfig/Kconfig.osn.nflog_backend"

#
# Platform/vendor NFLOG backends
#
osource "platform/*/kconfig/Kconfig.osn.nflog_backend"
osource "vendor/*/kconfig/Kconfig.osn.nflog_backend"
```

## kconfig/Kconfig.osn.pppoe_backend
```kconfig
#
# OpenSync core network PPPoE backend
#
source "src/lib/osn/kconfig/Kconfig.osn.pppoe_backend"

#
# Platform/vendor PPPoE backends
#
osource "platform/*/kconfig/Kconfig.osn.pppoe_backend"
osource "vendor/*/kconfig/Kconfig.osn.pppoe_backend"
```

## kconfig/Kconfig.osn.qdisc_backend
```kconfig
#
# OpenSync core network Generic Linux qdisc-based QoS backend
#
source "src/lib/osn/kconfig/Kconfig.osn.qdisc_backend"

#
# Platform/vendor QoS backends
#
osource "platform/*/kconfig/Kconfig.osn.qdisc_backend"
osource "vendor/*/kconfig/Kconfig.osn.qdisc_backend"
```

## kconfig/Kconfig.osn.qos_backend
```kconfig
#
# OpenSync core network QoS backend
#
source "src/lib/osn/kconfig/Kconfig.osn.qos_backend"

#
# Platform/vendor QoS backends
#
osource "platform/*/kconfig/Kconfig.osn.qos_backend"
osource "vendor/*/kconfig/Kconfig.osn.qos_backend"
```

## kconfig/Kconfig.osn.route_rule_backend
```kconfig
#
# OpenSync core policy routing rules backend
#
source "src/lib/osn/kconfig/Kconfig.osn.route_rule_backend"

#
# Platform/vendor policy routing rules backend, if any
#
osource "platform/*/kconfig/Kconfig.osn.route_rule_backend"
osource "vendor/*/kconfig/Kconfig.osn.route_rule_backend"
```

## kconfig/Kconfig.osn.routev4_backend
```kconfig
#
# OpenSync core IPv4 route reporting backend
#
source "src/lib/osn/kconfig/Kconfig.osn.routev4_backend"

#
# Platform/vendor IPv4 route reporting backend
#
osource "platform/*/kconfig/Kconfig.osn.routev4_backend"
osource "vendor/*/kconfig/Kconfig.osn.routev4_backend"
```

## kconfig/Kconfig.osn.routev6_backend
```kconfig
#
# OpenSync core IPv6 route reporting backend
#
source "src/lib/osn/kconfig/Kconfig.osn.routev6_backend"

#
# Platform/vendor IPv6 route reporting backend
#
osource "platform/*/kconfig/Kconfig.osn.routev6_backend"
osource "vendor/*/kconfig/Kconfig.osn.routev6_backend"
```

## kconfig/Kconfig.osn.tap_backend
```kconfig
#
# OpenSync core TAP interface backend
#
source "src/lib/osn/kconfig/Kconfig.osn.tap_backend"

#
# Platform/vendor TAP interface backends
#
osource "platform/*/kconfig/Kconfig.osn.tap_backend"
osource "vendor/*/kconfig/Kconfig.osn.tap_backend"
```

## kconfig/Kconfig.osn.tc_backend
```kconfig
#
# OpenSync core network TC backend
#
source "src/lib/osn/kconfig/Kconfig.osn.tc_backend"

#
# Platform/vendor TC backends
#
osource "platform/*/kconfig/Kconfig.osn.tc_backend"
osource "vendor/*/kconfig/Kconfig.osn.tc_backend"
```

## kconfig/Kconfig.osn.tunnif_backend
```kconfig
#
# core tunnel interface backends
#
source "src/lib/osn/kconfig/Kconfig.osn.tunnif_backend"

#
# platform/vendor tunnel interface backends, if any
#
osource "platform/*/kconfig/Kconfig.osn.tunnif_backend"
osource "vendor/*/kconfig/Kconfig.osn.tunnif_backend"
```

## kconfig/Kconfig.osn.upnp_backend
```kconfig
#
# OpenSync core UPnP backend
#
source "src/lib/osn/kconfig/Kconfig.osn.upnp_backend"

#
# Platform/vendor UPnP backends
#
osource "platform/*/kconfig/Kconfig.osn.upnp_backend"
osource "vendor/*/kconfig/Kconfig.osn.upnp_backend"
```

## kconfig/Kconfig.osn.vlan_backend
```kconfig
#
# OpenSync core network VLAN backend
#
source "src/lib/osn/kconfig/Kconfig.osn.vlan_backend"

#
# Platform/vendor VLAN backends
#
osource "platform/*/kconfig/Kconfig.osn.vlan_backend"
osource "vendor/*/kconfig/Kconfig.osn.vlan_backend"
```

## kconfig/Kconfig.osn.vpn_backend
```kconfig
#
# core VPN backends
#
source "src/lib/osn/kconfig/Kconfig.osn.vpn_backend"

#
# platform/vendor VPN backends, if any
#
osource "platform/*/kconfig/Kconfig.osn.vpn_backend"
osource "vendor/*/kconfig/Kconfig.osn.vpn_backend"
```

## kconfig/Kconfig.osp_ble.backend
```kconfig
#
# Vendor OSP Bluetooth backends (default, if available)
#
osource "vendor/*/kconfig/Kconfig.osp_ble.backend"

#
# Platform OSP Bluetooth backends
#
osource "platform/*/kconfig/Kconfig.osp_ble.backend"

#
# OpenSync core platform OSP Bluetooth backend
#
source "src/lib/osp/kconfig/Kconfig.osp_ble.backend"
```

## kconfig/Kconfig.osp_dl
```kconfig
#
# OpenSync core network Firewall
#
source "src/lib/osp/kconfig/Kconfig.osp_dl"

#
# Platform/vendor Firewall
#
osource "platform/*/kconfig/Kconfig.osp_dl"
osource "vendor/*/kconfig/Kconfig.osp_dl"
```

## kconfig/Kconfig.osp_dl.backend
```kconfig
#
# OpenSync core network interface backend
#
source "src/lib/osp/kconfig/Kconfig.osp_dl.backend"

#
# Platform/vendor network interface backends
#
osource "platform/*/kconfig/Kconfig.osp_dl.backend"
osource "vendor/*/kconfig/Kconfig.osp_dl.backend"
```

## kconfig/Kconfig.osp_l2switch
```kconfig
#
# OpenSync core network Firewall
#
source "src/lib/osp/kconfig/Kconfig.osp_l2switch"

#
# Platform/vendor Firewall
#
osource "platform/*/kconfig/Kconfig.osp_l2switch"
osource "vendor/*/kconfig/Kconfig.osp_l2switch"
```

## kconfig/Kconfig.osp_l2switch.backend
```kconfig
#
# OpenSync core platform l2switch backend
#
source "src/lib/osp/kconfig/Kconfig.osp_l2switch.backend"

#
# Platform/vendor L2 switch backens
#
osource "platform/*/kconfig/Kconfig.osp_l2switch.backend"
osource "vendor/*/kconfig/Kconfig.osp_l2switch.backend"
```

## kconfig/Kconfig.osp_l2uf
```kconfig
#
# OpenSync core l2uf
#
source "src/lib/osp/kconfig/Kconfig.osp_l2uf"

#
# Platform/vendor l2uf
#
osource "platform/*/kconfig/Kconfig.osp_l2uf"
osource "vendor/*/kconfig/Kconfig.osp_l2uf"
```

## kconfig/Kconfig.osp_l2uf.backend
```kconfig
#
# OpenSync core platform l2uf backend
#
source "src/lib/osp/kconfig/Kconfig.osp_l2uf.backend"

#
# Platform/vendor L2UF backens
#
osource "platform/*/kconfig/Kconfig.osp_l2uf.backend"
osource "vendor/*/kconfig/Kconfig.osp_l2uf.backend"
```

## kconfig/Kconfig.osp_led
```kconfig
#
# OpenSync core platform OSP LED
#
source "src/lib/osp/kconfig/Kconfig.osp_led"

#
# Platform/vendor OSP LED
#
osource "platform/*/kconfig/Kconfig.osp_led"
osource "vendor/*/kconfig/Kconfig.osp_led"
```
