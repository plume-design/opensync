## kconfig/Kconfig.osp_objm
```kconfig
#
# Include core OSP OBJM modules
#
source "src/lib/osp/kconfig/Kconfig.osp_objm"

#
# Include platform/vendor OSP OBJM modules
#
osource "platform/*/kconfig/Kconfig.osp_objm"
osource "vendor/*/kconfig/Kconfig.osp_objm"
```

## kconfig/Kconfig.osp_objm.backend
```kconfig
#
# Core OBJM modules
#
source "src/lib/osp/kconfig/Kconfig.osp_objm.backend"

#
# Vendor/Platform OBMJ modules
#
osource "platform/*/kconfig/Kconfig.osp_objm.backend"
osource "vendor/*/kconfig/Kconfig.osp_objm.backend"
```

## kconfig/Kconfig.osp_otbr
```kconfig
#
# Vendor OSP OTBR configuration
#
osource "vendor/*/kconfig/Kconfig.osp_otbr"

#
# Platform OSP OTBR backends
#
osource "platform/*/kconfig/Kconfig.osp_otbr"

#
# OpenSync core platform OSP OTBR configuration
#
osource "src/lib/osp/kconfig/Kconfig.osp_otbr"
```

## kconfig/Kconfig.osp_otbr.backend
```kconfig
#
# Vendor OSP OTBR backends (default, if available)
#
osource "vendor/*/kconfig/Kconfig.osp_otbr.backend"

#
# Platform OSP OTBR backends
#
osource "platform/*/kconfig/Kconfig.osp_otbr.backend"

#
# OpenSync core platform OSP OTBR backend
#
source "src/lib/osp/kconfig/Kconfig.osp_otbr.backend"
```

## kconfig/Kconfig.osp_pki
```kconfig
#
# OpenSync Public Key Infrastructure
#
source "src/lib/osp/kconfig/Kconfig.osp_pki"

#
# Platform/vendor Public Key Infrastructure
#
osource "platform/*/kconfig/Kconfig.osp_pki"
osource "vendor/*/kconfig/Kconfig.osp_pki"
```

## kconfig/Kconfig.osp_pki.backend
```kconfig
#
# OpenSync Public Key Infrastructure
#
source "src/lib/osp/kconfig/Kconfig.osp_pki.backend"

#
# Platform/vendor Public Key Infrastructure
#
osource "platform/*/kconfig/Kconfig.osp_pki.backend"
osource "vendor/*/kconfig/Kconfig.osp_pki.backend"
```

## kconfig/Kconfig.osp_power.backend
```kconfig
#
# include core modules
#
source "src/lib/osp/kconfig/Kconfig.osp_power.backend"

menuconfig POE_ENABLED
    bool "Enable PoE Support"
    depends on OSP_POWER
    default n
    help
        Enable if platform supports PoE

    config POE_PORT_IFNAME
        depends on POE_ENABLED
        string "PoE Port Interface Name"
        default "eth1"
        help
            Name of interface associated to the port which supports PoE

#
# include platform/vendor modules
#
osource "platform/*/kconfig/Kconfig.osp_power.backend"
osource "vendor/*/kconfig/Kconfig.osp_power.backend"
```

## kconfig/Kconfig.osp_ps
```kconfig
#
# Include core OSP PS modules
#
source "src/lib/osp/kconfig/Kconfig.osp_ps"

#
# Include platform/vendor OSP PS modules
#
osource "platform/*/kconfig/Kconfig.osp_ps"
osource "vendor/*/kconfig/Kconfig.osp_ps"
```

## kconfig/Kconfig.osp_ps.backend
```kconfig
#
# Core PS modules
#
source "src/lib/osp/kconfig/Kconfig.osp_ps.backend"

#
# Vendor/Platform PS modules
#
osource "platform/*/kconfig/Kconfig.osp_ps.backend"
osource "vendor/*/kconfig/Kconfig.osp_ps.backend"
```

## kconfig/Kconfig.osp_reboot
```kconfig
#
# Include core modules
#
source "src/lib/osp/kconfig/Kconfig.osp_reboot"
source "src/tools/preboot/kconfig/Kconfig.osp_reboot"


#
# Platform/vendor modules
#
osource "platform/*/kconfig/Kconfig.osp_reboot"
osource "vendor/*/kconfig/Kconfig.osp_reboot"
```

## kconfig/Kconfig.osp_reboot.backend
```kconfig
#
# include core modules
#
source "src/lib/osp/kconfig/Kconfig.osp_reboot.backend"

#
# include platform/vendor modules
#
osource "platform/*/kconfig/Kconfig.osp_reboot.backend"
osource "vendor/*/kconfig/Kconfig.osp_reboot.backend"
```

## kconfig/Kconfig.osp_sec
```kconfig
#
# Include core OSP SEC modules
#
source "src/lib/osp/kconfig/Kconfig.osp_sec"

#
# Include platform/vendor OSP SEC modules
#
osource "platform/*/kconfig/Kconfig.osp_sec"
osource "vendor/*/kconfig/Kconfig.osp_sec"
```

## kconfig/Kconfig.osp_sec.backend
```kconfig
#
# Core SEC modules
#
source "src/lib/osp/kconfig/Kconfig.osp_sec.backend"

#
# vendor/platform SEC modules
#
osource "platform/*/kconfig/Kconfig.osp_sec.backend"
osource "vendor/*/kconfig/Kconfig.osp_sec.backend"
```

## kconfig/Kconfig.osp_tm
```kconfig
#
# OpenSync core platform OSP TM
#
source "src/lib/osp/kconfig/Kconfig.osp_tm"

#
# Platform/vendor OSP TM
#
osource "platform/*/kconfig/Kconfig.osp_tm"
osource "vendor/*/kconfig/Kconfig.osp_tm"
```

## kconfig/Kconfig.osp_tm_sensors.backend
```kconfig
#
# Vendor OSP temperature sensors backends (default, if available)
#
osource "vendor/*/kconfig/Kconfig.osp_tm_sensors.backend"

#
# Platform OSP temperature sensors backends
#
osource "platform/*/kconfig/Kconfig.osp_tm_sensors.backend"

#
# OpenSync core platform OSP temperature sensors backend
#
source "src/lib/osp/kconfig/Kconfig.osp_tm_sensors.backend"
```

## kconfig/Kconfig.osp_unit.backend
```kconfig
#
# OpenSync core platform OSP Unit backend
#
source "src/lib/osp/kconfig/Kconfig.osp_unit.backend"

#
# Platform/vendor OSP Unit backends
#
osource "platform/*/kconfig/Kconfig.osp_unit.backend"
osource "vendor/*/kconfig/Kconfig.osp_unit.backend"
```

## kconfig/Kconfig.osp_upg
```kconfig
#
# OpenSync core network Firewall
#
source "src/lib/osp/kconfig/Kconfig.osp_upg"

#
# Platform/vendor Firewall
#
osource "platform/*/kconfig/Kconfig.osp_upg"
osource "vendor/*/kconfig/Kconfig.osp_upg"
```

## kconfig/Kconfig.osp_upg.backend
```kconfig
#
# OpenSync core network interface backend
#
source "src/lib/osp/kconfig/Kconfig.osp_upg.backend"

#
# Platform/vendor network interface backends
#
osource "platform/*/kconfig/Kconfig.osp_upg.backend"
osource "vendor/*/kconfig/Kconfig.osp_upg.backend"
```

## kconfig/Kconfig.services
```kconfig
menuconfig SERVICE_HEALTHCHECK
    bool "Healthcheck Service"
    default y
    help
        A set of scripts that check the health of the system and
        reboot the system in case of repeated errors or fatal failure
```

## kconfig/Kconfig.tools
```kconfig
#
# Include common tools configs
#
source "src/tools/osps/kconfig/Kconfig.tools"

#
# Include platform/vendor specific tool configs
#
osource "platform/*/kconfig/Kconfig.tools"
osource "vendor/*/kconfig/Kconfig.tools"
```

## ovsdb/Kconfig
```kconfig
menuconfig OVSDB_BOOTSTRAP
    bool "OVSDB extender bootstrap"
    default n
    help
        Select if you want to have a bootstrappable extender
        device. Extenders need to onboard themselves every
        time they boot - this includes finding a suitable
        internet-reachable uplink, connecting to cloud
        controller and eventually getting configured.

        Make sure to set up all the other OVSDB_BOOTSTRAP_
        knobs.

    if OVSDB_BOOTSTRAP
        config OVSDB_BOOTSTRAP_WIFI_PHY_LIST
            string "List of radio interfaces"
            default ""
            help
                The list must be space delimited and each item
                must take the format of

                  phy:chainmask:htmode:hwmode:freqband:hwtype:arg1=val1,arg2=val2:bct_int

                Values can be encapsulated with "" to express
                strings. These may not contain spaces, : or =

                The extra arg=value at the end are used to
                populate hw_config column.

                Example:
                  wifi0:240:HT80:11ax:5G:qca8074:dfs_usenol=\"1\",dfs_ignorecac=\"0\",dfs_enable=\"1\":100 wifi1:3:HT40:11ax:2.4G:qca8074::200

        config OVSDB_BOOTSTRAP_WIFI_STA_LIST
            string "List of wireless sta interfaces"
            default ""
            help
                The list must be space delimited and each item
                must take the format of

                  phy:vif

                When extender boots up it will have its ovsdb
                pre-populated with some values so that it can
                bootstrap itself and reach external controller.

                Example:

                  wifi0:bhaul-sta-24 wifi1:bhaul-sta-50

        config OVSDB_BOOTSTRAP_WIFI_STA_MTU
            int "MTU size to use for the wireless station netdevs"
            default 1600
            help
                Wireless onboarding involves GRE. While this may
                change in the future current systems must
                account for extra 42 bytes at least: 38 for
                gretap and 4 for 802.1q.

                The default value of 1600 is generous and hopes
                to avoid off-by-one or other system quirks where
                mtu calculation is broken.
    endif
```

## rootfs/kconfig/Kconfig.services
```kconfig
config HEALTHCHECK_HOSTAPD_WPA_SUPPLICANT
    bool "Hostapd and wpa_supplicant healthcheck routine"
    default n
    help
        Checks for hostapd and wpa_supplicant global instance process existence.
```

## src/blem/kconfig/Kconfig.managers
```kconfig
menuconfig MANAGER_BLEM
    bool "Bluetooth Manager (BLEM)"
    default n
    help
        Bluetooth Manager (BLEM) manages everything Bluetooth related, from
        BLE beaconing for onboarding to connectable mode for editing persistent
        configuration via BLE.

if MANAGER_BLEM
    config MANAGER_BLEM_CFG
        string "BLEM Startup configuration"
        default "blem;true;needs_plan_b=false"
        help
            Bluetooth Manager startup configuration

    config BLEM_ADVERTISING_INTERVAL
        int "Interval of advertising BLE beacons (in ms)"
        default 250
        help
            Interval of advertising BT LE beacons (in milliseconds).
            On some devices there is a separate antenna for Bluetooth so the
            beaconing frequency can be increased (100 ms interval), but on
            devices using shared antenna for Wi-Fi and Bluetooth (BT
            coexistence) this interval shall be kept higher (250 ms).

    config BLEM_MANUFACTURER_DATA_COMPANY_ID
        hex "Advertised Manufacturer Data - Company ID"
        default 0x0A17
        help
            Bluetooth beacons contain Manufacturer Data field, which has
            a mandatory Company ID value - each BT advertisement packet
            can contain multiple sets of Manufacturer Data, that is why
            each MD field has a mandatory 16-bit Company ID value.
            As example, 0x0A17 is officially assigned to Plume Design Inc..

    config BLEM_GATT_SERVICE_UUID
        hex "Advertised 16-bit Service UUID"
        default 0xFE71
        help
            This value will be advertised as the Complete list of 16-bit Service UUIDs
            in the BLE advertisement packets.
            0xFE71 is assigned to Plume Design Inc. by the Bluetooth SIG.

    menu "Advertise 'Pod <serial number>' as device name in BLE beacons"
        config BLEM_ADVERTISE_NAME_WHEN_BROADCASTING
            bool "Advertise name when advertising as non-connectable (BLE Broadcaster role)"
            default n
            help
                If enabled, then serial number in form of "Pod <sn>" is advertised in Scan Response
                BLE packets when device is advertising in broadcaster role (non-connectable beaconing),
                causing it to be visible in BLE scanners as normal BLE peripheral device.

        config BLEM_ADVERTISE_NAME_WHEN_CONNECTABLE
            bool "Advertise name when advertising as connectable (BLE Peripheral role)"
            depends on BLEM_CONFIG_VIA_BLE_ENABLED
            default y
            help
                If enabled, then serial number in form of "Pod <sn>" is advertised in Scan Response
                BLE packets when device is advertising in peripheral role (connectable mode),
                causing it to be visible in BLE scanners as normal BLE peripheral device.
                This is usually required so the users are able to connect to the device.
    endmenu

    config BLEM_CONFIG_VIA_BLE_ENABLED
        bool "Enable support for connectable mode for editing persistent configuration via BLE"
        default n
        help
            If enabled, device supports entering BLE Peripheral role, enabling BLE Central
            devices (usually smartphone) to connect to it and edit persistent WAN configuration
            via Plume Design Inc. JSON service (0xFE71).

endif
```

## src/bm/kconfig/Kconfig.managers
```kconfig
menuconfig MANAGER_BM
    bool "Band-steering Manager (BM)"
    default n
    help
        Enable Band-steering Manager (BM)

    config MANAGER_BM_CFG
        depends on MANAGER_BM
        string "BM Startup configuration"
        default "bm;true"
        help
            Band-steering Manager startup configuration
```

## src/cm2/kconfig/Kconfig
```kconfig
config PLUME_CM2_DISABLE_DRYRUN_ON_GRE
    bool "Disable udhcpc dryrun on gre interfaces"
    default n
    help
        Skip running dryrun on gre interfaces.
```
