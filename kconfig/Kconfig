## kconfig/Kconfig.osn.adaptive_qos_backend
```kconfig
#
# OpenSync core Adaptive QoS backend
#
source "src/lib/osn/kconfig/Kconfig.osn.adaptive_qos_backend"

#
# Platform/vendor Adaptive QoS backends, if any
#
osource "platform/*/kconfig/Kconfig.osn.adaptive_qos_backend"
osource "vendor/*/kconfig/Kconfig.osn.adaptive_qos_backend"
```

## kconfig/Kconfig.osn.bridging_backend
```kconfig
#
# OpenSync core network Bridge backend
#
source "src/lib/osn/kconfig/Kconfig.osn.bridging_backend"

#
# Platform/vendor Bridge backends
#
osource "platform/*/kconfig/Kconfig.osn.bridging_backend"
osource "vendor/*/kconfig/Kconfig.osn.bridging_backend"
```

## kconfig/Kconfig.osn.cell_backend
```kconfig
#
# OpenSync core network CELL backend
#
source "src/lib/osn/kconfig/Kconfig.osn.cell_backend"

#
# Platform/vendor CELL backends
#
osource "platform/*/kconfig/Kconfig.osn.cell_backend"
osource "vendor/*/kconfig/Kconfig.osn.cell_backend"
```

## kconfig/Kconfig.osn.dhcpv4_client_backend
```kconfig
#
# OpenSync core DHCPv4 client backend
#
source "src/lib/osn/kconfig/Kconfig.osn.dhcpv4_client_backend"

#
# Platform/vendor DHCPv4 client backends
#
osource "platform/*/kconfig/Kconfig.osn.dhcpv4_client_backend"
osource "vendor/*/kconfig/Kconfig.osn.dhcpv4_client_backend"
```

## kconfig/Kconfig.osn.dhcpv4_server_backend
```kconfig
#
# OpenSync core DHCPv4 server backend
#
source "src/lib/osn/kconfig/Kconfig.osn.dhcpv4_server_backend"

#
# Platform/vendor DHCPv4 server backends
#
osource "platform/*/kconfig/Kconfig.osn.dhcpv4_server_backend"
osource "vendor/*/kconfig/Kconfig.osn.dhcpv4_server_backend"
```

## kconfig/Kconfig.osn.dhcpv6_client_backend
```kconfig
#
# OpenSync core DHCPv6 client backend
#
source "src/lib/osn/kconfig/Kconfig.osn.dhcpv6_client_backend"

#
# Platform/vendor DHCPv6 client backends
#
osource "platform/*/kconfig/Kconfig.osn.dhcpv6_client_backend"
osource "vendor/*/kconfig/Kconfig.osn.dhcpv6_client_backend"
```

## kconfig/Kconfig.osn.dhcpv6_server_backend
```kconfig
#
# OpenSync core DHCPv6 server backend
#
source "src/lib/osn/kconfig/Kconfig.osn.dhcpv6_server_backend"

#
# Platform/vendor DHCPv6 server backends
#
osource "platform/*/kconfig/Kconfig.osn.dhcpv6_server_backend"
osource "vendor/*/kconfig/Kconfig.osn.dhcpv6_server_backend"
```

## kconfig/Kconfig.osn.fw
```kconfig
#
# OpenSync core network Firewall
#
source "src/lib/osn/kconfig/Kconfig.osn.fw"

#
# Platform/vendor Firewall
#
osource "platform/*/kconfig/Kconfig.osn.fw"
osource "vendor/*/kconfig/Kconfig.osn.fw"
```

## kconfig/Kconfig.osn.fw_backend
```kconfig
#
# OpenSync core network Firewall backend
#
source "src/lib/osn/kconfig/Kconfig.osn.fw_backend"

#
# Platform/vendor Firewall backends
#
osource "platform/*/kconfig/Kconfig.osn.fw_backend"
osource "vendor/*/kconfig/Kconfig.osn.fw_backend"
```

## kconfig/Kconfig.osn.fw_eb_backend
```kconfig
config OSN_BACKEND_FW_EBTABLES_FULL
    bool "ebtables full"
    help
        Use the ebtables full backend.

        This implementation uses the ebtables-restore command to apply firewall
        rules and fully takes control over system firewall configuration. This
        means that any rules that were not applied via this API will be
        destroyed. This allows for tighter control of firewall rules and
        guarantees atomicity.

config OSN_BACKEND_FW_EBTABLES_THIN
    bool "ebtables thin"
    help
        Use the ebtables thin backend.

        As opposed to the full implementation, the thin implementation uses the
        standard `ebtables` command to manipulate firewall rules. It works on a
        ebtables chain scope, meaning that it does not touch tables or chains
        that are not referenced in the Netfilter table.

        Use this option when you just want NFM to manage selected chains instead
        of the global firewall configuration.
```

## kconfig/Kconfig.osn.igmp_backend
```kconfig
#
# OpenSync core network IGMP backend
#
source "src/lib/osn/kconfig/Kconfig.osn.igmp_backend"

#
# Platform/vendor IGMP backends
#
osource "platform/*/kconfig/Kconfig.osn.igmp_backend"
osource "vendor/*/kconfig/Kconfig.osn.igmp_backend"
```

## kconfig/Kconfig.osn.ipsec_backend
```kconfig
#
# core IPsec backends
#
source "src/lib/osn/kconfig/Kconfig.osn.ipsec_backend"

#
# platform/vendor IPsec backends, if any
#
osource "platform/*/kconfig/Kconfig.osn.ipsec_backend"
osource "vendor/*/kconfig/Kconfig.osn.ipsec_backend"
```

## kconfig/Kconfig.osn.ipset_backend
```kconfig
#
# OpenSync core network ipset backend
#
source "src/lib/osn/kconfig/Kconfig.osn.ipset_backend"

#
# Platform/vendor ipset backends
#
osource "platform/*/kconfig/Kconfig.osn.ipset_backend"
osource "vendor/*/kconfig/Kconfig.osn.ipset_backend"
```

## kconfig/Kconfig.osn.ipv4_backend
```kconfig
#
# OpenSync core IPv4 networking backend
#
source "src/lib/osn/kconfig/Kconfig.osn.ipv4_backend"

#
# Platform/vendor IPv4 networking backends
#
osource "platform/*/kconfig/Kconfig.osn.ipv4_backend"
osource "vendor/*/kconfig/Kconfig.osn.ipv4_backend"
```

## kconfig/Kconfig.osn.ipv6_backend
```kconfig
#
# OpenSync core IPv4 networking backend
#
source "src/lib/osn/kconfig/Kconfig.osn.ipv6_backend"

#
# Platform/vendor IPv4 networking backends
#
osource "platform/*/kconfig/Kconfig.osn.ipv6_backend"
osource "vendor/*/kconfig/Kconfig.osn.ipv6_backend"
```

## kconfig/Kconfig.osn.ipv6_radv_backend
```kconfig
#
# OpenSync core DHCPv6 server backend
#
source "src/lib/osn/kconfig/Kconfig.osn.ipv6_radv_backend"

#
# Platform/vendor DHCPv6 server backends
#
osource "platform/*/kconfig/Kconfig.osn.ipv6_radv_backend"
osource "vendor/*/kconfig/Kconfig.osn.ipv6_radv_backend"
```

## kconfig/Kconfig.osn.lte_backend
```kconfig
#
# OpenSync core network LTE backend
#
source "src/lib/osn/kconfig/Kconfig.osn.lte_backend"

#
# Platform/vendor LTE backends
#
osource "platform/*/kconfig/Kconfig.osn.lte_backend"
osource "vendor/*/kconfig/Kconfig.osn.lte_backend"
```

## kconfig/Kconfig.osn.lte_modem_backend
```kconfig
#
# OpenSync core network LTE modem backend
#
source "src/lib/osn/kconfig/Kconfig.osn.lte_modem_backend"

#
# Platform/vendor LTE backends
#
osource "platform/*/kconfig/Kconfig.osn.lte_modem_backend"
osource "vendor/*/kconfig/Kconfig.osn.lte_modem_backend"
```

## kconfig/Kconfig.osn.map_backend
```kconfig
source "src/lib/osn/kconfig/Kconfig.osn.map_backend"

osource "platform/*/kconfig/Kconfig.osn.map_backend"
osource "vendor/*/kconfig/Kconfig.osn.map_backend"
```
