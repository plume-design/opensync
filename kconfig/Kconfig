## kconfig/Kconfig
```kconfig
mainmenu "OpenSync Configuration"

menu "Common"
    menu "Managers"
        source "kconfig/Kconfig.managers"
    endmenu

    menu "Services"
        source "kconfig/Kconfig.services"
    endmenu

    menu "OpenSync API"
        menu "Networking (OSN)"
            choice
                prompt "Interface L2 control"
                default OSN_BACKEND_NETIF_LINUX
                source "kconfig/Kconfig.osn.netif_backend"
            endchoice

            choice
                prompt "IPv4 networking"
                default OSN_BACKEND_IPV4_LINUX
                source "kconfig/Kconfig.osn.ipv4_backend"
            endchoice

            choice
                prompt "IPv4 routing (control and reporting)"
                default OSN_BACKEND_ROUTEV4_LINUX
                source "kconfig/Kconfig.osn.routev4_backend"
            endchoice

            choice
                prompt "DHCPv4 client"
                default OSN_BACKEND_DHCPV4_CLIENT_UDHCP
                source "kconfig/Kconfig.osn.dhcpv4_client_backend"
            endchoice

            choice
                prompt "DHCPv4 server"
                default OSN_BACKEND_DHCPV4_SERVER_DNSMASQ
                source "kconfig/Kconfig.osn.dhcpv4_server_backend"
            endchoice

            choice
                prompt "UPnP"
                default OSN_BACKEND_UPNP_MINIUPNPD
                source "kconfig/Kconfig.osn.upnp_backend"
            endchoice

            choice
                prompt "IPv6 networking"
                default OSN_BACKEND_IPV6_LINUX
                source "kconfig/Kconfig.osn.ipv6_backend"
            endchoice

            choice
                prompt "IPv6 routing (control and reporting)"
                default OSN_BACKEND_ROUTEV6_LINUX
                source "kconfig/Kconfig.osn.routev6_backend"
            endchoice

            choice
                prompt "DHCPv6 client"
                default OSN_BACKEND_DHCPV6_CLIENT_ODHCP6
                source "kconfig/Kconfig.osn.dhcpv6_client_backend"
            endchoice

            choice
                prompt "DHCPv6 server"
                default OSN_BACKEND_DHCPV6_SERVER_DNSMASQ6
                source "kconfig/Kconfig.osn.dhcpv6_server_backend"
            endchoice

            choice
                prompt "IPv6 Router Advertisement"
                default OSN_BACKEND_IPV6_RADV_DNSMASQ6
                source "kconfig/Kconfig.osn.ipv6_radv_backend"
            endchoice

            choice
                prompt "PPPoE"
                default OSN_BACKEND_PPPOE_LINUX
                source "kconfig/Kconfig.osn.pppoe_backend"
            endchoice

            choice
                prompt "VLAN"
                default OSN_BACKEND_VLAN_LINUX
                source "kconfig/Kconfig.osn.vlan_backend"
            endchoice

            choice
                prompt "IGMP"
                default OSN_BACKEND_IGMP_LINUX
                source "kconfig/Kconfig.osn.igmp_backend"
            endchoice

            choice
                prompt "MLD"
                default OSN_BACKEND_MLD_LINUX
                source "kconfig/Kconfig.osn.mld_backend"
            endchoice

            choice
                prompt "QoS"
                default OSN_BACKEND_QOS_LINUX
                source "kconfig/Kconfig.osn.qos_backend"
            endchoice

            choice
                prompt "Qdisc QoS"
                default OSN_BACKEND_QDISC_LINUX
                source "kconfig/Kconfig.osn.qdisc_backend"
            endchoice

            choice
                prompt "Adaptive QoS"
                default OSN_BACKEND_ADAPTIVE_QOS_NULL
                source "kconfig/Kconfig.osn.adaptive_qos_backend"
            endchoice

            choice
                prompt "Packet Classifier"
                default OSN_BACKEND_TC_LINUX
                source "kconfig/Kconfig.osn.tc_backend"
            endchoice

            choice
                prompt "Native Bridge"
                default OSN_BACKEND_LINUX_BRIDGING
                source "kconfig/Kconfig.osn.bridging_backend"
            endchoice

            choice
                prompt "TAP Interface"
                default OSN_BACKEND_TAP_INTERFACE
                source "kconfig/Kconfig.osn.tap_backend"
            endchoice

            choice
                prompt "NFLOG"
                default OSN_BACKEND_NFLOG_LINUX
                source "kconfig/Kconfig.osn.nflog_backend"
            endchoice

            choice
                prompt "Cellular"
                default OSN_BACKEND_CELL_LINUX
                source "kconfig/Kconfig.osn.cell_backend"
            endchoice

            menu "Firewall"
                choice
                    prompt "Firewall implementation"
                    default OSN_BACKEND_FW_IPTABLES_FULL
                    source "kconfig/Kconfig.osn.fw_backend"
                endchoice
                source "kconfig/Kconfig.osn.fw"
                choice
                    prompt "ipset implementation"
                    default OSN_BACKEND_IPSET_LINUX
                    source "kconfig/Kconfig.osn.ipset_backend"
                endchoice
                choice
                    prompt "ebtables implementation"
                    default OSN_BACKEND_FW_EBTABLES_FULL
                    source "kconfig/Kconfig.osn.fw_eb_backend"
                endchoice
                source "kconfig/Kconfig.osn.fw_eb"
            endmenu

            menu "Virtual Private Networks"
                choice
                    prompt "VPN"
                    default OSN_BACKEND_VPN_LINUX
                    source "kconfig/Kconfig.osn.vpn_backend"
                endchoice
                choice
                    prompt "IPsec"
                    default CONFIG_OSN_BACKEND_IPSEC_NULL
                    source "kconfig/Kconfig.osn.ipsec_backend"
                endchoice
                choice
                    prompt "Tunnel Interface"
                    default OSN_BACKEND_TUNNEL_IFACE_LINUX
                    source "kconfig/Kconfig.osn.tunnif_backend"
                endchoice
            endmenu

            choice
                prompt "Policy Routing Rules"
                default OSN_BACKEND_ROUTE_RULE_LINUX
                source "kconfig/Kconfig.osn.route_rule_backend"
            endchoice

            menu "MAP-T/MAP-E"
                choice
                    prompt "MAP-T/MAP-E Implementation"
                    default OSN_BACKEND_MAP_LINUX
                    source "kconfig/Kconfig.osn.map_backend"
                endchoice

                source "kconfig/Kconfig.osn.map_v6plus"
            endmenu

            source "kconfig/Kconfig.osn"
        endmenu

        menu "Platform (OSP)"
            menu "Unit (OSP unit)"
                choice
                    prompt "OSP Unit Backend"
                    source "kconfig/Kconfig.osp_unit.backend"
                endchoice
            endmenu

            menu "Upgrade (OSP_UPG)"
                choice
                    prompt "Upgrade Backend"
                    source "kconfig/Kconfig.osp_upg.backend"
                endchoice
                source "kconfig/Kconfig.osp_upg"
            endmenu

            menu "Download (OSP_DL)"
                choice
                    prompt "Download Backend"
                    default OSP_DL_CURL
                    source "kconfig/Kconfig.osp_dl.backend"
                endchoice
                source "kconfig/Kconfig.osp_dl"
            endmenu

            menu "Persistent Storage (OSP_PS)"
                choice
                    prompt "Persistent Storage Backend"
                    source "kconfig/Kconfig.osp_ps.backend"
                endchoice
                source "kconfig/Kconfig.osp_ps"
            endmenu

            menu "Reboot and Related Features (OSP_REBOOT)"
                choice
                    prompt "Reboot Backend"
                    source "kconfig/Kconfig.osp_reboot.backend"
                endchoice
                source "kconfig/Kconfig.osp_reboot"
            endmenu

            menu "OSP LED"
                source "kconfig/Kconfig.osp_led"
            endmenu

            menu "OSP TM"
                source "kconfig/Kconfig.osp_tm"
                choice
                    prompt "OSP TM temperature sensors backend"
                    default OSP_TM_SENSORS_NULL
                    source "kconfig/Kconfig.osp_tm_sensors.backend"
                endchoice
            endmenu

            menu "Layer 2 Switch Control"
                choice
                    prompt "L2Switch backend"
                    source "kconfig/Kconfig.osp_l2switch.backend"
                endchoice
                source "kconfig/Kconfig.osp_l2switch"
            endmenu

            menu "L2UF"
                choice
                    prompt "L2UF backend"
                    source "kconfig/Kconfig.osp_l2uf.backend"
                endchoice
                source "kconfig/Kconfig.osp_l2uf"
            endmenu

            menu "Object Management (OSP_OBJM)"
                choice
                    prompt "Object Management Backend"
                    source "kconfig/Kconfig.osp_objm.backend"
                endchoice
                source "kconfig/Kconfig.osp_objm"
            endmenu

            menu "OSP Power"
                source "kconfig/Kconfig.osp_power.backend"
            endmenu

            menu "Security (OSP_SEC)"
                choice
                    prompt "Security Backend"
                    default OSP_SEC_OPENSSL
                    source "kconfig/Kconfig.osp_sec.backend"
                endchoice
                source "kconfig/Kconfig.osp_sec"
            endmenu

            menu "Bluetooth Low Energy (OSP_BLE)"
                choice
                    prompt "Bluetooth Low Energy Backend"
                    source "kconfig/Kconfig.osp_ble.backend"
                endchoice
            endmenu

            menu "OpenThread Border Router (OSP_OTBR)"
                choice
                    prompt "OpenThread Border Router Backend"
                    default OSP_OTBR_NULL
                    source "kconfig/Kconfig.osp_otbr.backend"
                endchoice
                source "kconfig/Kconfig.osp_otbr"
            endmenu

            menu "Public Key Infrastrucutre (OSP_PKI)"
                choice
                    prompt "PKI Backend"
                    default OSP_PKI_PS
                    source "kconfig/Kconfig.osp_pki.backend"
                endchoice
                source "kconfig/Kconfig.osp_pki"
            endmenu

        endmenu
    endmenu

    menu "OVSDB"
        orsource "../ovsdb/Kconfig"
    endmenu

    menu "Libs"
        rsource "Kconfig.libs"
    endmenu

    menu "Tools"
        rsource "Kconfig.tools"
    endmenu

    menu "Misc"
        rsource "Kconfig.misc"
    endmenu

    menu "Target"
        orsource "../src/lib/target/kconfig/Kconfig"
    endmenu

    config INCLUDE
        string "Include base config"

    config INSTALL_PREFIX
        string "Install prefix path"
        default "$(INSTALL_PREFIX)"

    config TARGET_NAME
        string "Device Descriptive Name"

    config TARGET_ENABLE_EBTABLES
	bool "Enable ebtables to filter layer2 frames."
        default n
        help
            If enabled ebtables filtering is used to filter out layer2
            frames.

    config TARGET_MODEL
        string "Device Model Name"

    choice
        prompt "Boot integration"
        default NON_SUPERVISOR
            config SYSTEMD
                bool "Systemd"
                help
                "For systems that support systemd"

            config NON_SUPERVISOR
                bool "Non supervisor"
                help
                "For non supervisor systems"
        orsource "../platform/*/kconfig/Kconfig.startup"
        orsource "../vendor/*/kconfig/Kconfig.startup"
    endchoice
endmenu

menu "Platform Configuration"
    orsource "Kconfig.platform"
    orsource "../platform/*/kconfig/Kconfig.platform"
endmenu

menu "Vendor Configuration"
    choice VENDOR
        prompt "Vendor Selection"
        orsource "Kconfig.vendor"
        orsource "../vendor/*/kconfig/Kconfig.vendor"
    endchoice
    orsource "../vendor/*/kconfig/Kconfig"
endmenu

menu "3rdparty Configuration"
    orsource "../3rdparty/*/kconfig/Kconfig.3rdparty"
endmenu

orsource "Kconfig.hidden"
```

## kconfig/Kconfig.hidden
```kconfig
config OPENSYNC_NFM_FIREWALL
    bool
    default y if MANAGER_NFM && OSN_BACKEND_FW_IPTABLES_FULL
    default n
    help
        This is a hidden option (not visible from the menu). It is set to 'y' if
        OpenSync is using NFM for managing iptables.

config OPENSYNC_LEGACY_FIREWALL
    bool
    default y if !OPENSYNC_NFM_FIREWALL
    default n
    help
        This is a hidden option (not visible from the menu). It is set to 'y' if
        OpenSync is NOT using NFM for managing iptables.
```

## kconfig/Kconfig.libs
```kconfig
source "src/lib/evx/kconfig/Kconfig.libs"
source "src/lib/neigh_table/kconfig/Kconfig.libs"
source "src/lib/dns_cache/kconfig/Kconfig.libs"
source "src/lib/gatekeeper_msg/kconfig/Kconfig.libs"
source "src/lib/inet/kconfig/Kconfig.libs"
source "src/lib/log/kconfig/Kconfig.libs"
source "src/lib/mdnsd/kconfig/Kconfig.libs"
source "src/lib/gatekeeper_cache/kconfig/Kconfig.libs"
source "src/lib/gatekeeper_plugin/kconfig/Kconfig.libs"
source "src/lib/dhcp_relay/kconfig/Kconfig.libs"
source "src/lib/fsm_dpi_sec_portmap/kconfig/Kconfig.libs"
source "src/lib/imc/kconfig/Kconfig.libs"
source "src/lib/network_zone/kconfig/Kconfig.libs"
source "src/lib/we_dpi/kconfig/Kconfig.libs"
source "src/lib/walleye/kconfig/Kconfig.libs"
source "src/lib/rts/kconfig/Kconfig.libs"
source "src/lib/nfe/kconfig/Kconfig.libs"
source "src/lib/osw/kconfig/Kconfig.libs"
source "src/lib/ow/kconfig/Kconfig.libs"
source "src/lib/data_report_tags/kconfig/Kconfig.libs"
source "src/lib/ff/kconfig/Kconfig.libs"
source "src/lib/accel_evict_msg/kconfig/Kconfig.libs"
source "src/lib/dpi_intf/kconfig/Kconfig.libs"
source "src/lib/osbus/kconfig/Kconfig.libs"
source "src/lib/ustack/kconfig/Kconfig.libs"
source "src/lib/nf_utils/kconfig/Kconfig.libs"
source "src/lib/fsm_policy/kconfig/Kconfig.libs"
source "src/lib/fsm_utils/kconfig/Kconfig.libs"
source "src/lib/otbr_cli/kconfig/Kconfig.libs"
source "src/lib/revssh/kconfig/Kconfig.libs"

osource "platform/*/kconfig/Kconfig.libs"
osource "vendor/*/kconfig/Kconfig.libs"
```

## kconfig/Kconfig.managers
```kconfig
comment "Core Managers"

#
# OpenSync Core Modules
#
source "src/dm/kconfig/Kconfig.managers"
source "src/cm2/kconfig/Kconfig.managers"
source "src/wano/kconfig/Kconfig.managers"
source "src/nm2/kconfig/Kconfig.managers"
source "src/wm2/kconfig/Kconfig.managers"
source "src/sm/kconfig/Kconfig.managers"
source "src/bm/kconfig/Kconfig.managers"
source "src/um/kconfig/Kconfig.managers"
source "src/pm/kconfig/Kconfig.managers"
source "src/lm/kconfig/Kconfig.managers"
source "src/om/kconfig/Kconfig.managers"
source "src/qm/kconfig/Kconfig.managers"
source "src/fsm/kconfig/Kconfig.managers"
source "src/fcm/kconfig/Kconfig.managers"
source "src/qosm/kconfig/Kconfig.managers"
source "src/nfm/kconfig/Kconfig.managers"
source "src/maptm/kconfig/Kconfig.managers"
source "src/xm/kconfig/Kconfig.managers"
source "src/cpm/kconfig/Kconfig.managers"
source "src/hello_world/kconfig/Kconfig.managers"

#
# Include platform/vendor managers
#
osource "platform/*/kconfig/Kconfig.managers"
osource "vendor/*/kconfig/Kconfig.managers"
```

## kconfig/Kconfig.osn
```kconfig
#
# Core OSN module
#
source "src/lib/osn/kconfig/Kconfig.osn"

# Include vendor/platform OSN modules
osource "platform/*/kconfig/Kconfig.osn"
osource "vendor/*/kconfig/Kconfig.osn"
```
