## kconfig/Kconfig.misc
```kconfig
orsource "../src/lib/hostap/kconfig/Kconfig"
orsource "../src/wpd/kconfig/Kconfig"

config REMAP_LEGACY
    bool "Remap legacy install prefix path"
    help
        Move all files from legacy location to new install prefix path
        Also replace all paths in installed scripts

config IN_PLACE_UPGRADE
    bool "Support in-place upgrade of OpenSync"
    default n
    help
        Build an installable OpenSync package and
        modify the boot process to allow for in-place
        upgrade of OpenSync

config RUN_IN_LXC
    bool "Run in LXC container"
    default n
    help
        Run OpenSync in an LXC container

config MANAGER_WATCHDOG_TIMEOUT_SEC
    int "Manager watchdog timeout in seconds"
    default 90
    help
        Timeout for the manager watchdog that monitors the main event loop
        of a manager process. If the main loop does not process events within
        this timeout period, the watchdog will crash the process in order to
        prevent infinite loops or blocking calls.
        Runs on all managers, except ones that are expected to run system
        commands for an extended period of time like Upgrade Manager (UM).
        Set to 0 to disable the feature on all managers.
```

## src/cellm/kconfig/Kconfig.managers
```kconfig
menuconfig MANAGER_CELLM
    bool "Cellular Manager (CELLM)"
    default n
    help
        Enable Cellular Manager (CELLM)

    config MANAGER_CELLM_CFG
        depends on MANAGER_CELLM
        string "CELLM Startup configuration"
        default "cellm;true;always_restart=true;restart_delay=-1"
        help
            Cellular Manager startup configuration
            Optional crash backoff keys (;-separated key=value):
            crash_count_max, crash_count_period, crash_recovery.
            crash_count_max=0 disables. Ignored when needs_plan_b=true.
```

## src/lib/dns_cache/kconfig/Kconfig.libs
```kconfig
menu "libdns_cache Configuration"
    config LIBDNS_CACHE
        bool "Library for per device-ip lookup actions cache"
        depends on MANAGER_FSM
        default y
        help
            Enable support for caching per device per ip lookup actions cache
endmenu
```

## src/lib/dpi_intf/kconfig/Kconfig.libs
```kconfig
menuconfig LIB_DPI_INTF
    bool "Enables the management of network interfaces for the DPI framework"
        depends on MANAGER_FSM
        default y
        help
            N/A
```

## src/lib/fsm_policy/kconfig/Kconfig.libs
```kconfig
menuconfig LIB_FSM_POLICY
    bool "Enables the FSM policy management library"
        depends on MANAGER_FSM
        default y
        help
            Enable the FSM policy management library
```

## src/lib/gatekeeper_msg/kconfig/Kconfig.libs
```kconfig
menu "libgatekeeper_msg Configuration"
    config LIBGATEKEEPER_MSG
        bool "Library to manage Gatekeeper message format"
        depends on MANAGER_FSM
        default y
        help
            Enable support to serialize/deserialize messages from/to the gatekeeper service
endmenu
```

## src/lib/mdnsd/kconfig/Kconfig.libs
```kconfig
menuconfig LIB_FSM_MDNSD
    bool "Enables Opensync FSM mDNSD library"
    depends on MANAGER_FSM
    default y
    help
       N/A

if LIB_FSM_MDNSD
    config MDNS_OPENSYNC_LOG
        string "mdnsd Configuration"
        bool "Log mdnsd messages using OpenSync logger"
        default y
        help
            Log messages using OpenSync logger.
            If disabled, mdnsd will use its own logger.
endif
```

## src/lib/neigh_table/kconfig/Kconfig.libs
```kconfig
menu "libneigh_table Configuration"
    config LIBNEIGH_TABLE
        bool "Library for ip to mac address mapping"
        depends on MANAGER_FSM
        default y
        help
            Enable support for neigh_table caching mechanism to
            cache ip to mac address mapping which can be used
            by any of the managers.
endmenu
```

## src/lib/nf_utils/kconfig/Kconfig.libs
```kconfig
menuconfig LIB_NF_UTILS
    bool "Enables OpenSync netfilter utilities"
         depends on MANAGER_FSM
         default y
        help
            N/A
```

## src/lib/os_tr181/kconfig/Kconfig.libs
```kconfig
menu "OS TR181 LIB"

    config OS_TR181_LIB
        bool "os_tr181 lib Support"
        default y
        help
            Select to include os_tr181 lib

    if OS_TR181_LIB
        choice
            prompt "os_tr181 default backend"
            default OS_TR181_LIB_NULL

            config OS_TR181_LIB_NULL
                bool "NULL"
                help
                    An empty (null/stub) implementation

            config OS_TR181_LIB_AMX
                bool "PRPL/Ambiorix"
                help
                    PRPL/Ambiorix backend for tr181

            config OS_TR181_LIB_CCSP
                bool "RDKB/CCSP"
                help
                    RDKB/CCSP backend for tr181
        endchoice
    endif

endmenu
```

## src/lib/osn/kconfig/Kconfig.osn.fw_eb
```kconfig
if OSN_BACKEND_FW_EBTABLES_THIN
    comment "ebtables thin options"

    config OSN_FW_EBTABLES_THIN_ATOMIC
        bool "ebtables thin: atomic apply"
        default n
        help
            Apply ebtables rule changes atomically using ebtables
            --atomic-file / --atomic-save / --atomic-commit so that the
            managed chains are never momentarily empty during a
            reconfiguration. Without this, the thin backend flushes each
            managed chain and only re-adds its rules afterwards, leaving a
            brief window in which client-isolation rules (e.g. the DROP in
            INET_ONLY) are absent and LAN-to-LAN traffic can leak.

            Uses --atomic-save (not --atomic-init) to snapshot the current
            kernel table before modifications, preserving rules managed by
            other subsystems (e.g. SWAN).

            This requires legacy ebtables (the --atomic-* options and the
            EBTABLES_ATOMIC_FILE environment variable). On ebtables-nft,
            which does not implement atomic-file, a one-time runtime probe
            detects the lack of support and falls back to the non-atomic
            apply automatically.
endif

if OSN_BACKEND_FW_EBTABLES_FULL
    comment "ebtables full options"
    menu "Default ebtables Policy"
        comment "FILTER Table"
        choice
            prompt "INPUT"
            default OSN_FW_EBTABLES_POLICY_FILTER_INPUT_ACCEPT

            config OSN_FW_EBTABLES_POLICY_FILTER_INPUT_ACCEPT
                bool "Accept"

            config OSN_FW_EBTABLES_POLICY_FILTER_INPUT_CONTINUE
                bool "Continue"

            config OSN_FW_EBTABLES_POLICY_FILTER_INPUT_RETURN
                bool "Return"

            config OSN_FW_EBTABLES_POLICY_FILTER_INPUT_DROP
                bool "Drop"
        endchoice

        choice
            prompt "OUTPUT"
            default OSN_FW_EBTABLES_POLICY_FILTER_OUTPUT_ACCEPT

            config OSN_FW_EBTABLES_POLICY_FILTER_OUTPUT_ACCEPT
                bool "Accept"

            config OSN_FW_EBTABLES_POLICY_FILTER_OUTPUT_CONTINUE
                bool "Continue"

            config OSN_FW_EBTABLES_POLICY_FILTER_OUTPUT_RETURN
                bool "Return"

            config OSN_FW_EBTABLES_POLICY_FILTER_OUTPUT_DROP
                bool "Drop"
        endchoice

        choice
            prompt "FORWARD"
            default OSN_FW_EBTABLES_POLICY_FILTER_FORWARD_ACCEPT

            config OSN_FW_EBTABLES_POLICY_FILTER_FORWARD_ACCEPT
                bool "Accept"

            config OSN_FW_EBTABLES_POLICY_FILTER_FORWARD_CONTINUE
                bool "Continue"

            config OSN_FW_EBTABLES_POLICY_FILTER_FORWARD_RETURN
                bool "Return"

            config OSN_FW_EBTABLES_POLICY_FILTER_FORWARD_DROP
                bool "Drop"
        endchoice

        comment "NAT Table"
        choice
            prompt "PREROUTING"
            default OSN_FW_EBTABLES_POLICY_NAT_PREROUTING_ACCEPT

            config OSN_FW_EBTABLES_POLICY_NAT_PREROUTING_ACCEPT
                bool "Accept"

            config OSN_FW_EBTABLES_POLICY_NAT_PREROUTING_CONTINUE
                bool "Continue"

            config OSN_FW_EBTABLES_POLICY_NAT_PREROUTING_RETURN
                bool "Return"

            config OSN_FW_EBTABLES_POLICY_NAT_PREROUTING_DROP
                bool "Drop"
        endchoice

        choice
            prompt "OUTPUT"
            default OSN_FW_EBTABLES_POLICY_NAT_OUTPUT_ACCEPT

            config OSN_FW_EBTABLES_POLICY_NAT_OUTPUT_ACCEPT
                bool "Accept"

            config OSN_FW_EBTABLES_POLICY_NAT_OUTPUT_CONTINUE
                bool "Continue"

            config OSN_FW_EBTABLES_POLICY_NAT_OUTPUT_RETURN
                bool "Return"

            config OSN_FW_EBTABLES_POLICY_NAT_OUTPUT_DROP
                bool "Drop"
        endchoice

        choice
            prompt "POSTROUTING"
            default OSN_FW_EBTABLES_POLICY_NAT_POSTROUTING_ACCEPT

            config OSN_FW_EBTABLES_POLICY_NAT_POSTROUTING_ACCEPT
                bool "Accept"

            config OSN_FW_EBTABLES_POLICY_NAT_POSTROUTING_CONTINUE
                bool "Continue"

            config OSN_FW_EBTABLES_POLICY_NAT_POSTROUTING_RETURN
                bool "Return"

            config OSN_FW_EBTABLES_POLICY_NAT_POSTROUTING_DROP
                bool "Drop"
        endchoice

        comment "BROUTE Table"
        choice
            prompt "BROUTING"
            default OSN_FW_EBTABLES_POLICY_BROUTE_BROUTING_ACCEPT

            config OSN_FW_EBTABLES_POLICY_BROUTE_BROUTING_ACCEPT
                bool "Accept"

            config OSN_FW_EBTABLES_POLICY_BROUTE_BROUTING_RETURN
                bool "Return"

            config OSN_FW_EBTABLES_POLICY_BROUTE_BROUTING_CONTINUE
                bool "Continue"

            config OSN_FW_EBTABLES_POLICY_BROUTE_BROUTING_DROP
                bool "Drop"
        endchoice
    endmenu
endif
```

## src/nfm/kconfig/Kconfig.managers
```kconfig
menuconfig MANAGER_NFM
    bool "Netfilter Manager (NFM)"
    default n
    help
        Enable Netfilter Manager (NFM)

    config MANAGER_NFM_CFG
        depends on MANAGER_NFM
        string "NFM Startup configuration"
        default "nfm;true"
        help
            Netfilter Manager startup configuration
            Optional crash backoff keys (;-separated key=value):
            crash_count_max, crash_count_period, crash_recovery.
            crash_count_max=0 disables. Ignored when needs_plan_b=true.
```

## src/om/kconfig/Kconfig.managers
```kconfig
menuconfig MANAGER_OM
    bool "Openflow Manager (OM)"
    default y
    help
        Enable Openflow Manager (OM)

    config MANAGER_OM_CFG
        depends on MANAGER_OM
        string "OM Startup configuration"
        default "om;true;needs_plan_b=true"
        help
            Openflow Manager startup configuration
            Optional crash backoff keys (;-separated key=value):
            crash_count_max, crash_count_period, crash_recovery.
            crash_count_max=0 disables. Ignored when needs_plan_b=true.
```

## src/owm/kconfig/Kconfig.managers
```kconfig
menuconfig MANAGER_OWM
    bool "Opensync Wireless / One Wifi Manager (OWM)"
    default y
    help
        This process is intended to handle all Wireless
        related operations in Opensync - apply
        configurations, report states, steering clients,
        collect data (statistics, CSI), etc.

        Otherwise, if unsure, select 'y'.

    config MANAGER_OWM_CFG
        depends on MANAGER_OWM
        string "Startup configuration"
        default "owm;true;needs_plan_b=false;max_memory=100000"
        help
            Opensync Wireless Manager / One Wifi Manager
            startup configuration for DM. This provides the
            base parameters for daemon process supervision.
            Optional crash backoff keys (;-separated key=value):
            crash_count_max, crash_count_period, crash_recovery.
            crash_count_max=0 disables. Ignored when needs_plan_b=true.

    choice
        prompt "Select RSNO (RSN Override) mode"
        depends on MANAGER_OWM
        default OW_CORE_RSNO_WPA3_COMPAT_TRANSITION

            config OW_CORE_RSNO_NONE
                bool "No RSNO support"
                help
                    No RSNO support is compiled in.

            config OW_CORE_RSNO_WPA3_COMPAT
                bool "WPA3 compatibility mode"
                help
                    RSNO support is compiled in with WPA3 compatibility mode.
                    This will automatically remove non-PSK AKMs from RSNE and
                    move them to RSNO1 and RSNO2 as per WFA WPA spec.

                    This is the most conservative option. It will result in
                    downgrading older WPA3 clients to use PSK instead of SAE
                    when connecting to AP where RSNO is enabled.

                    This is intended mostly for Wi-Fi 7 platforms for
                    interoperability purposes.

                    Keep in mind this will have an effect on WPA3-Personal
                    Transition non-Wi-Fi 7 platforms too as it will move SAE to
                    RSNO1, and keep PSK in RSNE only.

            config OW_CORE_RSNO_WPA3_COMPAT_TRANSITION
                bool "WPA3 compatibility transition mode"
                help
                    Just like OW_CORE_RSNO_WPA3_COMPAT except RSNE is allowed
                    to contain PSK+SAE AKMs to avoid degrading security
                    properties for WPA3 devices that aren't RSNO aware.

                    This is least conservative option compared to
                    OW_CORE_RSNO_WPA3_COMPAT as it should not result in WPA3
                    clients being downgraded to WPA2.

                    This doesn't fulfill the WFA WPA spec's definition of WPA3
                    Compatibility Mode though, but complies with RSNO itself.

            config OW_CORE_RSNO_WPA3_COMPAT_WIFI7_ONLY
                bool "WPA3 compatibility mode for WiFi7 only"
                help
                    Just like OW_CORE_RSNO_WPA3_COMPAT except the split is done
                    only if RSNE AKM is intended to include SAE-EXT.

                    This is a middle-ground option between
                    OW_CORE_RSNO_WPA3_COMPAT and
                    OW_CORE_RSNO_WPA3_COMPAT_TRANSITION. It applies the
                    transformation only on Wi-Fi 7 APs where SAE-EXT is
                    required for EHT+MLO. APs that have no SAE-EXT will not
                    have their real RSNE changed.
    endchoice
```

## src/oxm/kconfig/Kconfig.managers
```kconfig
menuconfig MANAGER_OXM
    bool "OVSDB Translator (OXM)"
    depends on OS_TR181_LIB && !OS_TR181_LIB_NULL
    default y
    help
        This option enables the OVSDB Translator (OXM) manager which projects
        OVSDB into TR-181 data model and back.

        This allows integrating legacy Opensync systems that were exclusively
        designed to operate over OVSDB, with the new TR-181 based data model.

        By enabling this manager, you can ensure that your existing OVSDB-based
        configurations and operations continue to function seamlessly while
        transitioning to the TR-181 data model.

        If unsure, select 'y'.

    config MANAGER_OXM_CFG
        depends on MANAGER_OXM
        string "Startup configuration"
        default "oxm;true;needs_plan_b=false;max_memory=100000"
        help
            This option allows you to specify the startup configuration for the
            OVSDB Translator (OXM) manager.
            Optional crash backoff keys (;-separated key=value):
            crash_count_max, crash_count_period, crash_recovery.
            crash_count_max=0 disables. Ignored when needs_plan_b=true.
```
