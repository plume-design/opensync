## src/pkim/kconfig/Kconfig.managers
```kconfig
menuconfig MANAGER_PKIM
    bool "PKI Manager (PKIM)"
    default y
    help
        Enable PKI Manager (PKIM)

    config MANAGER_PKIM_CFG
        depends on MANAGER_PKIM
        string "PKIM Startup configuration"
        default "pkim;true;needs_plan_b=false"
        help
            PKI Manager startup configuration
            Optional crash backoff keys (;-separated key=value):
            crash_count_max, crash_count_period, crash_recovery.
            crash_count_max=0 disables. Ignored when needs_plan_b=true.
```

## src/psm/kconfig/Kconfig.managers
```kconfig
menuconfig MANAGER_PSM
    bool "Persistent Storage Manager (PSM)"
    default y
    help
        Enable Persistent Storage Manager (PSM)

if MANAGER_PSM
    config MANAGER_PSM_CFG
        string "PSM Startup configuration"
        default "psm;true"
        help
            Persistent Storage Manager configuration
            Optional crash backoff keys (;-separated key=value):
            crash_count_max, crash_count_period, crash_recovery.
            crash_count_max=0 disables. Ignored when needs_plan_b=true.
endif
```

## src/qm/kconfig/Kconfig.managers
```kconfig
menuconfig MANAGER_QM
    bool "Queue Manager (QM)"
    default y
    help
        Enable Queue Manager (QM)

    config MANAGER_QM_CFG
        depends on MANAGER_QM
        string "QM Startup configuration"
        default "qm;true"
        help
            Queue Manager startup configuration
            Optional crash backoff keys (;-separated key=value):
            crash_count_max, crash_count_period, crash_recovery.
            crash_count_max=0 disables. Ignored when needs_plan_b=true.
```

## src/qosm/kconfig/Kconfig.managers
```kconfig
menuconfig MANAGER_QOSM
    bool "QoS Manager (QoSM)"
    default y
    help
        Enable QoS Manager (QoSM)

if MANAGER_QOSM
    config MANAGER_QOSM_CFG
        string "QoSM Startup configuration"
        default "qosm;true"
        help
            QoS Manager startup configuration
            Optional crash backoff keys (;-separated key=value):
            crash_count_max, crash_count_period, crash_recovery.
            crash_count_max=0 disables. Ignored when needs_plan_b=true.
endif
```

## src/tpsm/kconfig/Kconfig.managers
```kconfig
menuconfig MANAGER_TPSM
    bool "3rd-Party Manager (TPSM)"
    default y

if MANAGER_TPSM
    config MANAGER_TPSM_CFG
        string "TPSM Startup configuration"
        default "tpsm;true;needs_plan_b=false"
        help
            Third-party Manager startup configuration
            Optional crash backoff keys (;-separated key=value):
            crash_count_max, crash_count_period, crash_recovery.
            crash_count_max=0 disables. Ignored when needs_plan_b=true.

    config TPSM_PID_PATH
        string "Path to the PID folder"
        default "/tmp/tmpid"
        help
            This is the folder where PID files of the started processes will
            be stored. The files will be named [MANAGER_NAME].pid

    config SPEEDTEST_RT_RUNTIME
        int "RT_RUNTIME in [%] of maximum"
        default 95
        help
            Sets the RT_RUNTIME for speedtest priority.

    menuconfig IPERF_SPEEDTEST
        bool "Iperf SpeedTest"
        default y

        if IPERF_SPEEDTEST
            config IPERF_NICE
                string "Optional command to set process priority of speedtest"
                default "$(INSTALL_PREFIX)/bin/runprio.sh"

            config IPERF_CLIENT_BIN_ARGUMENTS
                string "Additional iperf client binary arguments"
                default "-Z -O2"
                help
                    "Client-only arguments passed to the iperf3 binary when running as a client. These are mutable -> will be overridden by the cloud config"

            config IPERF_DEFAULT_PARALLEL
                int "Default number of parallel iperf streams"
                default 16
                help
                    Sets the -P value used when st_parallel is not configured.
                    Also used to scale the per-stream -b limit to match the total
                    configured bandwidth.

            config IPERF_PARAM
                string "Additional parameters for iperf"
                default ""
                help
                    "These are immutable -> will override cloud config"

            config IPERF_OPT_TCP_IGNORE_CSUM
                bool "iperf perf optimization: sysctl ipv4/tcp_ignore_csum"
                default y
                help
                    Use sysctl ipv4/tcp_ignore_csum for iperf performance improvement

            config IPERF_OPT_GRO
                bool "iperf perf optimization: ethtool gro"
                default n
                help
                    Use ethtool gro for iperf performance improvement

            config IPERF_OPT_MODULE
                bool "iperf perf optimization: kernel parameters"
                default n
                help
                    Use kernel parameters for iperf performance improvement

            config IPERF_LHOST_ACCEL
                bool "iperf perf optimization: lhost_accel"
                default y
                help
                    Use kernel module lhost_accel for iperf performance improvement

        endif
endif
```

## src/vpnm/kconfig/Kconfig.managers
```kconfig
menuconfig MANAGER_VPNM
    bool "Virtual Private Network Manager (VPNM)"
    default y
    help
        Enable Virtual Private Network Manager (VPNM)

    config MANAGER_VPNM_CFG
        depends on MANAGER_VPNM
        string "VPNM Startup configuration"
        default "vpnm;true"
        help
            Virtual Private Network Manager startup configuration
            Optional crash backoff keys (;-separated key=value):
            crash_count_max, crash_count_period, crash_recovery.
            crash_count_max=0 disables. Ignored when needs_plan_b=true.
```

## src/xm/kconfig/Kconfig.managers
```kconfig
menuconfig MANAGER_XM
    bool "Exchange Manager (XM)"
    default n
    help
        Enable Exchange Manager (XM)

    config MANAGER_XM_CFG
        depends on MANAGER_XM
        string "XM Startup configuration"
        default "xm;true"
        help
            Exchange Manager startup configuration
            Optional crash backoff keys (;-separated key=value):
            crash_count_max, crash_count_period, crash_recovery.
            crash_count_max=0 disables. Ignored when needs_plan_b=true.
```
